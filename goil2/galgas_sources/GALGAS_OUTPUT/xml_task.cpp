//---------------------------------------------------------------------------*
//                                                                           *
//                           File 'xml_task.cpp'                             *
//                 Generated by version GALGAS_BETA_VERSION                  *
//                      june 12th, 2009, at 14h44'49"                        *
//                                                                           *
//---------------------------------------------------------------------------*

//--- START OF USER ZONE 1


//--- END OF USER ZONE 1

//---------------------------------------------------------------------------*

#include "version_libpm.h"
#if LIBPM_VERSION != 502
  #error "This file has been compiled with a version of GALGAS different than the version of libpm"
#endif

//---------------------------------------------------------------------------*

#include <typeinfo>
#include "utilities/MF_MemoryControl.h"
#include "files/C_TextFileWrite.h"
#include "xml_task.h"

//---------------------------------------------------------------------------*

#ifndef DO_NOT_GENERATE_CHECKINGS
  #define SOURCE_FILE_AT_LINE(line) "xml_task.ggs", line
  #define COMMA_SOURCE_FILE_AT_LINE(line) , SOURCE_FILE_AT_LINE(line)
#else
  #define SOURCE_FILE_AT_LINE(line) 
  #define COMMA_SOURCE_FILE_AT_LINE(line) 
#endif


//--- START OF USER ZONE 2


//--- END OF USER ZONE 2

//---------------------------------------------------------------------------*
//                                                                           *
//             Implementation of routine "parse_task_autostart"              *
//                                                                           *
//---------------------------------------------------------------------------*

void routine_parse_task_autostart (C_Compiler & inLexique,
                                const GGS_xmlNodeList   var_cas_cont_elems,
                                const GGS_lstring   var_cas_name,
                                const GGS_location   var_cas_autoloc,
                                GGS_task_obj  & var_cas_task COMMA_UNUSED_LOCATION_ARGS) {
  #ifdef DEBUG_TRACE_ENABLED
    printf ("ENTER routine_parse_task_autostart at %s:%d\n", __FILE__, __LINE__) ;
  #endif
  GGS_xmlNode  var_cas_node ;
  var_cas_node = function_elem_named (inLexique, var_cas_cont_elems, GGS_string ("REFERENCE-VALUES") COMMA_SOURCE_FILE_AT_LINE (37)) ;
  if ((function_is_not_void (inLexique, var_cas_node COMMA_SOURCE_FILE_AT_LINE (38))).isBuiltAndTrue ()) {
    GGS_xmlNodeList  var_cas_appmodes ;
    var_cas_appmodes = var_cas_node.reader_nodeList (inLexique COMMA_SOURCE_FILE_AT_LINE (39)) ;
    GGS_stringset  var_cas_ams ;
    var_cas_ams = GGS_stringset ::constructor_emptySet () ;
    {
      GGS_xmlNodeList::cEnumerator enumerator_901 (var_cas_appmodes, true) ;
      const GGS_xmlNodeList::cElement * operand_901 = NULL ;
      while (((operand_901 = enumerator_901.nextObject ()))) {
        macroValidPointer (operand_901) ;
        GGS_string var_cas_am ;
        var_cas_am = function_ref_text (inLexique, operand_901->node COMMA_SOURCE_FILE_AT_LINE (42)).reader_string (inLexique COMMA_SOURCE_FILE_AT_LINE (42)).reader_lastPathComponent (inLexique COMMA_SOURCE_FILE_AT_LINE (42)) ;
        var_cas_ams._addAssign_operation (var_cas_am) ;
      }
    }
    var_cas_task.modifier_setAutostart (inLexique, GGS_task_autostart_true ::constructor_new (inLexique, var_cas_autoloc, var_cas_ams COMMA_HERE) COMMA_SOURCE_FILE_AT_LINE (45)) ;
  }else{
    var_cas_name.reader_location (inLexique COMMA_HERE).signalGGSSemanticError (inLexique, GGS_string ("No REFERENCE-VALUES found in OsTaskAutostart") COMMA_SOURCE_FILE_AT_LINE (48)) ;
  }
  #ifdef DEBUG_TRACE_ENABLED
    printf ("LEAVE routine_parse_task_autostart\n") ;
  #endif
}

//---------------------------------------------------------------------------*
//                                                                           *
//           Implementation of routine "parse_task_subcontainer"             *
//                                                                           *
//---------------------------------------------------------------------------*

void routine_parse_task_subcontainer (C_Compiler & inLexique,
                                const GGS_xmlNodeList   var_cas_cont_elems,
                                const GGS_lstring   var_cas_name,
                                GGS_task_obj  & var_cas_task COMMA_UNUSED_LOCATION_ARGS) {
  #ifdef DEBUG_TRACE_ENABLED
    printf ("ENTER routine_parse_task_subcontainer at %s:%d\n", __FILE__, __LINE__) ;
  #endif
  {
    GGS_xmlNodeList::cEnumerator enumerator_1298 (var_cas_cont_elems, true) ;
    const GGS_xmlNodeList::cElement * operand_1298 = NULL ;
    while (((operand_1298 = enumerator_1298.nextObject ()))) {
      macroValidPointer (operand_1298) ;
      GGS_lstring  var_cas_elem_name ;
      var_cas_elem_name = function_long_name (inLexique, operand_1298->node COMMA_SOURCE_FILE_AT_LINE (57)) ;
      if (((var_cas_elem_name.reader_string (inLexique COMMA_SOURCE_FILE_AT_LINE (58))).operator_isEqual (GGS_string ("OsTaskAutostart"))).isBuiltAndTrue ()) {
        inLexique.printMessage (GGS_string ("Autostart trouve\n") COMMA_SOURCE_FILE_AT_LINE (59)) ;
        ::routine_parse_task_autostart (inLexique,  var_cas_cont_elems,  var_cas_name,  var_cas_elem_name.reader_location (inLexique COMMA_SOURCE_FILE_AT_LINE (60)),  var_cas_task COMMA_SOURCE_FILE_AT_LINE (60)) ;
      }
    }
  }
  #ifdef DEBUG_TRACE_ENABLED
    printf ("LEAVE routine_parse_task_subcontainer\n") ;
  #endif
}

//---------------------------------------------------------------------------*
//                                                                           *
//                  Implementation of routine "parse_task"                   *
//                                                                           *
//---------------------------------------------------------------------------*

void routine_parse_task (C_Compiler & inLexique,
                                const GGS_lstring   var_cas_name,
                                const GGS_xmlNodeList   var_cas_cont_elems,
                                GGS_root_obj  & var_cas_cpu COMMA_UNUSED_LOCATION_ARGS) {
  #ifdef DEBUG_TRACE_ENABLED
    printf ("ENTER routine_parse_task at %s:%d\n", __FILE__, __LINE__) ;
  #endif
  GGS_task_obj  var_cas_t ;
  var_cas_t = function_default_task_obj (inLexique COMMA_SOURCE_FILE_AT_LINE (70)) ;
  GGS_xmlNode  var_cas_node ;
  var_cas_node = function_elem_named (inLexique, var_cas_cont_elems, GGS_string ("PARAMETER-VALUES") COMMA_SOURCE_FILE_AT_LINE (72)) ;
  if ((function_is_not_void (inLexique, var_cas_node COMMA_SOURCE_FILE_AT_LINE (73))).isBuiltAndTrue ()) {
    GGS_xmlNodeList  var_cas_params ;
    var_cas_params = var_cas_node.reader_nodeList (inLexique COMMA_SOURCE_FILE_AT_LINE (74)) ;
    {
      GGS_xmlNodeList::cEnumerator enumerator_1862 (var_cas_params, true) ;
      const GGS_xmlNodeList::cElement * operand_1862 = NULL ;
      while (((operand_1862 = enumerator_1862.nextObject ()))) {
        macroValidPointer (operand_1862) ;
        if ((function_is_param (inLexique, operand_1862->node, GGS_string ("OsTaskPriority") COMMA_SOURCE_FILE_AT_LINE (76))).isBuiltAndTrue ()) {
          var_cas_t.modifier_setPriority (inLexique, function_uint32_class_param (inLexique, operand_1862->node COMMA_SOURCE_FILE_AT_LINE (77)) COMMA_SOURCE_FILE_AT_LINE (77)) ;
          ::routine_p_bt (inLexique,  var_cas_t.reader_priority (inLexique COMMA_SOURCE_FILE_AT_LINE (78)) COMMA_SOURCE_FILE_AT_LINE (78)) ;
        }else if ((function_is_param (inLexique, operand_1862->node, GGS_string ("OsTaskSchedule") COMMA_SOURCE_FILE_AT_LINE (79))).isBuiltAndTrue ()) {
          var_cas_t.modifier_setSchedule (inLexique, function_lstring_param (inLexique, operand_1862->node COMMA_SOURCE_FILE_AT_LINE (80)) COMMA_SOURCE_FILE_AT_LINE (80)) ;
          inLexique.printMessage ((var_cas_t.reader_schedule (inLexique COMMA_SOURCE_FILE_AT_LINE (81)).reader_string (inLexique COMMA_SOURCE_FILE_AT_LINE (81))).operator_concat (GGS_string ("\n")) COMMA_SOURCE_FILE_AT_LINE (81)) ;
        }else if ((function_is_param (inLexique, operand_1862->node, GGS_string ("OsTaskActivation") COMMA_SOURCE_FILE_AT_LINE (82))).isBuiltAndTrue ()) {
          var_cas_t.modifier_setActivation (inLexique, function_uint32_class_param (inLexique, operand_1862->node COMMA_SOURCE_FILE_AT_LINE (83)) COMMA_SOURCE_FILE_AT_LINE (83)) ;
          ::routine_p_bt (inLexique,  var_cas_t.reader_activation (inLexique COMMA_SOURCE_FILE_AT_LINE (84)) COMMA_SOURCE_FILE_AT_LINE (84)) ;
        }else if ((function_is_param (inLexique, operand_1862->node, GGS_string ("OsTaskActivation") COMMA_SOURCE_FILE_AT_LINE (85))).isBuiltAndTrue ()) {
          var_cas_t.modifier_setActivation (inLexique, function_uint32_class_param (inLexique, operand_1862->node COMMA_SOURCE_FILE_AT_LINE (86)) COMMA_SOURCE_FILE_AT_LINE (86)) ;
          ::routine_p_bt (inLexique,  var_cas_t.reader_activation (inLexique COMMA_SOURCE_FILE_AT_LINE (87)) COMMA_SOURCE_FILE_AT_LINE (87)) ;
        }else if ((function_is_param (inLexique, operand_1862->node, GGS_string ("OsTaskResourceRef") COMMA_SOURCE_FILE_AT_LINE (88))).isBuiltAndTrue ()) {
          GGS_lstringlist  var_cas_resources ;
          var_cas_resources = var_cas_t.reader_resources (inLexique COMMA_SOURCE_FILE_AT_LINE (89)) ;
          var_cas_resources._addAssign_operation (function_value_text (inLexique, operand_1862->node COMMA_SOURCE_FILE_AT_LINE (90))) ;
          var_cas_t.modifier_setResources (inLexique, var_cas_resources COMMA_SOURCE_FILE_AT_LINE (91)) ;
          inLexique.printMessage (C_String ("LOGGING resources: ") + var_cas_resources.reader_description (inLexique COMMA_HERE).string () + "\n" COMMA_SOURCE_FILE_AT_LINE (92)) ;
        }else if ((function_is_param (inLexique, operand_1862->node, GGS_string ("OsTaskEventRef") COMMA_SOURCE_FILE_AT_LINE (93))).isBuiltAndTrue ()) {
          GGS_lstringlist  var_cas_events ;
          var_cas_events = var_cas_t.reader_events (inLexique COMMA_SOURCE_FILE_AT_LINE (94)) ;
          var_cas_events._addAssign_operation (function_value_text (inLexique, operand_1862->node COMMA_SOURCE_FILE_AT_LINE (95))) ;
          var_cas_t.modifier_setEvents (inLexique, var_cas_events COMMA_SOURCE_FILE_AT_LINE (96)) ;
          inLexique.printMessage (C_String ("LOGGING events: ") + var_cas_events.reader_description (inLexique COMMA_HERE).string () + "\n" COMMA_SOURCE_FILE_AT_LINE (97)) ;
        }else if ((function_is_param (inLexique, operand_1862->node, GGS_string ("OsTaskAccessingApplication") COMMA_SOURCE_FILE_AT_LINE (98))).isBuiltAndTrue ()) {
          GGS_lstringlist  var_cas_acc_apps ;
          var_cas_acc_apps = var_cas_t.reader_acc_apps (inLexique COMMA_SOURCE_FILE_AT_LINE (99)) ;
          var_cas_acc_apps._addAssign_operation (function_value_text (inLexique, operand_1862->node COMMA_SOURCE_FILE_AT_LINE (100))) ;
          var_cas_t.modifier_setAcc_apps (inLexique, var_cas_acc_apps COMMA_SOURCE_FILE_AT_LINE (101)) ;
          inLexique.printMessage (C_String ("LOGGING acc_apps: ") + var_cas_acc_apps.reader_description (inLexique COMMA_HERE).string () + "\n" COMMA_SOURCE_FILE_AT_LINE (102)) ;
        }else if ((function_is_param (inLexique, operand_1862->node, GGS_string ("OsTaskStackSize") COMMA_SOURCE_FILE_AT_LINE (103))).isBuiltAndTrue ()) {
          GGS_ident_map  var_cas_others ;
          var_cas_others = var_cas_t.reader_others (inLexique COMMA_SOURCE_FILE_AT_LINE (104)) ;
          GGS_uint64_class  var_cas_ss ;
          var_cas_ss = function_uint64_class_param (inLexique, operand_1862->node COMMA_SOURCE_FILE_AT_LINE (105)) ;
          var_cas_others.modifier_put (inLexique, GGS_lstring ::constructor_new (inLexique, GGS_string ("STACKSIZE"), var_cas_ss.reader_location (inLexique COMMA_SOURCE_FILE_AT_LINE (106)) COMMA_HERE), var_cas_ss COMMA_SOURCE_FILE_AT_LINE (106)) ;
        }
      }
    }
  }else{
    var_cas_name.reader_location (inLexique COMMA_HERE).signalGGSSemanticError (inLexique, GGS_string ("Task does not have a PARAMETER-VALUES element") COMMA_SOURCE_FILE_AT_LINE (111)) ;
  }
  var_cas_node = function_elem_named (inLexique, var_cas_cont_elems, GGS_string ("SUB-CONTAINERS") COMMA_SOURCE_FILE_AT_LINE (112)) ;
  GGS_xmlNodeList  var_cas_nl ;
  var_cas_nl = var_cas_node.reader_nodeList (inLexique COMMA_SOURCE_FILE_AT_LINE (113)) ;
  {
    GGS_xmlNodeList::cEnumerator enumerator_3452 (var_cas_nl, true) ;
    const GGS_xmlNodeList::cElement * operand_3452 = NULL ;
    while (((operand_3452 = enumerator_3452.nextObject ()))) {
      macroValidPointer (operand_3452) ;
      ::routine_parse_task_subcontainer (inLexique,  operand_3452->node.reader_nodeList (inLexique COMMA_SOURCE_FILE_AT_LINE (115)),  var_cas_name,  var_cas_t COMMA_SOURCE_FILE_AT_LINE (115)) ;
    }
  }
  GGS_task_map  var_cas_tm ;
  var_cas_tm = var_cas_cpu.reader_tasks (inLexique COMMA_SOURCE_FILE_AT_LINE (117)) ;
  var_cas_tm.modifier_put (inLexique, var_cas_name, var_cas_t COMMA_SOURCE_FILE_AT_LINE (118)) ;
  var_cas_cpu.modifier_setTasks (inLexique, var_cas_tm COMMA_SOURCE_FILE_AT_LINE (119)) ;
  #ifdef DEBUG_TRACE_ENABLED
    printf ("LEAVE routine_parse_task\n") ;
  #endif
}

//---------------------------------------------------------------------------*

