//---------------------------------------------------------------------------*
//                                                                           *
//                         File 'tasks_config.cpp'                           *
//                        Generated by version 1.9.7                         *
//                     december 17th, 2009, at 9h55'30"                      *
//                                                                           *
//---------------------------------------------------------------------------*

//--- START OF USER ZONE 1


//--- END OF USER ZONE 1

//---------------------------------------------------------------------------*

#include "version_libpm.h"
#if LIBPM_VERSION != 629
  #error "This file has been compiled with a version of GALGAS different than the version of libpm"
#endif

//---------------------------------------------------------------------------*

#include <typeinfo>
#include "utilities/MF_MemoryControl.h"
#include "files/C_TextFileWrite.h"
#include "galgas/C_galgas_CLI_Options.h"
#include "tasks_config.h"

//---------------------------------------------------------------------------*

#ifndef DO_NOT_GENERATE_CHECKINGS
  #define SOURCE_FILE_AT_LINE(line) "tasks_config.ggs", line
  #define COMMA_SOURCE_FILE_AT_LINE(line) , SOURCE_FILE_AT_LINE(line)
#else
  #define SOURCE_FILE_AT_LINE(line) 
  #define COMMA_SOURCE_FILE_AT_LINE(line) 
#endif


//--- START OF USER ZONE 2


//--- END OF USER ZONE 2

//---------------------------------------------------------------------------*
//                                                                           *
//           Implementation of routine "setAppRelatedAttributes"             *
//                                                                           *
//---------------------------------------------------------------------------*

void routine_setAppRelatedAttributes (C_Compiler & inLexique,
                                GGS_goilTemplateFieldMap  & var_cas_fieldMap,
                                const GGS_root_obj   var_cas_cpu,
                                const GGS_string_map   var_cas_appForObj,
                                const GGS_lstring   var_cas_objName COMMA_UNUSED_LOCATION_ARGS) {
  #ifdef DEBUG_TRACE_ENABLED
    printf ("ENTER routine_setAppRelatedAttributes at %s:%d\n", __FILE__, __LINE__) ;
  #endif
  const GGS_bool cond_1836 = gOption_goil_5F_options_autosar_5F_on.reader_value () ;
  if (cond_1836.isBuiltAndTrue ()) {
    const GGS_bool cond_1826 = (var_cas_appForObj.reader_count ()).operator_strictSup (GGS_uint (0U)) ;
    if (cond_1826.isBuiltAndTrue ()) {
      GGS_bool var_cas_trustedApp = GGS_bool (false) ;
      GGS_string var_cas_appName ;
      const GGS_string_map  temp_1347 = var_cas_appForObj ;
      if (temp_1347.isBuilt ()) {
        temp_1347 (HERE)->method_get (inLexique, var_cas_objName, var_cas_appName COMMA_SOURCE_FILE_AT_LINE (51)) ;
      }
      ::routine_addStringFieldValue (inLexique,  var_cas_fieldMap,  GGS_lstring ::constructor_new (inLexique, GGS_string ("APPLICATION"), GGS_location (inLexique) COMMA_HERE),  var_cas_appName COMMA_SOURCE_FILE_AT_LINE (52)) ;
      GGS_app_obj  var_cas_app ;
      const GGS_app_map  temp_1596 = var_cas_cpu.reader_applis (inLexique COMMA_SOURCE_FILE_AT_LINE (57)) ;
      if (temp_1596.isBuilt ()) {
        temp_1596 (HERE)->method_get (inLexique, GGS_lstring ::constructor_new (inLexique, var_cas_appName, GGS_location (inLexique) COMMA_HERE), var_cas_app COMMA_SOURCE_FILE_AT_LINE (57)) ;
      }
      { const GGS_app_trusted_obj _var_1731 = var_cas_app.reader_trusted (inLexique COMMA_SOURCE_FILE_AT_LINE (58)) ; // CAST instruction
        if (_var_1731.getPtr () != NULL) {
          macroValidPointer (_var_1731.getPtr ()) ;
          if (typeid (cPtr_app_trusted_true) == typeid (* (_var_1731.getPtr ()))) {
            var_cas_trustedApp = GGS_bool (true) ;
          }else{
          }
        }
      }
      ::routine_addBoolFieldValue (inLexique,  var_cas_fieldMap,  GGS_lstring ::constructor_new (inLexique, GGS_string ("TRUSTED"), GGS_location (inLexique) COMMA_HERE),  var_cas_trustedApp COMMA_SOURCE_FILE_AT_LINE (61)) ;
    }
  }
  #ifdef DEBUG_TRACE_ENABLED
    printf ("LEAVE routine_setAppRelatedAttributes\n") ;
  #endif
}

//---------------------------------------------------------------------------*
//                                                                           *
//               Implementation of routine "computeTaskList"                 *
//                                                                           *
//---------------------------------------------------------------------------*

void routine_computeTaskList (C_Compiler & inLexique,
                                const GGS_root_obj   var_cas_cpu,
                                const GGS_prio_map   var_cas_actualPriorities,
                                const GGS_string_map   var_cas_appForObj,
                                GGS_goilTemplateFieldMapList  & var_cas_taskList COMMA_UNUSED_LOCATION_ARGS) {
  #ifdef DEBUG_TRACE_ENABLED
    printf ("ENTER routine_computeTaskList at %s:%d\n", __FILE__, __LINE__) ;
  #endif
  GGS_tasks_by_type  var_cas_sTasks = GGS_tasks_by_type ::constructor_emptySortedList () ;
  {
    GGS_task_map::cEnumerator enumerator_2151 (var_cas_cpu.reader_tasks (inLexique COMMA_SOURCE_FILE_AT_LINE (77)), true) ;
    const GGS_task_map::cElement * operand_2151 = NULL ;
    while (((operand_2151 = enumerator_2151.nextObject ()))) {
      macroValidPointer (operand_2151) ;
      const GGS_bool cond_2246 = (operand_2151->mInfo.task.reader_events (inLexique COMMA_SOURCE_FILE_AT_LINE (78)).reader_length ()).operator_strictSup (GGS_uint (0U)) ;
      if (cond_2246.isBuiltAndTrue ()) {
        var_cas_sTasks.addAssign_operation (GGS_uint (0U), operand_2151->mKey.reader_string (inLexique COMMA_SOURCE_FILE_AT_LINE (79))) ;
      }else if (cond_2246.isBuiltAndFalse ()) {
        var_cas_sTasks.addAssign_operation (GGS_uint (1U), operand_2151->mKey.reader_string (inLexique COMMA_SOURCE_FILE_AT_LINE (81))) ;
      }
    }
  }
  {
    GGS_tasks_by_type::cEnumerator enumerator_2327 (var_cas_sTasks, true) ;
    const GGS_tasks_by_type::cElement * operand_2327 = NULL ;
    while (((operand_2327 = enumerator_2327.nextObject ()))) {
      macroValidPointer (operand_2327) ;
      GGS_task_obj  var_cas_task ;
      GGS_lstring  var_cas_taskName = GGS_lstring ::constructor_new (inLexique, operand_2327->name, GGS_location (inLexique) COMMA_HERE) ;
      const GGS_task_map  temp_2424 = var_cas_cpu.reader_tasks (inLexique COMMA_SOURCE_FILE_AT_LINE (88)) ;
      if (temp_2424.isBuilt ()) {
        temp_2424 (HERE)->method_get (inLexique, var_cas_taskName, var_cas_task COMMA_SOURCE_FILE_AT_LINE (88)) ;
      }
      GGS_goilTemplateFieldMap  var_cas_fieldMap = GGS_goilTemplateFieldMap ::constructor_emptyMap (inLexique COMMA_HERE) ;
      ::routine_addStringFieldValue (inLexique,  var_cas_fieldMap,  GGS_lstring ::constructor_new (inLexique, GGS_string ("NAME"), GGS_location (inLexique) COMMA_HERE),  operand_2327->name COMMA_SOURCE_FILE_AT_LINE (90)) ;
      ::routine_addStringFieldValue (inLexique,  var_cas_fieldMap,  GGS_lstring ::constructor_new (inLexique, GGS_string ("PROCESSKIND"), GGS_location (inLexique) COMMA_HERE),  GGS_string ("Task") COMMA_SOURCE_FILE_AT_LINE (91)) ;
      ::routine_addBoolFieldValue (inLexique,  var_cas_fieldMap,  GGS_lstring ::constructor_new (inLexique, GGS_string ("EXTENDEDTASK"), GGS_location (inLexique) COMMA_HERE),  (operand_2327->type).operator_isEqual (GGS_uint (0U)) COMMA_SOURCE_FILE_AT_LINE (92)) ;
      ::routine_addBoolFieldValue (inLexique,  var_cas_fieldMap,  GGS_lstring ::constructor_new (inLexique, GGS_string ("NONPREEMPTABLE"), GGS_location (inLexique) COMMA_HERE),  (var_cas_task.reader_schedule (inLexique COMMA_SOURCE_FILE_AT_LINE (93)).reader_string (inLexique COMMA_SOURCE_FILE_AT_LINE (93))).operator_isEqual (GGS_string ("NON")) COMMA_SOURCE_FILE_AT_LINE (93)) ;
      GGS_uint  var_cas_actualPrio ;
      GGS_uint  var_cas_activation ;
      const GGS_prio_map  temp_2906 = var_cas_actualPriorities ;
      if (temp_2906.isBuilt ()) {
        temp_2906 (HERE)->method_get (inLexique, var_cas_taskName, var_cas_actualPrio, var_cas_activation COMMA_SOURCE_FILE_AT_LINE (96)) ;
      }
      ::routine_addUnsignedFieldValue (inLexique,  var_cas_fieldMap,  GGS_lstring ::constructor_new (inLexique, GGS_string ("PRIORITY"), GGS_location (inLexique) COMMA_HERE),  var_cas_actualPrio.reader_uint64 (inLexique COMMA_SOURCE_FILE_AT_LINE (97)) COMMA_SOURCE_FILE_AT_LINE (97)) ;
      ::routine_addUnsignedFieldValue (inLexique,  var_cas_fieldMap,  GGS_lstring ::constructor_new (inLexique, GGS_string ("ACTIVATION"), GGS_location (inLexique) COMMA_HERE),  var_cas_activation.reader_uint64 (inLexique COMMA_SOURCE_FILE_AT_LINE (98)) COMMA_SOURCE_FILE_AT_LINE (98)) ;
      { const GGS_task_autostart_obj _var_3496 = var_cas_task.reader_autostart (inLexique COMMA_SOURCE_FILE_AT_LINE (100)) ; // CAST instruction
        if (_var_3496.getPtr () != NULL) {
          macroValidPointer (_var_3496.getPtr ()) ;
          if (typeid (cPtr_task_autostart_true) == typeid (* (_var_3496.getPtr ()))) {
            ::routine_addBoolFieldValue (inLexique,  var_cas_fieldMap,  GGS_lstring ::constructor_new (inLexique, GGS_string ("AUTOSTART"), GGS_location (inLexique) COMMA_HERE),  GGS_bool (true) COMMA_SOURCE_FILE_AT_LINE (102)) ;
          }else if (typeid (cPtr_task_autostart_false) == typeid (* (_var_3496.getPtr ()))) {
            ::routine_addBoolFieldValue (inLexique,  var_cas_fieldMap,  GGS_lstring ::constructor_new (inLexique, GGS_string ("AUTOSTART"), GGS_location (inLexique) COMMA_HERE),  GGS_bool (false) COMMA_SOURCE_FILE_AT_LINE (104)) ;
          }else{
            var_cas_task.reader_autostart (inLexique COMMA_SOURCE_FILE_AT_LINE (106)).reader_location (inLexique COMMA_SOURCE_FILE_AT_LINE (106)).reader_location (inLexique COMMA_HERE).signalGGSSemanticError (inLexique, GGS_string ("internal error, AUTOSTART type is undefined") COMMA_SOURCE_FILE_AT_LINE (107)) ;
          }
        }
      }
      const GGS_bool cond_4385 = (var_cas_task.reader_schedule (inLexique COMMA_SOURCE_FILE_AT_LINE (108)).reader_string (inLexique COMMA_SOURCE_FILE_AT_LINE (108))).operator_isEqual (GGS_string ("FULL")) ;
      if (cond_4385.isBuiltAndTrue ()) {
        GGS_bool var_cas_internalFound = GGS_bool (false) ;
        {
          GGS_lstringlist::cEnumerator enumerator_3601 (var_cas_task.reader_resources (inLexique COMMA_SOURCE_FILE_AT_LINE (110)), true) ;
          const GGS_lstringlist::cElement * operand_3601 = NULL ;
          while (((operand_3601 = enumerator_3601.nextObject ()))) {
            macroValidPointer (operand_3601) ;
            const GGS_bool cond_4131 = (var_cas_internalFound).operator_not () ;
            if (cond_4131.isBuiltAndTrue ()) {
              GGS_resource_obj  var_cas_resource ;
              const GGS_resource_map  temp_3742 = var_cas_cpu.reader_resources (inLexique COMMA_SOURCE_FILE_AT_LINE (113)) ;
              if (temp_3742.isBuilt ()) {
                temp_3742 (HERE)->method_get (inLexique, operand_3601->mValue, var_cas_resource COMMA_SOURCE_FILE_AT_LINE (113)) ;
              }
              { const GGS_resource_property_obj _var_4113 = var_cas_resource.reader_property (inLexique COMMA_SOURCE_FILE_AT_LINE (114)) ; // CAST instruction
                if (_var_4113.getPtr () != NULL) {
                  macroValidPointer (_var_4113.getPtr ()) ;
                  if (typeid (cPtr_resource_property_internal_obj) == typeid (* (_var_4113.getPtr ()))) {
                    var_cas_internalFound = GGS_bool (true) ;
                    ::routine_addStringFieldValue (inLexique,  var_cas_fieldMap,  GGS_lstring ::constructor_new (inLexique, GGS_string ("INTERNALRESOURCE"), GGS_location (inLexique) COMMA_HERE),  operand_3601->mValue.reader_string (inLexique COMMA_SOURCE_FILE_AT_LINE (117)) COMMA_SOURCE_FILE_AT_LINE (117)) ;
                    ::routine_addBoolFieldValue (inLexique,  var_cas_fieldMap,  GGS_lstring ::constructor_new (inLexique, GGS_string ("USEINTERNALRESOURCE"), GGS_location (inLexique) COMMA_HERE),  GGS_bool (true) COMMA_SOURCE_FILE_AT_LINE (118)) ;
                  }else{
                  }
                }
              }
            }
          }
        }
        const GGS_bool cond_4372 = (var_cas_internalFound).operator_not () ;
        if (cond_4372.isBuiltAndTrue ()) {
          ::routine_addStringFieldValue (inLexique,  var_cas_fieldMap,  GGS_lstring ::constructor_new (inLexique, GGS_string ("INTERNALRESOURCE"), GGS_location (inLexique) COMMA_HERE),  GGS_string ("") COMMA_SOURCE_FILE_AT_LINE (123)) ;
          ::routine_addBoolFieldValue (inLexique,  var_cas_fieldMap,  GGS_lstring ::constructor_new (inLexique, GGS_string ("USEINTERNALRESOURCE"), GGS_location (inLexique) COMMA_HERE),  GGS_bool (false) COMMA_SOURCE_FILE_AT_LINE (124)) ;
        }
      }else if (cond_4385.isBuiltAndFalse ()) {
        ::routine_addStringFieldValue (inLexique,  var_cas_fieldMap,  GGS_lstring ::constructor_new (inLexique, GGS_string ("INTERNALRESOURCE"), GGS_location (inLexique) COMMA_HERE),  GGS_string ("") COMMA_SOURCE_FILE_AT_LINE (127)) ;
        ::routine_addBoolFieldValue (inLexique,  var_cas_fieldMap,  GGS_lstring ::constructor_new (inLexique, GGS_string ("USEINTERNALRESOURCE"), GGS_location (inLexique) COMMA_HERE),  GGS_bool (false) COMMA_SOURCE_FILE_AT_LINE (128)) ;
      }
      GGS_goilTemplateFieldMapList  var_cas_resourceList = GGS_goilTemplateFieldMapList ::constructor_emptyList () ;
      {
        GGS_lstringlist::cEnumerator enumerator_4644 (var_cas_task.reader_resources (inLexique COMMA_SOURCE_FILE_AT_LINE (132)), true) ;
        const GGS_lstringlist::cElement * operand_4644 = NULL ;
        while (((operand_4644 = enumerator_4644.nextObject ()))) {
          macroValidPointer (operand_4644) ;
          GGS_resource_obj  var_cas_resource ;
          const GGS_resource_map  temp_4743 = var_cas_cpu.reader_resources (inLexique COMMA_SOURCE_FILE_AT_LINE (134)) ;
          if (temp_4743.isBuilt ()) {
            temp_4743 (HERE)->method_get (inLexique, operand_4644->mValue, var_cas_resource COMMA_SOURCE_FILE_AT_LINE (134)) ;
          }
          { const GGS_resource_property_obj _var_5082 = var_cas_resource.reader_property (inLexique COMMA_SOURCE_FILE_AT_LINE (135)) ; // CAST instruction
            if (_var_5082.getPtr () != NULL) {
              macroValidPointer (_var_5082.getPtr ()) ;
              if (typeid (cPtr_resource_property_internal_obj) == typeid (* (_var_5082.getPtr ()))) {
              }else{
                GGS_goilTemplateFieldMap  var_cas_resourceFieldMap = GGS_goilTemplateFieldMap ::constructor_emptyMap (inLexique COMMA_HERE) ;
                ::routine_addStringFieldValue (inLexique,  var_cas_resourceFieldMap,  GGS_lstring ::constructor_new (inLexique, GGS_string ("RESOURCENAME"), GGS_location (inLexique) COMMA_HERE),  operand_4644->mValue.reader_string (inLexique COMMA_SOURCE_FILE_AT_LINE (139)) COMMA_SOURCE_FILE_AT_LINE (139)) ;
                var_cas_resourceList.addAssign_operation (var_cas_resourceFieldMap) ;
              }
            }
          }
        }
      }
      ::routine_addListFieldValue (inLexique,  var_cas_fieldMap,  GGS_lstring ::constructor_new (inLexique, GGS_string ("RESOURCES"), GGS_location (inLexique) COMMA_HERE),  var_cas_resourceList COMMA_SOURCE_FILE_AT_LINE (143)) ;
      ::routine_setAppRelatedAttributes (inLexique,  var_cas_fieldMap,  var_cas_cpu,  var_cas_appForObj,  var_cas_taskName COMMA_SOURCE_FILE_AT_LINE (145)) ;
      var_cas_taskList.addAssign_operation (var_cas_fieldMap) ;
    }
  }
  #ifdef DEBUG_TRACE_ENABLED
    printf ("LEAVE routine_computeTaskList\n") ;
  #endif
}

//---------------------------------------------------------------------------*
//                                                                           *
//                Implementation of routine "computeISRList"                 *
//                                                                           *
//---------------------------------------------------------------------------*

void routine_computeISRList (C_Compiler & inLexique,
                                const GGS_root_obj   var_cas_cpu,
                                const GGS_prio_map   var_cas_actualPriorities,
                                const GGS_string_map   var_cas_appForObj,
                                const GGS_uint64   var_cas_isrCategory,
                                GGS_goilTemplateFieldMapList  & var_cas_isrList COMMA_UNUSED_LOCATION_ARGS) {
  #ifdef DEBUG_TRACE_ENABLED
    printf ("ENTER routine_computeISRList at %s:%d\n", __FILE__, __LINE__) ;
  #endif
  {
    GGS_isr_map::cEnumerator enumerator_5535 (var_cas_cpu.reader_isrs (inLexique COMMA_SOURCE_FILE_AT_LINE (161)), true) ;
    const GGS_isr_map::cElement * operand_5535 = NULL ;
    while (((operand_5535 = enumerator_5535.nextObject ()))) {
      macroValidPointer (operand_5535) ;
      { const GGS_basic_type _var_7061 = operand_5535->mInfo.isr.reader_category (inLexique COMMA_SOURCE_FILE_AT_LINE (162)) ; // CAST instruction
        if (_var_7061.getPtr () != NULL) {
          macroValidPointer (_var_7061.getPtr ()) ;
          if (typeid (cPtr_uint64_class) == typeid (* (_var_7061.getPtr ()))) {
            const GGS_uint64_class var_cas_category (_var_7061.getPtr ()) ;
            const GGS_bool cond_7044 = (var_cas_category.reader_value (inLexique COMMA_SOURCE_FILE_AT_LINE (164))).operator_isEqual (var_cas_isrCategory) ;
            if (cond_7044.isBuiltAndTrue ()) {
              GGS_goilTemplateFieldMap  var_cas_fieldMap = GGS_goilTemplateFieldMap ::constructor_emptyMap (inLexique COMMA_HERE) ;
              ::routine_addStringFieldValue (inLexique,  var_cas_fieldMap,  GGS_lstring ::constructor_new (inLexique, GGS_string ("NAME"), GGS_location (inLexique) COMMA_HERE),  operand_5535->mKey.reader_string (inLexique COMMA_SOURCE_FILE_AT_LINE (166)) COMMA_SOURCE_FILE_AT_LINE (166)) ;
              ::routine_addStringFieldValue (inLexique,  var_cas_fieldMap,  GGS_lstring ::constructor_new (inLexique, GGS_string ("PROCESSKIND"), GGS_location (inLexique) COMMA_HERE),  GGS_string ("ISR") COMMA_SOURCE_FILE_AT_LINE (167)) ;
              ::routine_addBoolFieldValue (inLexique,  var_cas_fieldMap,  GGS_lstring ::constructor_new (inLexique, GGS_string ("EXTENDEDTASK"), GGS_location (inLexique) COMMA_HERE),  GGS_bool (false) COMMA_SOURCE_FILE_AT_LINE (168)) ;
              GGS_uint  var_cas_actualPrio ;
              GGS_uint  var_cas_activation ;
              const GGS_prio_map  temp_6042 = var_cas_actualPriorities ;
              if (temp_6042.isBuilt ()) {
                temp_6042 (HERE)->method_get (inLexique, operand_5535->mKey, var_cas_actualPrio, var_cas_activation COMMA_SOURCE_FILE_AT_LINE (171)) ;
              }
              ::routine_addUnsignedFieldValue (inLexique,  var_cas_fieldMap,  GGS_lstring ::constructor_new (inLexique, GGS_string ("PRIORITY"), GGS_location (inLexique) COMMA_HERE),  var_cas_actualPrio.reader_uint64 (inLexique COMMA_SOURCE_FILE_AT_LINE (172)) COMMA_SOURCE_FILE_AT_LINE (172)) ;
              ::routine_addUnsignedFieldValue (inLexique,  var_cas_fieldMap,  GGS_lstring ::constructor_new (inLexique, GGS_string ("ACTIVATION"), GGS_location (inLexique) COMMA_HERE),  var_cas_activation.reader_uint64 (inLexique COMMA_SOURCE_FILE_AT_LINE (173)) COMMA_SOURCE_FILE_AT_LINE (173)) ;
              GGS_goilTemplateFieldMapList  var_cas_resourceList = GGS_goilTemplateFieldMapList ::constructor_emptyList () ;
              {
                GGS_lstringlist::cEnumerator enumerator_6348 (operand_5535->mInfo.isr.reader_resources (inLexique COMMA_SOURCE_FILE_AT_LINE (176)), true) ;
                const GGS_lstringlist::cElement * operand_6348 = NULL ;
                while (((operand_6348 = enumerator_6348.nextObject ()))) {
                  macroValidPointer (operand_6348) ;
                  GGS_resource_obj  var_cas_resource ;
                  const GGS_resource_map  temp_6454 = var_cas_cpu.reader_resources (inLexique COMMA_SOURCE_FILE_AT_LINE (178)) ;
                  if (temp_6454.isBuilt ()) {
                    temp_6454 (HERE)->method_get (inLexique, operand_6348->mValue, var_cas_resource COMMA_SOURCE_FILE_AT_LINE (178)) ;
                  }
                  { const GGS_resource_property_obj _var_6821 = var_cas_resource.reader_property (inLexique COMMA_SOURCE_FILE_AT_LINE (179)) ; // CAST instruction
                    if (_var_6821.getPtr () != NULL) {
                      macroValidPointer (_var_6821.getPtr ()) ;
                      if (typeid (cPtr_resource_property_internal_obj) == typeid (* (_var_6821.getPtr ()))) {
                      }else{
                        GGS_goilTemplateFieldMap  var_cas_resourceFieldMap = GGS_goilTemplateFieldMap ::constructor_emptyMap (inLexique COMMA_HERE) ;
                        ::routine_addStringFieldValue (inLexique,  var_cas_resourceFieldMap,  GGS_lstring ::constructor_new (inLexique, GGS_string ("RESOURCENAME"), GGS_location (inLexique) COMMA_HERE),  operand_6348->mValue.reader_string (inLexique COMMA_SOURCE_FILE_AT_LINE (183)) COMMA_SOURCE_FILE_AT_LINE (183)) ;
                        var_cas_resourceList.addAssign_operation (var_cas_resourceFieldMap) ;
                      }
                    }
                  }
                }
              }
              ::routine_addListFieldValue (inLexique,  var_cas_fieldMap,  GGS_lstring ::constructor_new (inLexique, GGS_string ("RESOURCES"), GGS_location (inLexique) COMMA_HERE),  var_cas_resourceList COMMA_SOURCE_FILE_AT_LINE (187)) ;
              ::routine_setAppRelatedAttributes (inLexique,  var_cas_fieldMap,  var_cas_cpu,  var_cas_appForObj,  operand_5535->mKey COMMA_SOURCE_FILE_AT_LINE (189)) ;
              var_cas_isrList.addAssign_operation (var_cas_fieldMap) ;
            }
          }else{
          }
        }
      }
    }
  }
  #ifdef DEBUG_TRACE_ENABLED
    printf ("LEAVE routine_computeISRList\n") ;
  #endif
}

//---------------------------------------------------------------------------*
//                                                                           *
//                 Implementation of routine "setTasksList"                  *
//                                                                           *
//---------------------------------------------------------------------------*

void routine_setTasksList (C_Compiler & inLexique,
                                const GGS_root_obj   var_cas_cpu,
                                const GGS_prio_map   var_cas_actualPriorities,
                                const GGS_string_map   var_cas_appForObj,
                                GGS_goilTemplateVariableMap  & var_cas_cfg COMMA_UNUSED_LOCATION_ARGS) {
  #ifdef DEBUG_TRACE_ENABLED
    printf ("ENTER routine_setTasksList at %s:%d\n", __FILE__, __LINE__) ;
  #endif
  GGS_goilTemplateFieldMapList  var_cas_taskList = GGS_goilTemplateFieldMapList ::constructor_emptyList () ;
  ::routine_computeTaskList (inLexique,  var_cas_cpu,  var_cas_actualPriorities,  var_cas_appForObj,  var_cas_taskList COMMA_SOURCE_FILE_AT_LINE (207)) ;
  ::routine_addListValue (inLexique,  var_cas_cfg,  GGS_lstring ::constructor_new (inLexique, GGS_string ("TASKS"), GGS_location (inLexique) COMMA_HERE),  var_cas_taskList COMMA_SOURCE_FILE_AT_LINE (208)) ;
  #ifdef DEBUG_TRACE_ENABLED
    printf ("LEAVE routine_setTasksList\n") ;
  #endif
}

//---------------------------------------------------------------------------*
//                                                                           *
//                 Implementation of routine "setISRs1List"                  *
//                                                                           *
//---------------------------------------------------------------------------*

void routine_setISRs1List (C_Compiler & inLexique,
                                const GGS_root_obj   var_cas_cpu,
                                const GGS_prio_map   var_cas_actualPriorities,
                                const GGS_string_map   var_cas_appForObj,
                                GGS_goilTemplateVariableMap  & var_cas_cfg COMMA_UNUSED_LOCATION_ARGS) {
  #ifdef DEBUG_TRACE_ENABLED
    printf ("ENTER routine_setISRs1List at %s:%d\n", __FILE__, __LINE__) ;
  #endif
  GGS_goilTemplateFieldMapList  var_cas_isrList = GGS_goilTemplateFieldMapList ::constructor_emptyList () ;
  ::routine_computeISRList (inLexique,  var_cas_cpu,  var_cas_actualPriorities,  var_cas_appForObj,  GGS_uint64 (1ULL),  var_cas_isrList COMMA_SOURCE_FILE_AT_LINE (221)) ;
  ::routine_addListValue (inLexique,  var_cas_cfg,  GGS_lstring ::constructor_new (inLexique, GGS_string ("ISRS1"), GGS_location (inLexique) COMMA_HERE),  var_cas_isrList COMMA_SOURCE_FILE_AT_LINE (222)) ;
  #ifdef DEBUG_TRACE_ENABLED
    printf ("LEAVE routine_setISRs1List\n") ;
  #endif
}

//---------------------------------------------------------------------------*
//                                                                           *
//                 Implementation of routine "setISRs2List"                  *
//                                                                           *
//---------------------------------------------------------------------------*

void routine_setISRs2List (C_Compiler & inLexique,
                                const GGS_root_obj   var_cas_cpu,
                                const GGS_prio_map   var_cas_actualPriorities,
                                const GGS_string_map   var_cas_appForObj,
                                GGS_goilTemplateVariableMap  & var_cas_cfg COMMA_UNUSED_LOCATION_ARGS) {
  #ifdef DEBUG_TRACE_ENABLED
    printf ("ENTER routine_setISRs2List at %s:%d\n", __FILE__, __LINE__) ;
  #endif
  GGS_goilTemplateFieldMapList  var_cas_isrList = GGS_goilTemplateFieldMapList ::constructor_emptyList () ;
  ::routine_computeISRList (inLexique,  var_cas_cpu,  var_cas_actualPriorities,  var_cas_appForObj,  GGS_uint64 (2ULL),  var_cas_isrList COMMA_SOURCE_FILE_AT_LINE (235)) ;
  ::routine_addListValue (inLexique,  var_cas_cfg,  GGS_lstring ::constructor_new (inLexique, GGS_string ("ISRS2"), GGS_location (inLexique) COMMA_HERE),  var_cas_isrList COMMA_SOURCE_FILE_AT_LINE (236)) ;
  #ifdef DEBUG_TRACE_ENABLED
    printf ("LEAVE routine_setISRs2List\n") ;
  #endif
}

//---------------------------------------------------------------------------*
//                                                                           *
//               Implementation of routine "setProcessesList"                *
//                                                                           *
//---------------------------------------------------------------------------*

void routine_setProcessesList (C_Compiler & inLexique,
                                const GGS_root_obj   var_cas_cpu,
                                const GGS_prio_map   var_cas_actualPriorities,
                                const GGS_string_map   var_cas_appForObj,
                                GGS_goilTemplateVariableMap  & var_cas_cfg COMMA_UNUSED_LOCATION_ARGS) {
  #ifdef DEBUG_TRACE_ENABLED
    printf ("ENTER routine_setProcessesList at %s:%d\n", __FILE__, __LINE__) ;
  #endif
  GGS_goilTemplateFieldMapList  var_cas_processesList = GGS_goilTemplateFieldMapList ::constructor_emptyList () ;
  ::routine_computeTaskList (inLexique,  var_cas_cpu,  var_cas_actualPriorities,  var_cas_appForObj,  var_cas_processesList COMMA_SOURCE_FILE_AT_LINE (249)) ;
  ::routine_computeISRList (inLexique,  var_cas_cpu,  var_cas_actualPriorities,  var_cas_appForObj,  GGS_uint64 (2ULL),  var_cas_processesList COMMA_SOURCE_FILE_AT_LINE (250)) ;
  ::routine_addListValue (inLexique,  var_cas_cfg,  function_lstringWith (inLexique, GGS_string ("PROCESSES") COMMA_SOURCE_FILE_AT_LINE (251)),  var_cas_processesList COMMA_SOURCE_FILE_AT_LINE (251)) ;
  #ifdef DEBUG_TRACE_ENABLED
    printf ("LEAVE routine_setProcessesList\n") ;
  #endif
}

//---------------------------------------------------------------------------*
//                                                                           *
//               Implementation of routine "setCountersList"                 *
//                                                                           *
//---------------------------------------------------------------------------*

void routine_setCountersList (C_Compiler & inLexique,
                                const GGS_root_obj   var_cas_cpu,
                                const GGS_string_map   var_cas_appForObj,
                                GGS_goilTemplateVariableMap  & var_cas_cfg COMMA_UNUSED_LOCATION_ARGS) {
  #ifdef DEBUG_TRACE_ENABLED
    printf ("ENTER routine_setCountersList at %s:%d\n", __FILE__, __LINE__) ;
  #endif
  GGS_goilTemplateFieldMapList  var_cas_countersList = GGS_goilTemplateFieldMapList ::constructor_emptyList () ;
  {
    GGS_counter_map::cEnumerator enumerator_8908 (var_cas_cpu.reader_counters (inLexique COMMA_SOURCE_FILE_AT_LINE (263)), true) ;
    const GGS_counter_map::cElement * operand_8908 = NULL ;
    while (((operand_8908 = enumerator_8908.nextObject ()))) {
      macroValidPointer (operand_8908) ;
      GGS_goilTemplateFieldMap  var_cas_fieldMap = GGS_goilTemplateFieldMap ::constructor_emptyMap (inLexique COMMA_HERE) ;
      ::routine_addStringFieldValue (inLexique,  var_cas_fieldMap,  function_lstringWith (inLexique, GGS_string ("NAME") COMMA_SOURCE_FILE_AT_LINE (265)),  operand_8908->mKey.reader_string (inLexique COMMA_SOURCE_FILE_AT_LINE (265)) COMMA_SOURCE_FILE_AT_LINE (265)) ;
      ::routine_addUnsignedFieldValue (inLexique,  var_cas_fieldMap,  function_lstringWith (inLexique, GGS_string ("MAXALLOWEDVALUE") COMMA_SOURCE_FILE_AT_LINE (266)),  function_maxAllowedValue (inLexique, operand_8908->mInfo.counter COMMA_SOURCE_FILE_AT_LINE (266)) COMMA_SOURCE_FILE_AT_LINE (266)) ;
      ::routine_addUnsignedFieldValue (inLexique,  var_cas_fieldMap,  function_lstringWith (inLexique, GGS_string ("MINCYCLE") COMMA_SOURCE_FILE_AT_LINE (267)),  function_minCycle (inLexique, operand_8908->mInfo.counter COMMA_SOURCE_FILE_AT_LINE (267)) COMMA_SOURCE_FILE_AT_LINE (267)) ;
      ::routine_addUnsignedFieldValue (inLexique,  var_cas_fieldMap,  function_lstringWith (inLexique, GGS_string ("TICKSPERBASE") COMMA_SOURCE_FILE_AT_LINE (268)),  function_ticksPerBase (inLexique, operand_8908->mInfo.counter COMMA_SOURCE_FILE_AT_LINE (268)) COMMA_SOURCE_FILE_AT_LINE (268)) ;
      GGS_string var_cas_type = GGS_string ("HARDWARE_COUNTER") ;
      { const GGS_counter_type _var_9456 = operand_8908->mInfo.counter.reader_type (inLexique COMMA_SOURCE_FILE_AT_LINE (270)) ; // CAST instruction
        if (_var_9456.getPtr () != NULL) {
          macroValidPointer (_var_9456.getPtr ()) ;
          if (typeid (cPtr_software_counter) == typeid (* (_var_9456.getPtr ()))) {
            var_cas_type = GGS_string ("SOFTWARE_COUNTER") ;
          }else{
          }
        }
      }
      ::routine_addStringFieldValue (inLexique,  var_cas_fieldMap,  function_lstringWith (inLexique, GGS_string ("TYPE") COMMA_SOURCE_FILE_AT_LINE (273)),  var_cas_type COMMA_SOURCE_FILE_AT_LINE (273)) ;
      const GGS_bool cond_9642 = (operand_8908->mKey.reader_string (inLexique COMMA_SOURCE_FILE_AT_LINE (275))).operator_isNotEqual (GGS_string ("SystemCounter")) ;
      if (cond_9642.isBuiltAndTrue ()) {
        ::routine_setAppRelatedAttributes (inLexique,  var_cas_fieldMap,  var_cas_cpu,  var_cas_appForObj,  operand_8908->mKey COMMA_SOURCE_FILE_AT_LINE (276)) ;
      }
      var_cas_countersList.addAssign_operation (var_cas_fieldMap) ;
    }
  }
  ::routine_addListValue (inLexique,  var_cas_cfg,  function_lstringWith (inLexique, GGS_string ("COUNTERS") COMMA_SOURCE_FILE_AT_LINE (281)),  var_cas_countersList COMMA_SOURCE_FILE_AT_LINE (281)) ;
  #ifdef DEBUG_TRACE_ENABLED
    printf ("LEAVE routine_setCountersList\n") ;
  #endif
}

//---------------------------------------------------------------------------*
//                                                                           *
//                Implementation of routine "setEventsList"                  *
//                                                                           *
//---------------------------------------------------------------------------*

void routine_setEventsList (C_Compiler & inLexique,
                                const GGS_root_obj   var_cas_cpu,
                                GGS_goilTemplateVariableMap  & var_cas_cfg COMMA_UNUSED_LOCATION_ARGS) {
  #ifdef DEBUG_TRACE_ENABLED
    printf ("ENTER routine_setEventsList at %s:%d\n", __FILE__, __LINE__) ;
  #endif
  GGS_goilTemplateFieldMapList  var_cas_eventsList = GGS_goilTemplateFieldMapList ::constructor_emptyList () ;
  {
    GGS_event_map::cEnumerator enumerator_9951 (var_cas_cpu.reader_events (inLexique COMMA_SOURCE_FILE_AT_LINE (292)), true) ;
    const GGS_event_map::cElement * operand_9951 = NULL ;
    while (((operand_9951 = enumerator_9951.nextObject ()))) {
      macroValidPointer (operand_9951) ;
      GGS_goilTemplateFieldMap  var_cas_fieldMap = GGS_goilTemplateFieldMap ::constructor_emptyMap (inLexique COMMA_HERE) ;
      ::routine_addStringFieldValue (inLexique,  var_cas_fieldMap,  GGS_lstring ::constructor_new (inLexique, GGS_string ("NAME"), GGS_location (inLexique) COMMA_HERE),  operand_9951->mKey.reader_string (inLexique COMMA_SOURCE_FILE_AT_LINE (294)) COMMA_SOURCE_FILE_AT_LINE (294)) ;
      var_cas_eventsList.addAssign_operation (var_cas_fieldMap) ;
    }
  }
  ::routine_addListValue (inLexique,  var_cas_cfg,  GGS_lstring ::constructor_new (inLexique, GGS_string ("EVENTS"), GGS_location (inLexique) COMMA_HERE),  var_cas_eventsList COMMA_SOURCE_FILE_AT_LINE (297)) ;
  #ifdef DEBUG_TRACE_ENABLED
    printf ("LEAVE routine_setEventsList\n") ;
  #endif
}

//---------------------------------------------------------------------------*
//                                                                           *
//                Implementation of routine "setAlarmsList"                  *
//                                                                           *
//---------------------------------------------------------------------------*

void routine_setAlarmsList (C_Compiler & inLexique,
                                const GGS_root_obj   var_cas_cpu,
                                const GGS_string_map   var_cas_appForObj,
                                GGS_goilTemplateVariableMap  & var_cas_cfg COMMA_UNUSED_LOCATION_ARGS) {
  #ifdef DEBUG_TRACE_ENABLED
    printf ("ENTER routine_setAlarmsList at %s:%d\n", __FILE__, __LINE__) ;
  #endif
  GGS_goilTemplateFieldMapList  var_cas_alarmsList = GGS_goilTemplateFieldMapList ::constructor_emptyList () ;
  {
    GGS_alarm_map::cEnumerator enumerator_10424 (var_cas_cpu.reader_alarms (inLexique COMMA_SOURCE_FILE_AT_LINE (309)), true) ;
    const GGS_alarm_map::cElement * operand_10424 = NULL ;
    while (((operand_10424 = enumerator_10424.nextObject ()))) {
      macroValidPointer (operand_10424) ;
      GGS_goilTemplateFieldMap  var_cas_fieldMap = GGS_goilTemplateFieldMap ::constructor_emptyMap (inLexique COMMA_HERE) ;
      ::routine_addStringFieldValue (inLexique,  var_cas_fieldMap,  function_lstringWith (inLexique, GGS_string ("NAME") COMMA_SOURCE_FILE_AT_LINE (311)),  operand_10424->mKey.reader_string (inLexique COMMA_SOURCE_FILE_AT_LINE (311)) COMMA_SOURCE_FILE_AT_LINE (311)) ;
      ::routine_addStringFieldValue (inLexique,  var_cas_fieldMap,  function_lstringWith (inLexique, GGS_string ("COUNTER") COMMA_SOURCE_FILE_AT_LINE (312)),  operand_10424->mInfo.alarm.reader_counter_name (inLexique COMMA_SOURCE_FILE_AT_LINE (312)).reader_string (inLexique COMMA_SOURCE_FILE_AT_LINE (312)) COMMA_SOURCE_FILE_AT_LINE (312)) ;
      { const GGS_action_obj _var_11674 = operand_10424->mInfo.alarm.reader_action_params (inLexique COMMA_SOURCE_FILE_AT_LINE (314)) ; // CAST instruction
        if (_var_11674.getPtr () != NULL) {
          macroValidPointer (_var_11674.getPtr ()) ;
          if (typeid (cPtr_setevent_action) == typeid (* (_var_11674.getPtr ()))) {
            const GGS_setevent_action var_cas_setEvent (_var_11674.getPtr ()) ;
            ::routine_addStringFieldValue (inLexique,  var_cas_fieldMap,  function_lstringWith (inLexique, GGS_string ("ACTION") COMMA_SOURCE_FILE_AT_LINE (316)),  GGS_string ("setEvent") COMMA_SOURCE_FILE_AT_LINE (316)) ;
            ::routine_addStringFieldValue (inLexique,  var_cas_fieldMap,  function_lstringWith (inLexique, GGS_string ("TASK") COMMA_SOURCE_FILE_AT_LINE (317)),  var_cas_setEvent.reader_task_name (inLexique COMMA_SOURCE_FILE_AT_LINE (317)).reader_string (inLexique COMMA_SOURCE_FILE_AT_LINE (317)) COMMA_SOURCE_FILE_AT_LINE (317)) ;
            ::routine_addStringFieldValue (inLexique,  var_cas_fieldMap,  function_lstringWith (inLexique, GGS_string ("EVENT") COMMA_SOURCE_FILE_AT_LINE (318)),  var_cas_setEvent.reader_event_name (inLexique COMMA_SOURCE_FILE_AT_LINE (318)).reader_string (inLexique COMMA_SOURCE_FILE_AT_LINE (318)) COMMA_SOURCE_FILE_AT_LINE (318)) ;
          }else if (typeid (cPtr_activatetask_action) == typeid (* (_var_11674.getPtr ()))) {
            const GGS_activatetask_action var_cas_activateTask (_var_11674.getPtr ()) ;
            ::routine_addStringFieldValue (inLexique,  var_cas_fieldMap,  function_lstringWith (inLexique, GGS_string ("ACTION") COMMA_SOURCE_FILE_AT_LINE (320)),  GGS_string ("activateTask") COMMA_SOURCE_FILE_AT_LINE (320)) ;
            ::routine_addStringFieldValue (inLexique,  var_cas_fieldMap,  function_lstringWith (inLexique, GGS_string ("TASK") COMMA_SOURCE_FILE_AT_LINE (321)),  var_cas_activateTask.reader_task_name (inLexique COMMA_SOURCE_FILE_AT_LINE (321)).reader_string (inLexique COMMA_SOURCE_FILE_AT_LINE (321)) COMMA_SOURCE_FILE_AT_LINE (321)) ;
          }else if (typeid (cPtr_callback_action) == typeid (* (_var_11674.getPtr ()))) {
            const GGS_callback_action var_cas_callback (_var_11674.getPtr ()) ;
            ::routine_addStringFieldValue (inLexique,  var_cas_fieldMap,  function_lstringWith (inLexique, GGS_string ("ACTION") COMMA_SOURCE_FILE_AT_LINE (323)),  GGS_string ("callback") COMMA_SOURCE_FILE_AT_LINE (323)) ;
            ::routine_addStringFieldValue (inLexique,  var_cas_fieldMap,  function_lstringWith (inLexique, GGS_string ("FUNCTION") COMMA_SOURCE_FILE_AT_LINE (324)),  var_cas_callback.reader_function_name (inLexique COMMA_SOURCE_FILE_AT_LINE (324)).reader_string (inLexique COMMA_SOURCE_FILE_AT_LINE (324)) COMMA_SOURCE_FILE_AT_LINE (324)) ;
          }else if (typeid (cPtr_incrementcounter_action) == typeid (* (_var_11674.getPtr ()))) {
            const GGS_incrementcounter_action var_cas_incrementCounter (_var_11674.getPtr ()) ;
            ::routine_addStringFieldValue (inLexique,  var_cas_fieldMap,  function_lstringWith (inLexique, GGS_string ("ACTION") COMMA_SOURCE_FILE_AT_LINE (326)),  GGS_string ("incrementCounter") COMMA_SOURCE_FILE_AT_LINE (326)) ;
            ::routine_addStringFieldValue (inLexique,  var_cas_fieldMap,  function_lstringWith (inLexique, GGS_string ("COUNTER") COMMA_SOURCE_FILE_AT_LINE (327)),  var_cas_incrementCounter.reader_counter_name (inLexique COMMA_SOURCE_FILE_AT_LINE (327)).reader_string (inLexique COMMA_SOURCE_FILE_AT_LINE (327)) COMMA_SOURCE_FILE_AT_LINE (327)) ;
          }else{
          }
        }
      }
      { const GGS_autostart_obj _var_12633 = operand_10424->mInfo.alarm.reader_autostart_params (inLexique COMMA_SOURCE_FILE_AT_LINE (330)) ; // CAST instruction
        if (_var_12633.getPtr () != NULL) {
          macroValidPointer (_var_12633.getPtr ()) ;
          if (typeid (cPtr_alarm_autostart_true) == typeid (* (_var_12633.getPtr ()))) {
            const GGS_alarm_autostart_true var_cas_autostart (_var_12633.getPtr ()) ;
            ::routine_addBoolFieldValue (inLexique,  var_cas_fieldMap,  function_lstringWith (inLexique, GGS_string ("AUTOSTART") COMMA_SOURCE_FILE_AT_LINE (332)),  GGS_bool (true) COMMA_SOURCE_FILE_AT_LINE (332)) ;
            ::routine_addUnsignedFieldValue (inLexique,  var_cas_fieldMap,  function_lstringWith (inLexique, GGS_string ("ALARMTIME") COMMA_SOURCE_FILE_AT_LINE (333)),  var_cas_autostart.reader_alarm_time (inLexique COMMA_SOURCE_FILE_AT_LINE (333)).reader_uint64 (inLexique COMMA_SOURCE_FILE_AT_LINE (333)) COMMA_SOURCE_FILE_AT_LINE (333)) ;
            ::routine_addUnsignedFieldValue (inLexique,  var_cas_fieldMap,  function_lstringWith (inLexique, GGS_string ("CYCLETIME") COMMA_SOURCE_FILE_AT_LINE (334)),  var_cas_autostart.reader_cycle_time (inLexique COMMA_SOURCE_FILE_AT_LINE (334)).reader_uint64 (inLexique COMMA_SOURCE_FILE_AT_LINE (334)) COMMA_SOURCE_FILE_AT_LINE (334)) ;
            GGS_goilTemplateFieldMapList  var_cas_appmodesList = GGS_goilTemplateFieldMapList ::constructor_emptyList () ;
            {
              GGS_stringset::cEnumerator enumerator_12106 (var_cas_autostart.reader_app_modes (inLexique COMMA_SOURCE_FILE_AT_LINE (336)), true) ;
              while (enumerator_12106.hasCurrentObject ()) {
                GGS_goilTemplateFieldMap  var_cas_appModeFields = GGS_goilTemplateFieldMap ::constructor_emptyMap (inLexique COMMA_HERE) ;
                ::routine_addStringFieldValue (inLexique,  var_cas_appModeFields,  function_lstringWith (inLexique, GGS_string ("APPMODE") COMMA_SOURCE_FILE_AT_LINE (338)),  enumerator_12106._key (HERE) COMMA_SOURCE_FILE_AT_LINE (338)) ;
                var_cas_appmodesList.addAssign_operation (var_cas_appModeFields) ;
                enumerator_12106.next () ;
              }
            }
            ::routine_addListFieldValue (inLexique,  var_cas_fieldMap,  function_lstringWith (inLexique, GGS_string ("APPMODES") COMMA_SOURCE_FILE_AT_LINE (341)),  var_cas_appmodesList COMMA_SOURCE_FILE_AT_LINE (341)) ;
          }else if (typeid (cPtr_autostart_false) == typeid (* (_var_12633.getPtr ()))) {
            ::routine_addBoolFieldValue (inLexique,  var_cas_fieldMap,  function_lstringWith (inLexique, GGS_string ("AUTOSTART") COMMA_SOURCE_FILE_AT_LINE (343)),  GGS_bool (false) COMMA_SOURCE_FILE_AT_LINE (343)) ;
          }else if (typeid (cPtr_autostart_void) == typeid (* (_var_12633.getPtr ()))) {
            ::routine_addBoolFieldValue (inLexique,  var_cas_fieldMap,  function_lstringWith (inLexique, GGS_string ("AUTOSTART") COMMA_SOURCE_FILE_AT_LINE (345)),  GGS_bool (false) COMMA_SOURCE_FILE_AT_LINE (345)) ;
          }else{
          }
        }
      }
      ::routine_setAppRelatedAttributes (inLexique,  var_cas_fieldMap,  var_cas_cpu,  var_cas_appForObj,  operand_10424->mKey COMMA_SOURCE_FILE_AT_LINE (348)) ;
      var_cas_alarmsList.addAssign_operation (var_cas_fieldMap) ;
    }
  }
  ::routine_addListValue (inLexique,  var_cas_cfg,  GGS_lstring ::constructor_new (inLexique, GGS_string ("ALARMS"), GGS_location (inLexique) COMMA_HERE),  var_cas_alarmsList COMMA_SOURCE_FILE_AT_LINE (352)) ;
  #ifdef DEBUG_TRACE_ENABLED
    printf ("LEAVE routine_setAlarmsList\n") ;
  #endif
}

//---------------------------------------------------------------------------*
//                                                                           *
//               Implementation of routine "setResourcesList"                *
//                                                                           *
//---------------------------------------------------------------------------*

void routine_setResourcesList (C_Compiler & inLexique,
                                const GGS_root_obj   var_cas_cpu,
                                const GGS_prio_map   var_cas_resourcesPrio,
                                const GGS_string_map   var_cas_appForObj,
                                GGS_goilTemplateVariableMap  & var_cas_cfg COMMA_UNUSED_LOCATION_ARGS) {
  #ifdef DEBUG_TRACE_ENABLED
    printf ("ENTER routine_setResourcesList at %s:%d\n", __FILE__, __LINE__) ;
  #endif
  GGS_goilTemplateFieldMapList  var_cas_regularList = GGS_goilTemplateFieldMapList ::constructor_emptyList () ;
  GGS_goilTemplateFieldMapList  var_cas_internalList = GGS_goilTemplateFieldMapList ::constructor_emptyList () ;
  {
    GGS_resource_map::cEnumerator enumerator_13131 (var_cas_cpu.reader_resources (inLexique COMMA_SOURCE_FILE_AT_LINE (366)), true) ;
    const GGS_resource_map::cElement * operand_13131 = NULL ;
    while (((operand_13131 = enumerator_13131.nextObject ()))) {
      macroValidPointer (operand_13131) ;
      GGS_goilTemplateFieldMap  var_cas_fieldMap = GGS_goilTemplateFieldMap ::constructor_emptyMap (inLexique COMMA_HERE) ;
      ::routine_addStringFieldValue (inLexique,  var_cas_fieldMap,  GGS_lstring ::constructor_new (inLexique, GGS_string ("NAME"), GGS_location (inLexique) COMMA_HERE),  operand_13131->mKey.reader_string (inLexique COMMA_SOURCE_FILE_AT_LINE (368)) COMMA_SOURCE_FILE_AT_LINE (368)) ;
      GGS_uint  var_cas_priority ;
      GGS_string var_cas_usage ;
      GGS_uint  automatic_var_0 ;
      const GGS_prio_map  temp_13337 = var_cas_resourcesPrio ;
      if (temp_13337.isBuilt ()) {
        temp_13337 (HERE)->method_get (inLexique, operand_13131->mKey, var_cas_priority, automatic_var_0 COMMA_SOURCE_FILE_AT_LINE (371)) ;
      }
      ::routine_addUnsignedFieldValue (inLexique,  var_cas_fieldMap,  GGS_lstring ::constructor_new (inLexique, GGS_string ("PRIORITY"), GGS_location (inLexique) COMMA_HERE),  var_cas_priority.reader_uint64 (inLexique COMMA_SOURCE_FILE_AT_LINE (372)) COMMA_SOURCE_FILE_AT_LINE (372)) ;
      GGS_goilTemplateFieldMapList  var_cas_taskUsage = GGS_goilTemplateFieldMapList ::constructor_emptyList () ;
      {
        GGS_task_map::cEnumerator enumerator_13516 (var_cas_cpu.reader_tasks (inLexique COMMA_SOURCE_FILE_AT_LINE (375)), true) ;
        const GGS_task_map::cElement * operand_13516 = NULL ;
        while (((operand_13516 = enumerator_13516.nextObject ()))) {
          macroValidPointer (operand_13516) ;
          const GGS_bool cond_13769 = function_isInLstringlist (inLexique, operand_13516->mInfo.task.reader_resources (inLexique COMMA_SOURCE_FILE_AT_LINE (376)), operand_13131->mKey COMMA_SOURCE_FILE_AT_LINE (376)) ;
          if (cond_13769.isBuiltAndTrue ()) {
            GGS_goilTemplateFieldMap  var_cas_usage = GGS_goilTemplateFieldMap ::constructor_emptyMap (inLexique COMMA_HERE) ;
            ::routine_addStringFieldValue (inLexique,  var_cas_usage,  GGS_lstring ::constructor_new (inLexique, GGS_string ("NAME"), GGS_location (inLexique) COMMA_HERE),  operand_13516->mKey.reader_string (inLexique COMMA_SOURCE_FILE_AT_LINE (378)) COMMA_SOURCE_FILE_AT_LINE (378)) ;
            var_cas_taskUsage.addAssign_operation (var_cas_usage) ;
          }
        }
      }
      ::routine_addListFieldValue (inLexique,  var_cas_fieldMap,  GGS_lstring ::constructor_new (inLexique, GGS_string ("TASKUSAGE"), GGS_location (inLexique) COMMA_HERE),  var_cas_taskUsage COMMA_SOURCE_FILE_AT_LINE (383)) ;
      GGS_goilTemplateFieldMapList  var_cas_isrUsage = GGS_goilTemplateFieldMapList ::constructor_emptyList () ;
      {
        GGS_isr_map::cEnumerator enumerator_13946 (var_cas_cpu.reader_isrs (inLexique COMMA_SOURCE_FILE_AT_LINE (386)), true) ;
        const GGS_isr_map::cElement * operand_13946 = NULL ;
        while (((operand_13946 = enumerator_13946.nextObject ()))) {
          macroValidPointer (operand_13946) ;
          const GGS_bool cond_14196 = function_isInLstringlist (inLexique, operand_13946->mInfo.isr.reader_resources (inLexique COMMA_SOURCE_FILE_AT_LINE (387)), operand_13131->mKey COMMA_SOURCE_FILE_AT_LINE (387)) ;
          if (cond_14196.isBuiltAndTrue ()) {
            GGS_goilTemplateFieldMap  var_cas_usage = GGS_goilTemplateFieldMap ::constructor_emptyMap (inLexique COMMA_HERE) ;
            ::routine_addStringFieldValue (inLexique,  var_cas_usage,  GGS_lstring ::constructor_new (inLexique, GGS_string ("NAME"), GGS_location (inLexique) COMMA_HERE),  operand_13946->mKey.reader_string (inLexique COMMA_SOURCE_FILE_AT_LINE (389)) COMMA_SOURCE_FILE_AT_LINE (389)) ;
            var_cas_isrUsage.addAssign_operation (var_cas_usage) ;
          }
        }
      }
      ::routine_addListFieldValue (inLexique,  var_cas_fieldMap,  GGS_lstring ::constructor_new (inLexique, GGS_string ("ISRUSAGE"), GGS_location (inLexique) COMMA_HERE),  var_cas_isrUsage COMMA_SOURCE_FILE_AT_LINE (394)) ;
      ::routine_setAppRelatedAttributes (inLexique,  var_cas_fieldMap,  var_cas_cpu,  var_cas_appForObj,  operand_13131->mKey COMMA_SOURCE_FILE_AT_LINE (396)) ;
      { const GGS_resource_property_obj _var_14748 = operand_13131->mInfo.resource.reader_property (inLexique COMMA_SOURCE_FILE_AT_LINE (399)) ; // CAST instruction
        if (_var_14748.getPtr () != NULL) {
          macroValidPointer (_var_14748.getPtr ()) ;
          if (typeid (cPtr_resource_property_standard_obj) == typeid (* (_var_14748.getPtr ()))) {
            var_cas_regularList.addAssign_operation (var_cas_fieldMap) ;
          }else if (typeid (cPtr_resource_property_linked_obj) == typeid (* (_var_14748.getPtr ()))) {
            var_cas_regularList.addAssign_operation (var_cas_fieldMap) ;
          }else if (typeid (cPtr_resource_property_internal_obj) == typeid (* (_var_14748.getPtr ()))) {
            var_cas_internalList.addAssign_operation (var_cas_fieldMap) ;
          }else{
            operand_13131->mInfo.resource.reader_property (inLexique COMMA_SOURCE_FILE_AT_LINE (407)).reader_location (inLexique COMMA_SOURCE_FILE_AT_LINE (407)).reader_location (inLexique COMMA_HERE).signalGGSSemanticError (inLexique, GGS_string ("internal error, RESOURCEPROPERTY type is undefined") COMMA_SOURCE_FILE_AT_LINE (408)) ;
          }
        }
      }
    }
  }
  ::routine_addListValue (inLexique,  var_cas_cfg,  GGS_lstring ::constructor_new (inLexique, GGS_string ("REGULARRESOURCES"), GGS_location (inLexique) COMMA_HERE),  var_cas_regularList COMMA_SOURCE_FILE_AT_LINE (410)) ;
  ::routine_addListValue (inLexique,  var_cas_cfg,  GGS_lstring ::constructor_new (inLexique, GGS_string ("INTERNALRESOURCES"), GGS_location (inLexique) COMMA_HERE),  var_cas_internalList COMMA_SOURCE_FILE_AT_LINE (411)) ;
  #ifdef DEBUG_TRACE_ENABLED
    printf ("LEAVE routine_setResourcesList\n") ;
  #endif
}

//---------------------------------------------------------------------------*
//                                                                           *
//               Implementation of routine "setMessagesList"                 *
//                                                                           *
//---------------------------------------------------------------------------*

void routine_setMessagesList (C_Compiler & inLexique,
                                const GGS_root_obj   var_cas_cpu,
                                const GGS_string_map   /* var_cas_appForObj */,
                                GGS_goilTemplateVariableMap  & var_cas_cfg COMMA_UNUSED_LOCATION_ARGS) {
  #ifdef DEBUG_TRACE_ENABLED
    printf ("ENTER routine_setMessagesList at %s:%d\n", __FILE__, __LINE__) ;
  #endif
  GGS_goilTemplateFieldMapList  var_cas_messagesList = GGS_goilTemplateFieldMapList ::constructor_emptyList () ;
  {
    GGS_message_map::cEnumerator enumerator_15139 (var_cas_cpu.reader_messages (inLexique COMMA_SOURCE_FILE_AT_LINE (423)), true) ;
    const GGS_message_map::cElement * operand_15139 = NULL ;
    while (((operand_15139 = enumerator_15139.nextObject ()))) {
      macroValidPointer (operand_15139) ;
      GGS_goilTemplateFieldMap  var_cas_fieldMap = GGS_goilTemplateFieldMap ::constructor_emptyMap (inLexique COMMA_HERE) ;
      ::routine_addStringFieldValue (inLexique,  var_cas_fieldMap,  function_lstringWith (inLexique, GGS_string ("NAME") COMMA_SOURCE_FILE_AT_LINE (425)),  operand_15139->mKey.reader_string (inLexique COMMA_SOURCE_FILE_AT_LINE (425)) COMMA_SOURCE_FILE_AT_LINE (425)) ;
      var_cas_messagesList.addAssign_operation (var_cas_fieldMap) ;
    }
  }
  ::routine_addListValue (inLexique,  var_cas_cfg,  function_lstringWith (inLexique, GGS_string ("MESSAGES") COMMA_SOURCE_FILE_AT_LINE (428)),  var_cas_messagesList COMMA_SOURCE_FILE_AT_LINE (428)) ;
  #ifdef DEBUG_TRACE_ENABLED
    printf ("LEAVE routine_setMessagesList\n") ;
  #endif
}

//---------------------------------------------------------------------------*
//                                                                           *
//            Implementation of routine "setScheduletablesList"              *
//                                                                           *
//---------------------------------------------------------------------------*

void routine_setScheduletablesList (C_Compiler & inLexique,
                                const GGS_root_obj   var_cas_cpu,
                                const GGS_string_map   var_cas_appForObj,
                                GGS_goilTemplateVariableMap  & var_cas_cfg COMMA_UNUSED_LOCATION_ARGS) {
  #ifdef DEBUG_TRACE_ENABLED
    printf ("ENTER routine_setScheduletablesList at %s:%d\n", __FILE__, __LINE__) ;
  #endif
  GGS_goilTemplateFieldMapList  var_cas_scheduletablesList = GGS_goilTemplateFieldMapList ::constructor_emptyList () ;
  {
    GGS_scheduletable_map::cEnumerator enumerator_15615 (var_cas_cpu.reader_scheduletables (inLexique COMMA_SOURCE_FILE_AT_LINE (440)), true) ;
    const GGS_scheduletable_map::cElement * operand_15615 = NULL ;
    while (((operand_15615 = enumerator_15615.nextObject ()))) {
      macroValidPointer (operand_15615) ;
      GGS_goilTemplateFieldMap  var_cas_fieldMap = GGS_goilTemplateFieldMap ::constructor_emptyMap (inLexique COMMA_HERE) ;
      ::routine_addStringFieldValue (inLexique,  var_cas_fieldMap,  function_lstringWith (inLexique, GGS_string ("NAME") COMMA_SOURCE_FILE_AT_LINE (442)),  operand_15615->mKey.reader_string (inLexique COMMA_SOURCE_FILE_AT_LINE (442)) COMMA_SOURCE_FILE_AT_LINE (442)) ;
      ::routine_addStringFieldValue (inLexique,  var_cas_fieldMap,  function_lstringWith (inLexique, GGS_string ("COUNTER") COMMA_SOURCE_FILE_AT_LINE (443)),  operand_15615->mInfo.st.reader_counter (inLexique COMMA_SOURCE_FILE_AT_LINE (443)).reader_string (inLexique COMMA_SOURCE_FILE_AT_LINE (443)) COMMA_SOURCE_FILE_AT_LINE (443)) ;
      GGS_bool var_cas_periodic = GGS_bool (false) ;
      { const GGS_basic_type _var_15963 = operand_15615->mInfo.st.reader_periodic (inLexique COMMA_SOURCE_FILE_AT_LINE (446)) ; // CAST instruction
        if (_var_15963.getPtr () != NULL) {
          macroValidPointer (_var_15963.getPtr ()) ;
          if (typeid (cPtr_bool_class) == typeid (* (_var_15963.getPtr ()))) {
            const GGS_bool_class var_cas_p (_var_15963.getPtr ()) ;
            var_cas_periodic = var_cas_p.reader_value (inLexique COMMA_SOURCE_FILE_AT_LINE (447)) ;
          }else{
          }
        }
      }
      ::routine_addBoolFieldValue (inLexique,  var_cas_fieldMap,  function_lstringWith (inLexique, GGS_string ("PERIODIC") COMMA_SOURCE_FILE_AT_LINE (449)),  var_cas_periodic COMMA_SOURCE_FILE_AT_LINE (449)) ;
      GGS_uint64  var_cas_length = GGS_uint64 (0ULL) ;
      { const GGS_basic_type _var_16221 = operand_15615->mInfo.st.reader_length (inLexique COMMA_SOURCE_FILE_AT_LINE (452)) ; // CAST instruction
        if (_var_16221.getPtr () != NULL) {
          macroValidPointer (_var_16221.getPtr ()) ;
          if (typeid (cPtr_uint64_class) == typeid (* (_var_16221.getPtr ()))) {
            const GGS_uint64_class var_cas_len (_var_16221.getPtr ()) ;
            var_cas_length = var_cas_len.reader_value (inLexique COMMA_SOURCE_FILE_AT_LINE (453)) ;
          }else{
            operand_15615->mKey.reader_location (inLexique COMMA_HERE).signalGGSSemanticError (inLexique, GGS_string ("internal, wrong type for LENGTH attribute") COMMA_SOURCE_FILE_AT_LINE (455)) ;
          }
        }
      }
      ::routine_addUnsignedFieldValue (inLexique,  var_cas_fieldMap,  function_lstringWith (inLexique, GGS_string ("LENGTH") COMMA_SOURCE_FILE_AT_LINE (456)),  var_cas_length COMMA_SOURCE_FILE_AT_LINE (456)) ;
      GGS_expiry_point_list  var_cas_expiryPoints = operand_15615->mInfo.st.reader_exp_points (inLexique COMMA_SOURCE_FILE_AT_LINE (460)) ;
      GGS_expiry_point_obj  var_cas_lastPoint ;
      GGS_uint64  var_cas_lastOffset ;
      var_cas_expiryPoints.modifier_popGreatest (inLexique, var_cas_lastOffset, var_cas_lastPoint COMMA_SOURCE_FILE_AT_LINE (463)) ;
      const GGS_bool cond_16802 = (var_cas_lastOffset).operator_isEqual (var_cas_length) ;
      if (cond_16802.isBuiltAndTrue ()) {
        GGS_action_list  var_cas_actions = var_cas_lastPoint.reader_actions (inLexique COMMA_SOURCE_FILE_AT_LINE (466)) ;
        var_cas_actions.addAssign_operation (GGS_uint (10U), GGS_finalize_st_action ::constructor_new (inLexique, GGS_location (inLexique) COMMA_HERE)) ;
        var_cas_lastPoint.modifier_setActions (inLexique, var_cas_actions COMMA_SOURCE_FILE_AT_LINE (468)) ;
      }else if (cond_16802.isBuiltAndFalse ()) {
        GGS_action_list  var_cas_finalizeExpiryPointActions = GGS_action_list ::constructor_emptySortedList () ;
        var_cas_finalizeExpiryPointActions.addAssign_operation (GGS_uint (10U), GGS_finalize_st_action ::constructor_new (inLexique, GGS_location (inLexique) COMMA_HERE)) ;
        GGS_expiry_point_obj  var_cas_finalizeExpiryPoint = GGS_expiry_point_obj ::constructor_new (inLexique, GGS_lstring ::constructor_new (inLexique, GGS_string (""), GGS_location (inLexique) COMMA_HERE), GGS_uint64_class ::constructor_new (inLexique, GGS_location (inLexique), var_cas_length COMMA_HERE), GGS_lstring ::constructor_new (inLexique, GGS_string ("finalize"), GGS_location (inLexique) COMMA_HERE), GGS_adjustable_void ::constructor_new (inLexique, function_empty_lstring (inLexique COMMA_SOURCE_FILE_AT_LINE (478)), GGS_location (inLexique) COMMA_HERE), var_cas_finalizeExpiryPointActions COMMA_HERE) ;
        var_cas_expiryPoints.addAssign_operation (var_cas_length, var_cas_finalizeExpiryPoint) ;
      }
      var_cas_expiryPoints.addAssign_operation (var_cas_lastOffset, var_cas_lastPoint) ;
      GGS_goilTemplateFieldMapList  var_cas_expiryPointsList = GGS_goilTemplateFieldMapList ::constructor_emptyList () ;
      GGS_uint64  var_cas_previousOffset = GGS_uint64 (0ULL) ;
      {
        GGS_expiry_point_list::cEnumerator enumerator_17573 (var_cas_expiryPoints, true) ;
        const GGS_expiry_point_list::cElement * operand_17573 = NULL ;
        while (((operand_17573 = enumerator_17573.nextObject ()))) {
          macroValidPointer (operand_17573) ;
          GGS_goilTemplateFieldMap  var_cas_fieldMap = GGS_goilTemplateFieldMap ::constructor_emptyMap (inLexique COMMA_HERE) ;
          ::routine_addUnsignedFieldValue (inLexique,  var_cas_fieldMap,  function_lstringWith (inLexique, GGS_string ("ABSOLUTEOFFSET") COMMA_SOURCE_FILE_AT_LINE (490)),  operand_17573->off COMMA_SOURCE_FILE_AT_LINE (490)) ;
          ::routine_addUnsignedFieldValue (inLexique,  var_cas_fieldMap,  function_lstringWith (inLexique, GGS_string ("RELATIVEOFFSET") COMMA_SOURCE_FILE_AT_LINE (491)),  operand_17573->off.substract_operation (inLexique, var_cas_previousOffset COMMA_SOURCE_FILE_AT_LINE (491)) COMMA_SOURCE_FILE_AT_LINE (491)) ;
          ::routine_addUnsignedFieldValue (inLexique,  var_cas_fieldMap,  function_lstringWith (inLexique, GGS_string ("ACTIONCOUNT") COMMA_SOURCE_FILE_AT_LINE (492)),  operand_17573->point.reader_actions (inLexique COMMA_SOURCE_FILE_AT_LINE (492)).reader_length ().reader_uint64 (inLexique COMMA_SOURCE_FILE_AT_LINE (492)) COMMA_SOURCE_FILE_AT_LINE (492)) ;
          var_cas_expiryPointsList.addAssign_operation (var_cas_fieldMap) ;
        }
      }
      ::routine_addListFieldValue (inLexique,  var_cas_fieldMap,  function_lstringWith (inLexique, GGS_string ("EXPIRYPOINTS") COMMA_SOURCE_FILE_AT_LINE (496)),  var_cas_expiryPointsList COMMA_SOURCE_FILE_AT_LINE (496)) ;
      ::routine_setAppRelatedAttributes (inLexique,  var_cas_fieldMap,  var_cas_cpu,  var_cas_appForObj,  operand_15615->mKey COMMA_SOURCE_FILE_AT_LINE (498)) ;
      var_cas_scheduletablesList.addAssign_operation (var_cas_fieldMap) ;
    }
  }
  ::routine_addListValue (inLexique,  var_cas_cfg,  function_lstringWith (inLexique, GGS_string ("SCHEDULETABLES") COMMA_SOURCE_FILE_AT_LINE (502)),  var_cas_scheduletablesList COMMA_SOURCE_FILE_AT_LINE (502)) ;
  #ifdef DEBUG_TRACE_ENABLED
    printf ("LEAVE routine_setScheduletablesList\n") ;
  #endif
}

//---------------------------------------------------------------------------*
//                                                                           *
//            Implementation of routine "setOsapplicationsList"              *
//                                                                           *
//---------------------------------------------------------------------------*

void routine_setOsapplicationsList (C_Compiler & inLexique,
                                const GGS_root_obj   var_cas_cpu,
                                const GGS_string_map   /* var_cas_appForObj */,
                                GGS_goilTemplateVariableMap  & var_cas_cfg COMMA_UNUSED_LOCATION_ARGS) {
  #ifdef DEBUG_TRACE_ENABLED
    printf ("ENTER routine_setOsapplicationsList at %s:%d\n", __FILE__, __LINE__) ;
  #endif
  GGS_goilTemplateFieldMapList  var_cas_osapplicationsList = GGS_goilTemplateFieldMapList ::constructor_emptyList () ;
  GGS_stringset  var_cas_trustedFunctionSet = GGS_stringset ::constructor_emptySet () ;
  {
    GGS_app_map::cEnumerator enumerator_18537 (var_cas_cpu.reader_applis (inLexique COMMA_SOURCE_FILE_AT_LINE (515)), true) ;
    const GGS_app_map::cElement * operand_18537 = NULL ;
    while (((operand_18537 = enumerator_18537.nextObject ()))) {
      macroValidPointer (operand_18537) ;
      GGS_goilTemplateFieldMap  var_cas_fieldMap = GGS_goilTemplateFieldMap ::constructor_emptyMap (inLexique COMMA_HERE) ;
      ::routine_addStringFieldValue (inLexique,  var_cas_fieldMap,  function_lstringWith (inLexique, GGS_string ("NAME") COMMA_SOURCE_FILE_AT_LINE (517)),  operand_18537->mKey.reader_string (inLexique COMMA_SOURCE_FILE_AT_LINE (517)) COMMA_SOURCE_FILE_AT_LINE (517)) ;
      var_cas_osapplicationsList.addAssign_operation (var_cas_fieldMap) ;
      { const GGS_app_trusted_obj _var_18914 = operand_18537->mInfo.app.reader_trusted (inLexique COMMA_SOURCE_FILE_AT_LINE (519)) ; // CAST instruction
        if (_var_18914.getPtr () != NULL) {
          macroValidPointer (_var_18914.getPtr ()) ;
          if (typeid (cPtr_app_trusted_true) == typeid (* (_var_18914.getPtr ()))) {
            const GGS_app_trusted_true var_cas_t (_var_18914.getPtr ()) ;
            {
              GGS_stringset::cEnumerator enumerator_18782 (var_cas_t.reader_trusted_fcts (inLexique COMMA_SOURCE_FILE_AT_LINE (521)), true) ;
              while (enumerator_18782.hasCurrentObject ()) {
                var_cas_trustedFunctionSet.addAssign_operation (enumerator_18782._key (HERE)) ;
                enumerator_18782.next () ;
              }
            }
          }else{
          }
        }
      }
    }
  }
  ::routine_addListValue (inLexique,  var_cas_cfg,  function_lstringWith (inLexique, GGS_string ("OSAPPLICATIONS") COMMA_SOURCE_FILE_AT_LINE (526)),  var_cas_osapplicationsList COMMA_SOURCE_FILE_AT_LINE (526)) ;
  GGS_goilTemplateFieldMapList  var_cas_trustedfunctionsList = GGS_goilTemplateFieldMapList ::constructor_emptyList () ;
  {
    GGS_stringset::cEnumerator enumerator_19103 (var_cas_trustedFunctionSet, true) ;
    while (enumerator_19103.hasCurrentObject ()) {
      GGS_goilTemplateFieldMap  var_cas_fieldMap = GGS_goilTemplateFieldMap ::constructor_emptyMap (inLexique COMMA_HERE) ;
      ::routine_addStringFieldValue (inLexique,  var_cas_fieldMap,  function_lstringWith (inLexique, GGS_string ("NAME") COMMA_SOURCE_FILE_AT_LINE (531)),  enumerator_19103._key (HERE) COMMA_SOURCE_FILE_AT_LINE (531)) ;
      var_cas_trustedfunctionsList.addAssign_operation (var_cas_fieldMap) ;
      enumerator_19103.next () ;
    }
  }
  ::routine_addListValue (inLexique,  var_cas_cfg,  function_lstringWith (inLexique, GGS_string ("TRUSTEDFUNCTIONS") COMMA_SOURCE_FILE_AT_LINE (534)),  var_cas_osapplicationsList COMMA_SOURCE_FILE_AT_LINE (534)) ;
  #ifdef DEBUG_TRACE_ENABLED
    printf ("LEAVE routine_setOsapplicationsList\n") ;
  #endif
}

//---------------------------------------------------------------------------*
//                                                                           *
//               Implementation of routine "setProcessCount"                 *
//                                                                           *
//---------------------------------------------------------------------------*

void routine_setProcessCount (C_Compiler & inLexique,
                                const GGS_root_obj   var_cas_cpu,
                                GGS_goilTemplateVariableMap  & var_cas_cfg COMMA_UNUSED_LOCATION_ARGS) {
  #ifdef DEBUG_TRACE_ENABLED
    printf ("ENTER routine_setProcessCount at %s:%d\n", __FILE__, __LINE__) ;
  #endif
  GGS_uint64  var_cas_taskCount = var_cas_cpu.reader_tasks (inLexique COMMA_SOURCE_FILE_AT_LINE (546)).reader_count ().reader_uint64 (inLexique COMMA_SOURCE_FILE_AT_LINE (546)) ;
  GGS_uint64  var_cas_isrCount = var_cas_cpu.reader_isrs (inLexique COMMA_SOURCE_FILE_AT_LINE (547)).reader_count ().reader_uint64 (inLexique COMMA_SOURCE_FILE_AT_LINE (547)) ;
  GGS_uint64  var_cas_extendedCount = GGS_uint64 (0ULL) ;
  {
    GGS_task_map::cEnumerator enumerator_19764 (var_cas_cpu.reader_tasks (inLexique COMMA_SOURCE_FILE_AT_LINE (549)), true) ;
    const GGS_task_map::cElement * operand_19764 = NULL ;
    while (((operand_19764 = enumerator_19764.nextObject ()))) {
      macroValidPointer (operand_19764) ;
      const GGS_bool cond_19847 = (operand_19764->mInfo.task.reader_events (inLexique COMMA_SOURCE_FILE_AT_LINE (550)).reader_length ()).operator_strictSup (GGS_uint (0U)) ;
      if (cond_19847.isBuiltAndTrue ()) {
        var_cas_extendedCount.increment_operation (inLexique COMMA_SOURCE_FILE_AT_LINE (551)) ;
      }
    }
  }
  GGS_uint64  var_cas_isr2Count = GGS_uint64 (0ULL) ;
  {
    GGS_isr_map::cEnumerator enumerator_19905 (var_cas_cpu.reader_isrs (inLexique COMMA_SOURCE_FILE_AT_LINE (555)), true) ;
    const GGS_isr_map::cElement * operand_19905 = NULL ;
    while (((operand_19905 = enumerator_19905.nextObject ()))) {
      macroValidPointer (operand_19905) ;
      { const GGS_basic_type _var_20106 = operand_19905->mInfo.isr.reader_category (inLexique COMMA_SOURCE_FILE_AT_LINE (556)) ; // CAST instruction
        if (_var_20106.getPtr () != NULL) {
          macroValidPointer (_var_20106.getPtr ()) ;
          if (typeid (cPtr_uint64_class) == typeid (* (_var_20106.getPtr ()))) {
            const GGS_uint64_class var_cas_cat (_var_20106.getPtr ()) ;
            const GGS_bool cond_20038 = (var_cas_cat.reader_value (inLexique COMMA_SOURCE_FILE_AT_LINE (558))).operator_isEqual (GGS_uint64 (2ULL)) ;
            if (cond_20038.isBuiltAndTrue ()) {
              var_cas_isr2Count.increment_operation (inLexique COMMA_SOURCE_FILE_AT_LINE (559)) ;
            }
          }else{
            operand_19905->mKey.reader_location (inLexique COMMA_HERE).signalGGSSemanticError (inLexique, GGS_string ("missing CATEGORY attribute") COMMA_SOURCE_FILE_AT_LINE (563)) ;
          }
        }
      }
    }
  }
  ::routine_addUnsignedValue (inLexique,  var_cas_cfg,  GGS_lstring ::constructor_new (inLexique, GGS_string ("TASKCOUNT"), GGS_location (inLexique) COMMA_HERE),  var_cas_taskCount COMMA_SOURCE_FILE_AT_LINE (565)) ;
  ::routine_addUnsignedValue (inLexique,  var_cas_cfg,  GGS_lstring ::constructor_new (inLexique, GGS_string ("EXTENDEDTASKCOUNT"), GGS_location (inLexique) COMMA_HERE),  var_cas_extendedCount COMMA_SOURCE_FILE_AT_LINE (566)) ;
  ::routine_addUnsignedValue (inLexique,  var_cas_cfg,  GGS_lstring ::constructor_new (inLexique, GGS_string ("BASICTASKCOUNT"), GGS_location (inLexique) COMMA_HERE),  var_cas_taskCount.substract_operation (inLexique, var_cas_extendedCount COMMA_SOURCE_FILE_AT_LINE (567)) COMMA_SOURCE_FILE_AT_LINE (567)) ;
  ::routine_addUnsignedValue (inLexique,  var_cas_cfg,  GGS_lstring ::constructor_new (inLexique, GGS_string ("PROCESSCOUNT"), GGS_location (inLexique) COMMA_HERE),  var_cas_taskCount.add_operation (inLexique, var_cas_isr2Count COMMA_SOURCE_FILE_AT_LINE (568)) COMMA_SOURCE_FILE_AT_LINE (568)) ;
  ::routine_addUnsignedValue (inLexique,  var_cas_cfg,  GGS_lstring ::constructor_new (inLexique, GGS_string ("ISRCOUNT"), GGS_location (inLexique) COMMA_HERE),  var_cas_isrCount COMMA_SOURCE_FILE_AT_LINE (569)) ;
  ::routine_addUnsignedValue (inLexique,  var_cas_cfg,  GGS_lstring ::constructor_new (inLexique, GGS_string ("ISR2COUNT"), GGS_location (inLexique) COMMA_HERE),  var_cas_isr2Count COMMA_SOURCE_FILE_AT_LINE (570)) ;
  ::routine_addUnsignedValue (inLexique,  var_cas_cfg,  GGS_lstring ::constructor_new (inLexique, GGS_string ("ISR1COUNT"), GGS_location (inLexique) COMMA_HERE),  var_cas_isrCount.substract_operation (inLexique, var_cas_isr2Count COMMA_SOURCE_FILE_AT_LINE (571)) COMMA_SOURCE_FILE_AT_LINE (571)) ;
  #ifdef DEBUG_TRACE_ENABLED
    printf ("LEAVE routine_setProcessCount\n") ;
  #endif
}

//---------------------------------------------------------------------------*
//                                                                           *
//               Implementation of routine "setResourceCount"                *
//                                                                           *
//---------------------------------------------------------------------------*

void routine_setResourceCount (C_Compiler & inLexique,
                                const GGS_root_obj   var_cas_cpu,
                                GGS_goilTemplateVariableMap  & var_cas_cfg COMMA_UNUSED_LOCATION_ARGS) {
  #ifdef DEBUG_TRACE_ENABLED
    printf ("ENTER routine_setResourceCount at %s:%d\n", __FILE__, __LINE__) ;
  #endif
  ::routine_addUnsignedValue (inLexique,  var_cas_cfg,  GGS_lstring ::constructor_new (inLexique, GGS_string ("RESOURCECOUNT"), GGS_location (inLexique) COMMA_HERE),  var_cas_cpu.reader_resources (inLexique COMMA_SOURCE_FILE_AT_LINE (578)).reader_count ().reader_uint64 (inLexique COMMA_SOURCE_FILE_AT_LINE (578)) COMMA_SOURCE_FILE_AT_LINE (578)) ;
  GGS_uint64  var_cas_regularCount = GGS_uint64 (0ULL) ;
  GGS_uint64  var_cas_internalCount = GGS_uint64 (0ULL) ;
  {
    GGS_resource_map::cEnumerator enumerator_21026 (var_cas_cpu.reader_resources (inLexique COMMA_SOURCE_FILE_AT_LINE (581)), true) ;
    const GGS_resource_map::cElement * operand_21026 = NULL ;
    while (((operand_21026 = enumerator_21026.nextObject ()))) {
      macroValidPointer (operand_21026) ;
      { const GGS_resource_property_obj _var_21395 = operand_21026->mInfo.resource.reader_property (inLexique COMMA_SOURCE_FILE_AT_LINE (582)) ; // CAST instruction
        if (_var_21395.getPtr () != NULL) {
          macroValidPointer (_var_21395.getPtr ()) ;
          if (typeid (cPtr_resource_property_standard_obj) == typeid (* (_var_21395.getPtr ()))) {
            var_cas_regularCount.increment_operation (inLexique COMMA_SOURCE_FILE_AT_LINE (584)) ;
          }else if (typeid (cPtr_resource_property_linked_obj) == typeid (* (_var_21395.getPtr ()))) {
            var_cas_regularCount.increment_operation (inLexique COMMA_SOURCE_FILE_AT_LINE (586)) ;
          }else if (typeid (cPtr_resource_property_internal_obj) == typeid (* (_var_21395.getPtr ()))) {
            var_cas_internalCount.increment_operation (inLexique COMMA_SOURCE_FILE_AT_LINE (588)) ;
          }else{
            operand_21026->mInfo.resource.reader_property (inLexique COMMA_SOURCE_FILE_AT_LINE (590)).reader_location (inLexique COMMA_SOURCE_FILE_AT_LINE (590)).reader_location (inLexique COMMA_HERE).signalGGSSemanticError (inLexique, GGS_string ("internal error, RESOURCEPROPERTY type is undefined") COMMA_SOURCE_FILE_AT_LINE (591)) ;
          }
        }
      }
    }
  }
  ::routine_addUnsignedValue (inLexique,  var_cas_cfg,  GGS_lstring ::constructor_new (inLexique, GGS_string ("REGULARRESOURCECOUNT"), GGS_location (inLexique) COMMA_HERE),  var_cas_regularCount COMMA_SOURCE_FILE_AT_LINE (593)) ;
  ::routine_addUnsignedValue (inLexique,  var_cas_cfg,  GGS_lstring ::constructor_new (inLexique, GGS_string ("INTERNALRESOURCECOUNT"), GGS_location (inLexique) COMMA_HERE),  var_cas_internalCount COMMA_SOURCE_FILE_AT_LINE (594)) ;
  #ifdef DEBUG_TRACE_ENABLED
    printf ("LEAVE routine_setResourceCount\n") ;
  #endif
}

//---------------------------------------------------------------------------*
//                                                                           *
//                  Implementation of routine "setUseCom"                    *
//                                                                           *
//---------------------------------------------------------------------------*

void routine_setUseCom (C_Compiler & inLexique,
                                const GGS_root_obj   var_cas_cpu,
                                GGS_goilTemplateVariableMap  & var_cas_cfg COMMA_UNUSED_LOCATION_ARGS) {
  #ifdef DEBUG_TRACE_ENABLED
    printf ("ENTER routine_setUseCom at %s:%d\n", __FILE__, __LINE__) ;
  #endif
  GGS_bool var_cas_usecom = GGS_bool (false) ;
  const GGS_bool cond_21886 = var_cas_cpu.reader_com (inLexique COMMA_SOURCE_FILE_AT_LINE (603)).reader_usecom (inLexique COMMA_SOURCE_FILE_AT_LINE (603)) ;
  if (cond_21886.isBuiltAndTrue ()) {
    var_cas_usecom = GGS_bool (true) ;
  }else if (cond_21886.isBuiltAndFalse ()) {
    var_cas_usecom = ((var_cas_cpu.reader_messages (inLexique COMMA_SOURCE_FILE_AT_LINE (606)).reader_count ()).operator_strictSup (GGS_uint (0U))).operator_or ((var_cas_cpu.reader_net_messages (inLexique COMMA_SOURCE_FILE_AT_LINE (607)).reader_count ()).operator_strictSup (GGS_uint (0U))) ;
  }
  ::routine_addBoolValue (inLexique,  var_cas_cfg,  GGS_lstring ::constructor_new (inLexique, GGS_string ("USECOM"), GGS_location (inLexique) COMMA_HERE),  var_cas_usecom COMMA_SOURCE_FILE_AT_LINE (609)) ;
  #ifdef DEBUG_TRACE_ENABLED
    printf ("LEAVE routine_setUseCom\n") ;
  #endif
}

//---------------------------------------------------------------------------*
//                                                                           *
//             Implementation of routine "setScalabilityClass"               *
//                                                                           *
//---------------------------------------------------------------------------*

void routine_setScalabilityClass (C_Compiler & inLexique,
                                const GGS_root_obj   var_cas_cpu,
                                GGS_goilTemplateVariableMap  & var_cas_cfg COMMA_UNUSED_LOCATION_ARGS) {
  #ifdef DEBUG_TRACE_ENABLED
    printf ("ENTER routine_setScalabilityClass at %s:%d\n", __FILE__, __LINE__) ;
  #endif
  const GGS_bool cond_23914 = gOption_goil_5F_options_autosar_5F_on.reader_value () ;
  if (cond_23914.isBuiltAndTrue ()) {
    GGS_bool var_cas_useTimingProtection = GGS_bool (false) ;
    GGS_bool var_cas_useProtectionHook = GGS_bool (false) ;
    GGS_uint64  var_cas_sc = GGS_uint64 (1ULL) ;
    GGS_string var_cas_setSC = var_cas_cpu.reader_os (inLexique COMMA_SOURCE_FILE_AT_LINE (624)).reader_scalabilityclass (inLexique COMMA_SOURCE_FILE_AT_LINE (624)).reader_string (inLexique COMMA_SOURCE_FILE_AT_LINE (624)) ;
    const GGS_bool cond_23516 = ((var_cas_setSC).operator_isEqual (GGS_string (""))).operator_or ((var_cas_setSC).operator_isEqual (GGS_string ("AUTO"))) ;
    if (cond_23516.isBuiltAndTrue ()) {
      {
        GGS_task_map::cEnumerator enumerator_22669 (var_cas_cpu.reader_tasks (inLexique COMMA_SOURCE_FILE_AT_LINE (632)), true) ;
        const GGS_task_map::cElement * operand_22669 = NULL ;
        while (((operand_22669 = enumerator_22669.nextObject ()))) {
          macroValidPointer (operand_22669) ;
          { const GGS_timing_prot _var_22798 = operand_22669->mInfo.task.reader_timing_prot (inLexique COMMA_SOURCE_FILE_AT_LINE (633)) ; // CAST instruction
            if (_var_22798.getPtr () != NULL) {
              macroValidPointer (_var_22798.getPtr ()) ;
              if (typeid (cPtr_timing_prot_task) == typeid (* (_var_22798.getPtr ()))) {
                var_cas_useTimingProtection = GGS_bool (true) ;
              }else{
              }
            }
          }
        }
      }
      {
        GGS_isr_map::cEnumerator enumerator_22846 (var_cas_cpu.reader_isrs (inLexique COMMA_SOURCE_FILE_AT_LINE (638)), true) ;
        const GGS_isr_map::cElement * operand_22846 = NULL ;
        while (((operand_22846 = enumerator_22846.nextObject ()))) {
          macroValidPointer (operand_22846) ;
          { const GGS_timing_prot _var_22972 = operand_22846->mInfo.isr.reader_timing_prot (inLexique COMMA_SOURCE_FILE_AT_LINE (639)) ; // CAST instruction
            if (_var_22972.getPtr () != NULL) {
              macroValidPointer (_var_22972.getPtr ()) ;
              if (typeid (cPtr_timing_prot_isr) == typeid (* (_var_22972.getPtr ()))) {
                var_cas_useTimingProtection = GGS_bool (true) ;
              }else{
              }
            }
          }
        }
      }
      { const GGS_basic_type _var_23130 = var_cas_cpu.reader_os (inLexique COMMA_SOURCE_FILE_AT_LINE (644)).reader_protectionhook (inLexique COMMA_SOURCE_FILE_AT_LINE (644)) ; // CAST instruction
        if (_var_23130.getPtr () != NULL) {
          macroValidPointer (_var_23130.getPtr ()) ;
          if (typeid (cPtr_bool_class) == typeid (* (_var_23130.getPtr ()))) {
            const GGS_bool_class var_cas_ph (_var_23130.getPtr ()) ;
            var_cas_useProtectionHook = var_cas_ph.reader_value (inLexique COMMA_SOURCE_FILE_AT_LINE (646)) ;
          }else{
          }
        }
      }
      const GGS_bool cond_23225 = (var_cas_useTimingProtection).operator_or (var_cas_useProtectionHook) ;
      if (cond_23225.isBuiltAndTrue ()) {
        var_cas_sc = GGS_uint64 (2ULL) ;
      }
      const GGS_bool cond_23496 = (function_memory_protection_on (inLexique, var_cas_cpu.reader_os (inLexique COMMA_SOURCE_FILE_AT_LINE (657)) COMMA_SOURCE_FILE_AT_LINE (657))).operator_or ((var_cas_cpu.reader_applis (inLexique COMMA_SOURCE_FILE_AT_LINE (657)).reader_count ()).operator_strictSup (GGS_uint (0U))) ;
      if (cond_23496.isBuiltAndTrue ()) {
        var_cas_sc = var_cas_sc.add_operation (inLexique, GGS_uint64 (2ULL) COMMA_SOURCE_FILE_AT_LINE (658)) ;
      }
    }else if (cond_23516.isBuiltAndFalse ()) {
      var_cas_sc = var_cas_setSC.reader_decimalUnsignedNumber (inLexique COMMA_SOURCE_FILE_AT_LINE (662)).reader_uint64 (inLexique COMMA_SOURCE_FILE_AT_LINE (662)) ;
    }
    ::routine_addUnsignedValue (inLexique,  var_cas_cfg,  function_lstringWith (inLexique, GGS_string ("SCALABILITYCLASS") COMMA_SOURCE_FILE_AT_LINE (664)),  var_cas_sc COMMA_SOURCE_FILE_AT_LINE (664)) ;
    ::routine_addBoolValue (inLexique,  var_cas_cfg,  function_lstringWith (inLexique, GGS_string ("USETIMINGPROTECTION") COMMA_SOURCE_FILE_AT_LINE (665)),  var_cas_useTimingProtection COMMA_SOURCE_FILE_AT_LINE (665)) ;
    ::routine_addBoolValue (inLexique,  var_cas_cfg,  function_lstringWith (inLexique, GGS_string ("USEPROTECTIONHOOK") COMMA_SOURCE_FILE_AT_LINE (666)),  var_cas_useProtectionHook COMMA_SOURCE_FILE_AT_LINE (666)) ;
    ::routine_addBoolValue (inLexique,  var_cas_cfg,  function_lstringWith (inLexique, GGS_string ("USEMEMORYPROTECTION") COMMA_SOURCE_FILE_AT_LINE (667)),  function_memory_protection_on (inLexique, var_cas_cpu.reader_os (inLexique COMMA_SOURCE_FILE_AT_LINE (667)) COMMA_SOURCE_FILE_AT_LINE (667)) COMMA_SOURCE_FILE_AT_LINE (667)) ;
  }
  #ifdef DEBUG_TRACE_ENABLED
    printf ("LEAVE routine_setScalabilityClass\n") ;
  #endif
}

//---------------------------------------------------------------------------*

