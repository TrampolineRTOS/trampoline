//---------------------------------------------------------------------------*
//                                                                           *
//                         File 'goil_types_os.cpp'                          *
//                    Generated by version version 2.1.4                     *
//                     january 10th, 2011, at 14h31'41"                      *
//                                                                           *
//---------------------------------------------------------------------------*

//--- START OF USER ZONE 1


//--- END OF USER ZONE 1

#include "version_libpm.h"
#if CURRENT_LIBPM_VERSION != 926
  #error "This file has been compiled with a version of GALGAS that uses libpm version 926, different than the current version (CURRENT_LIBPM_VERSION) of libpm"
#endif

//---------------------------------------------------------------------------*

#include "goil_types_os.h"
#include "galgas2/C_Compiler.h"
#include "galgas2/C_galgas_CLI_Options.h"

//---------------------------------------------------------------------------*

#include "goil_options.h"

//---------------------------------------------------------------------------*

#ifndef DO_NOT_GENERATE_CHECKINGS
  #define SOURCE_FILE_AT_LINE(line) "goil_types_os.gSemantics", line
  #define COMMA_SOURCE_FILE_AT_LINE(line) , SOURCE_FILE_AT_LINE(line)
#else
  #define SOURCE_FILE_AT_LINE(line) 
  #define COMMA_SOURCE_FILE_AT_LINE(line) 
#endif

//---------------------------------------------------------------------------*
//                                                                           *
//                           Routine 'set_method'                            *
//                                                                           *
//---------------------------------------------------------------------------*

void routine_set_5F_method (GALGAS_trace_5F_method & ioArgument_t,
                            GALGAS_trace_5F_method inArgument_s,
                            GALGAS_string inArgument_att,
                            C_Compiler * inCompiler
                            COMMA_UNUSED_LOCATION_ARGS) {
  //-------- @structuredCastInstructionForGeneration
  if (ioArgument_t.isValid ()) {
    if (ioArgument_t.dynamicTypeDescriptor () == & kTypeDescriptor_GALGAS_trace_5F_void) {
      //-------- @assignmentInstructionForGeneration
      ioArgument_t = inArgument_s ;
    }else{
      //-------- @errorInstructionForGeneration
      inCompiler->emitSemanticError (inArgument_s.reader_loc (SOURCE_FILE_AT_LINE (112)), GALGAS_string ("Redefinition of ").operator_concat (inArgument_att COMMA_SOURCE_FILE_AT_LINE (112)) COMMA_SOURCE_FILE_AT_LINE (112)) ;
      //-------- @errorInstructionForGeneration
      inCompiler->emitSemanticError (ioArgument_t.reader_loc (SOURCE_FILE_AT_LINE (113)), GALGAS_string ("was defined here") COMMA_SOURCE_FILE_AT_LINE (113)) ;
    }
  }
}


//---------------------------------------------------------------------------*
//                                                                           *
//                           Routine 'set_linker'                            *
//                                                                           *
//---------------------------------------------------------------------------*

void routine_set_5F_linker (GALGAS_basic_5F_type & ioArgument_l,
                            GALGAS_basic_5F_type inArgument_nl,
                            GALGAS_string inArgument_att,
                            C_Compiler * inCompiler
                            COMMA_UNUSED_LOCATION_ARGS) {
  //-------- @structuredCastInstructionForGeneration
  if (ioArgument_l.isValid ()) {
    if (ioArgument_l.dynamicTypeDescriptor () == & kTypeDescriptor_GALGAS_void) {
      //-------- @assignmentInstructionForGeneration
      ioArgument_l = inArgument_nl ;
    }else{
      //-------- @errorInstructionForGeneration
      inCompiler->emitSemanticError (inArgument_nl.reader_location (SOURCE_FILE_AT_LINE (133)), GALGAS_string ("Redefinition of ").operator_concat (inArgument_att COMMA_SOURCE_FILE_AT_LINE (133)) COMMA_SOURCE_FILE_AT_LINE (133)) ;
      //-------- @errorInstructionForGeneration
      inCompiler->emitSemanticError (ioArgument_l.reader_location (SOURCE_FILE_AT_LINE (134)), GALGAS_string ("was defined here") COMMA_SOURCE_FILE_AT_LINE (134)) ;
    }
  }
}


//---------------------------------------------------------------------------*
//                                                                           *
//                        Function 'link_script_name'                        *
//                                                                           *
//---------------------------------------------------------------------------*

GALGAS_string function_link_5F_script_5F_name (const GALGAS_basic_5F_type & constinArgument_mm,
                                               C_Compiler * /* inCompiler */
                                               COMMA_UNUSED_LOCATION_ARGS) {
  GALGAS_string result_string ; // Returned variable
  //-------- @structuredCastInstructionForGeneration
  if (constinArgument_mm.isValid ()) {
    if (constinArgument_mm.dynamicTypeDescriptor () == & kTypeDescriptor_GALGAS_memmap_5F_true) {
      GALGAS_memmap_5F_true cast_3578_m ((cPtr_memmap_5F_true *) constinArgument_mm.ptr ()) ;
      //-------- @structuredCastInstructionForGeneration
      if (cast_3578_m.reader_linker (SOURCE_FILE_AT_LINE (153)).isValid ()) {
        if (cast_3578_m.reader_linker (SOURCE_FILE_AT_LINE (153)).dynamicTypeDescriptor () == & kTypeDescriptor_GALGAS_yes_5F_linker) {
          GALGAS_yes_5F_linker cast_3629_l ((cPtr_yes_5F_linker *) cast_3578_m.reader_linker (SOURCE_FILE_AT_LINE (153)).ptr ()) ;
          //-------- @assignmentInstructionForGeneration
          result_string = cast_3629_l.reader_script (SOURCE_FILE_AT_LINE (155)).reader_string (SOURCE_FILE_AT_LINE (155)) ;
        }else{
          //-------- @assignmentInstructionForGeneration
          result_string = GALGAS_string::makeEmptyString () ;
        }
      }
    }else{
      //-------- @assignmentInstructionForGeneration
      result_string = GALGAS_string::makeEmptyString () ;
    }
  }
//---
  return result_string ;
}


//---------------------------------------------------------------------------*
//  Function introspection                                                   *
//---------------------------------------------------------------------------*

static const C_galgas_type_descriptor * functionArgs_link_5F_script_5F_name [2] = {
  & kTypeDescriptor_GALGAS_basic_5F_type,
  NULL
} ;

//---------------------------------------------------------------------------*

static GALGAS_object functionWithGenericHeader_link_5F_script_5F_name (C_Compiler * inCompiler,
                                                                       const cObjectArray & inEffectiveParameterArray,
                                                                       const GALGAS_location & inErrorLocation
                                                                       COMMA_LOCATION_ARGS) {
  const GALGAS_basic_5F_type operand0 = GALGAS_basic_5F_type::extractObject (inEffectiveParameterArray.objectAtIndex (0 COMMA_HERE), inCompiler, inErrorLocation COMMA_THERE) ;
  return function_link_5F_script_5F_name (operand0, inCompiler COMMA_THERE).reader_object (THERE) ;
}

//---------------------------------------------------------------------------*

C_galgas_function_descriptor functionDescriptor_link_5F_script_5F_name ("link_script_name",
                                                                        functionWithGenericHeader_link_5F_script_5F_name,
                                                                        & kTypeDescriptor_GALGAS_string,
                                                                        1,
                                                                        functionArgs_link_5F_script_5F_name) ;

//---------------------------------------------------------------------------*
//                                                                           *
//                           Routine 'set_memmap'                            *
//                                                                           *
//---------------------------------------------------------------------------*

void routine_set_5F_memmap (GALGAS_basic_5F_type & ioArgument_m,
                            GALGAS_basic_5F_type inArgument_nm,
                            GALGAS_string inArgument_att,
                            C_Compiler * inCompiler
                            COMMA_UNUSED_LOCATION_ARGS) {
  //-------- @structuredCastInstructionForGeneration
  if (ioArgument_m.isValid ()) {
    if (ioArgument_m.dynamicTypeDescriptor () == & kTypeDescriptor_GALGAS_void) {
      //-------- @assignmentInstructionForGeneration
      ioArgument_m = inArgument_nm ;
    }else{
      //-------- @errorInstructionForGeneration
      inCompiler->emitSemanticError (inArgument_nm.reader_location (SOURCE_FILE_AT_LINE (174)), GALGAS_string ("Redefinition of ").operator_concat (inArgument_att COMMA_SOURCE_FILE_AT_LINE (174)) COMMA_SOURCE_FILE_AT_LINE (174)) ;
      //-------- @errorInstructionForGeneration
      inCompiler->emitSemanticError (ioArgument_m.reader_location (SOURCE_FILE_AT_LINE (175)), GALGAS_string ("was defined here") COMMA_SOURCE_FILE_AT_LINE (175)) ;
    }
  }
}


//---------------------------------------------------------------------------*
//                                                                           *
//                        Function 'applicationName'                         *
//                                                                           *
//---------------------------------------------------------------------------*

GALGAS_lstring function_applicationName (const GALGAS_os_5F_obj & constinArgument_os,
                                         C_Compiler * inCompiler
                                         COMMA_UNUSED_LOCATION_ARGS) {
  GALGAS_lstring result_lstring ; // Returned variable
  //-------- @assignmentInstructionForGeneration
  result_lstring = constinArgument_os.reader_app_5F_name (SOURCE_FILE_AT_LINE (210)) ;
  //-------- @ifInstructionForGeneration
  const enumGalgasBool test_0 = GALGAS_bool (kIsEqual, result_lstring.reader_string (SOURCE_FILE_AT_LINE (211)).objectCompare (GALGAS_string::makeEmptyString ())).boolEnum () ;
  if (kBoolTrue == test_0) {
    //-------- @assignmentInstructionForGeneration
    result_lstring = function_lstringWith (GALGAS_string ("trampoline"), inCompiler COMMA_SOURCE_FILE_AT_LINE (212)) ;
  }
//---
  return result_lstring ;
}


//---------------------------------------------------------------------------*
//  Function introspection                                                   *
//---------------------------------------------------------------------------*

static const C_galgas_type_descriptor * functionArgs_applicationName [2] = {
  & kTypeDescriptor_GALGAS_os_5F_obj,
  NULL
} ;

//---------------------------------------------------------------------------*

static GALGAS_object functionWithGenericHeader_applicationName (C_Compiler * inCompiler,
                                                                const cObjectArray & inEffectiveParameterArray,
                                                                const GALGAS_location & inErrorLocation
                                                                COMMA_LOCATION_ARGS) {
  const GALGAS_os_5F_obj operand0 = GALGAS_os_5F_obj::extractObject (inEffectiveParameterArray.objectAtIndex (0 COMMA_HERE), inCompiler, inErrorLocation COMMA_THERE) ;
  return function_applicationName (operand0, inCompiler COMMA_THERE).reader_object (THERE) ;
}

//---------------------------------------------------------------------------*

C_galgas_function_descriptor functionDescriptor_applicationName ("applicationName",
                                                                 functionWithGenericHeader_applicationName,
                                                                 & kTypeDescriptor_GALGAS_lstring,
                                                                 1,
                                                                 functionArgs_applicationName) ;

//---------------------------------------------------------------------------*
//                                                                           *
//                       Function 'memory_protection'                        *
//                                                                           *
//---------------------------------------------------------------------------*

GALGAS_basic_5F_type function_memory_5F_protection (GALGAS_os_5F_obj inArgument_os,
                                                    C_Compiler * inCompiler
                                                    COMMA_UNUSED_LOCATION_ARGS) {
  GALGAS_basic_5F_type result_basic_5F_type ; // Returned variable
  //-------- @structuredCastInstructionForGeneration
  if (inArgument_os.reader_memmap (SOURCE_FILE_AT_LINE (220)).isValid ()) {
    if (inArgument_os.reader_memmap (SOURCE_FILE_AT_LINE (220)).dynamicTypeDescriptor () == & kTypeDescriptor_GALGAS_memmap_5F_true) {
      GALGAS_memmap_5F_true cast_5757_mm ((cPtr_memmap_5F_true *) inArgument_os.reader_memmap (SOURCE_FILE_AT_LINE (220)).ptr ()) ;
      //-------- @assignmentInstructionForGeneration
      result_basic_5F_type = cast_5757_mm.reader_memory_5F_prot (SOURCE_FILE_AT_LINE (222)) ;
    }else{
      //-------- @assignmentInstructionForGeneration
      result_basic_5F_type = GALGAS_bool_5F_class::constructor_new (inCompiler->here (), GALGAS_bool (false) COMMA_SOURCE_FILE_AT_LINE (224)) ;
    }
  }
//---
  return result_basic_5F_type ;
}


//---------------------------------------------------------------------------*
//  Function introspection                                                   *
//---------------------------------------------------------------------------*

static const C_galgas_type_descriptor * functionArgs_memory_5F_protection [2] = {
  & kTypeDescriptor_GALGAS_os_5F_obj,
  NULL
} ;

//---------------------------------------------------------------------------*

static GALGAS_object functionWithGenericHeader_memory_5F_protection (C_Compiler * inCompiler,
                                                                     const cObjectArray & inEffectiveParameterArray,
                                                                     const GALGAS_location & inErrorLocation
                                                                     COMMA_LOCATION_ARGS) {
  const GALGAS_os_5F_obj operand0 = GALGAS_os_5F_obj::extractObject (inEffectiveParameterArray.objectAtIndex (0 COMMA_HERE), inCompiler, inErrorLocation COMMA_THERE) ;
  return function_memory_5F_protection (operand0, inCompiler COMMA_THERE).reader_object (THERE) ;
}

//---------------------------------------------------------------------------*

C_galgas_function_descriptor functionDescriptor_memory_5F_protection ("memory_protection",
                                                                      functionWithGenericHeader_memory_5F_protection,
                                                                      & kTypeDescriptor_GALGAS_basic_5F_type,
                                                                      1,
                                                                      functionArgs_memory_5F_protection) ;

//---------------------------------------------------------------------------*
//                                                                           *
//                      Function 'memory_protection_on'                      *
//                                                                           *
//---------------------------------------------------------------------------*

GALGAS_bool function_memory_5F_protection_5F_on (GALGAS_os_5F_obj inArgument_os,
                                                 C_Compiler * /* inCompiler */
                                                 COMMA_UNUSED_LOCATION_ARGS) {
  GALGAS_bool result_bool ; // Returned variable
  //-------- @structuredCastInstructionForGeneration
  if (inArgument_os.reader_memmap (SOURCE_FILE_AT_LINE (232)).isValid ()) {
    if (inArgument_os.reader_memmap (SOURCE_FILE_AT_LINE (232)).dynamicTypeDescriptor () == & kTypeDescriptor_GALGAS_memmap_5F_true) {
      GALGAS_memmap_5F_true cast_5970_mm ((cPtr_memmap_5F_true *) inArgument_os.reader_memmap (SOURCE_FILE_AT_LINE (232)).ptr ()) ;
      //-------- @structuredCastInstructionForGeneration
      if (cast_5970_mm.reader_memory_5F_prot (SOURCE_FILE_AT_LINE (234)).isValid ()) {
        if (cast_5970_mm.reader_memory_5F_prot (SOURCE_FILE_AT_LINE (234)).dynamicTypeDescriptor () == & kTypeDescriptor_GALGAS_bool_5F_class) {
          GALGAS_bool_5F_class cast_6027_b ((cPtr_bool_5F_class *) cast_5970_mm.reader_memory_5F_prot (SOURCE_FILE_AT_LINE (234)).ptr ()) ;
          //-------- @assignmentInstructionForGeneration
          result_bool = cast_6027_b.reader_value (SOURCE_FILE_AT_LINE (236)) ;
        }else{
          //-------- @assignmentInstructionForGeneration
          result_bool = GALGAS_bool (false) ;
        }
      }
    }else{
      //-------- @assignmentInstructionForGeneration
      result_bool = GALGAS_bool (false) ;
    }
  }
//---
  return result_bool ;
}


//---------------------------------------------------------------------------*
//  Function introspection                                                   *
//---------------------------------------------------------------------------*

static const C_galgas_type_descriptor * functionArgs_memory_5F_protection_5F_on [2] = {
  & kTypeDescriptor_GALGAS_os_5F_obj,
  NULL
} ;

//---------------------------------------------------------------------------*

static GALGAS_object functionWithGenericHeader_memory_5F_protection_5F_on (C_Compiler * inCompiler,
                                                                           const cObjectArray & inEffectiveParameterArray,
                                                                           const GALGAS_location & inErrorLocation
                                                                           COMMA_LOCATION_ARGS) {
  const GALGAS_os_5F_obj operand0 = GALGAS_os_5F_obj::extractObject (inEffectiveParameterArray.objectAtIndex (0 COMMA_HERE), inCompiler, inErrorLocation COMMA_THERE) ;
  return function_memory_5F_protection_5F_on (operand0, inCompiler COMMA_THERE).reader_object (THERE) ;
}

//---------------------------------------------------------------------------*

C_galgas_function_descriptor functionDescriptor_memory_5F_protection_5F_on ("memory_protection_on",
                                                                            functionWithGenericHeader_memory_5F_protection_5F_on,
                                                                            & kTypeDescriptor_GALGAS_bool,
                                                                            1,
                                                                            functionArgs_memory_5F_protection_5F_on) ;

//---------------------------------------------------------------------------*
//                                                                           *
//                         Function 'memory_mapping'                         *
//                                                                           *
//---------------------------------------------------------------------------*

GALGAS_bool function_memory_5F_mapping (GALGAS_os_5F_obj inArgument_os,
                                        C_Compiler * /* inCompiler */
                                        COMMA_UNUSED_LOCATION_ARGS) {
  GALGAS_bool result_bool ; // Returned variable
  //-------- @structuredCastInstructionForGeneration
  if (inArgument_os.reader_memmap (SOURCE_FILE_AT_LINE (249)).isValid ()) {
    if (inArgument_os.reader_memmap (SOURCE_FILE_AT_LINE (249)).dynamicTypeDescriptor () == & kTypeDescriptor_GALGAS_memmap_5F_true) {
      //-------- @assignmentInstructionForGeneration
      result_bool = GALGAS_bool (true) ;
    }else{
      //-------- @assignmentInstructionForGeneration
      result_bool = GALGAS_bool (false) ;
    }
  }
//---
  return result_bool ;
}


//---------------------------------------------------------------------------*
//  Function introspection                                                   *
//---------------------------------------------------------------------------*

static const C_galgas_type_descriptor * functionArgs_memory_5F_mapping [2] = {
  & kTypeDescriptor_GALGAS_os_5F_obj,
  NULL
} ;

//---------------------------------------------------------------------------*

static GALGAS_object functionWithGenericHeader_memory_5F_mapping (C_Compiler * inCompiler,
                                                                  const cObjectArray & inEffectiveParameterArray,
                                                                  const GALGAS_location & inErrorLocation
                                                                  COMMA_LOCATION_ARGS) {
  const GALGAS_os_5F_obj operand0 = GALGAS_os_5F_obj::extractObject (inEffectiveParameterArray.objectAtIndex (0 COMMA_HERE), inCompiler, inErrorLocation COMMA_THERE) ;
  return function_memory_5F_mapping (operand0, inCompiler COMMA_THERE).reader_object (THERE) ;
}

//---------------------------------------------------------------------------*

C_galgas_function_descriptor functionDescriptor_memory_5F_mapping ("memory_mapping",
                                                                   functionWithGenericHeader_memory_5F_mapping,
                                                                   & kTypeDescriptor_GALGAS_bool,
                                                                   1,
                                                                   functionArgs_memory_5F_mapping) ;

//---------------------------------------------------------------------------*
//                                                                           *
//                            Function 'compiler'                            *
//                                                                           *
//---------------------------------------------------------------------------*

GALGAS_string function_compiler (const GALGAS_basic_5F_type & constinArgument_os_5F_memmap,
                                 C_Compiler * inCompiler
                                 COMMA_UNUSED_LOCATION_ARGS) {
  GALGAS_string result_string ; // Returned variable
  //-------- @structuredCastInstructionForGeneration
  if (constinArgument_os_5F_memmap.isValid ()) {
    if (constinArgument_os_5F_memmap.dynamicTypeDescriptor () == & kTypeDescriptor_GALGAS_memmap_5F_true) {
      GALGAS_memmap_5F_true cast_6518_s ((cPtr_memmap_5F_true *) constinArgument_os_5F_memmap.ptr ()) ;
      //-------- @assignmentInstructionForGeneration
      result_string = cast_6518_s.reader_compiler (SOURCE_FILE_AT_LINE (267)).reader_string (SOURCE_FILE_AT_LINE (267)) ;
      //-------- @assignmentInstructionForGeneration
      result_string = GALGAS_string ("compiler/").operator_concat (result_string COMMA_SOURCE_FILE_AT_LINE (268)) ;
      //-------- @localVariableOrConstantDeclarationWithSourceExpressionForGeneration
      GALGAS_string var_rtd = function_rootTemplatesDirectory (inCompiler COMMA_SOURCE_FILE_AT_LINE (269)) ;
      //-------- @ifInstructionForGeneration
      const enumGalgasBool test_0 = GALGAS_bool (kIsNotEqual, var_rtd.objectCompare (GALGAS_string::makeEmptyString ())).boolEnum () ;
      if (kBoolTrue == test_0) {
        //-------- @localVariableOrConstantDeclarationWithSourceExpressionForGeneration
        GALGAS_string var_path = var_rtd.operator_concat (GALGAS_string ("/") COMMA_SOURCE_FILE_AT_LINE (271)).operator_concat (result_string COMMA_SOURCE_FILE_AT_LINE (271)) ;
        //-------- @ifInstructionForGeneration
        const enumGalgasBool test_1 = var_path.reader_directoryExists (SOURCE_FILE_AT_LINE (272)).operator_not (SOURCE_FILE_AT_LINE (272)).boolEnum () ;
        if (kBoolTrue == test_1) {
          //-------- @warningInstructionForGeneration
          inCompiler->emitSemanticWarning (inCompiler->here (), GALGAS_string ("no compiler found at path: ").operator_concat (var_path COMMA_SOURCE_FILE_AT_LINE (273)) COMMA_SOURCE_FILE_AT_LINE (273)) ;
          //-------- @assignmentInstructionForGeneration
          result_string = GALGAS_string::makeEmptyString () ;
        }
      }else if (kBoolFalse == test_0) {
        //-------- @assignmentInstructionForGeneration
        result_string = GALGAS_string::makeEmptyString () ;
      }
    }else{
      //-------- @assignmentInstructionForGeneration
      result_string = GALGAS_string::makeEmptyString () ;
    }
  }
//---
  return result_string ;
}


//---------------------------------------------------------------------------*
//  Function introspection                                                   *
//---------------------------------------------------------------------------*

static const C_galgas_type_descriptor * functionArgs_compiler [2] = {
  & kTypeDescriptor_GALGAS_basic_5F_type,
  NULL
} ;

//---------------------------------------------------------------------------*

static GALGAS_object functionWithGenericHeader_compiler (C_Compiler * inCompiler,
                                                         const cObjectArray & inEffectiveParameterArray,
                                                         const GALGAS_location & inErrorLocation
                                                         COMMA_LOCATION_ARGS) {
  const GALGAS_basic_5F_type operand0 = GALGAS_basic_5F_type::extractObject (inEffectiveParameterArray.objectAtIndex (0 COMMA_HERE), inCompiler, inErrorLocation COMMA_THERE) ;
  return function_compiler (operand0, inCompiler COMMA_THERE).reader_object (THERE) ;
}

//---------------------------------------------------------------------------*

C_galgas_function_descriptor functionDescriptor_compiler ("compiler",
                                                          functionWithGenericHeader_compiler,
                                                          & kTypeDescriptor_GALGAS_string,
                                                          1,
                                                          functionArgs_compiler) ;

//---------------------------------------------------------------------------*
//                                                                           *
//                             Function 'linker'                             *
//                                                                           *
//---------------------------------------------------------------------------*

GALGAS_string function_linker (const GALGAS_basic_5F_type & constinArgument_os_5F_memmap,
                               C_Compiler * inCompiler
                               COMMA_UNUSED_LOCATION_ARGS) {
  GALGAS_string result_string ; // Returned variable
  //-------- @structuredCastInstructionForGeneration
  if (constinArgument_os_5F_memmap.isValid ()) {
    if (constinArgument_os_5F_memmap.dynamicTypeDescriptor () == & kTypeDescriptor_GALGAS_memmap_5F_true) {
      GALGAS_memmap_5F_true cast_7092_s ((cPtr_memmap_5F_true *) constinArgument_os_5F_memmap.ptr ()) ;
      //-------- @structuredCastInstructionForGeneration
      if (cast_7092_s.reader_linker (SOURCE_FILE_AT_LINE (293)).isValid ()) {
        if (cast_7092_s.reader_linker (SOURCE_FILE_AT_LINE (293)).dynamicTypeDescriptor () == & kTypeDescriptor_GALGAS_no_5F_linker) {
          //-------- @assignmentInstructionForGeneration
          result_string = GALGAS_string::makeEmptyString () ;
        }else if (cast_7092_s.reader_linker (SOURCE_FILE_AT_LINE (293)).dynamicTypeDescriptor () == & kTypeDescriptor_GALGAS_yes_5F_linker) {
          GALGAS_yes_5F_linker cast_7179_l ((cPtr_yes_5F_linker *) cast_7092_s.reader_linker (SOURCE_FILE_AT_LINE (293)).ptr ()) ;
          //-------- @assignmentInstructionForGeneration
          result_string = cast_7179_l.reader_linker (SOURCE_FILE_AT_LINE (295)).reader_string (SOURCE_FILE_AT_LINE (295)) ;
        }else{
          //-------- @assignmentInstructionForGeneration
          result_string = GALGAS_string::makeEmptyString () ;
        }
      }
    }else{
      //-------- @assignmentInstructionForGeneration
      result_string = GALGAS_string::makeEmptyString () ;
    }
  }
  //-------- @ifInstructionForGeneration
  const enumGalgasBool test_0 = GALGAS_bool (kIsNotEqual, result_string.objectCompare (GALGAS_string::makeEmptyString ())).boolEnum () ;
  if (kBoolTrue == test_0) {
    //-------- @assignmentInstructionForGeneration
    result_string = GALGAS_string ("linker/").operator_concat (result_string COMMA_SOURCE_FILE_AT_LINE (302)) ;
    //-------- @localVariableOrConstantDeclarationWithSourceExpressionForGeneration
    GALGAS_string var_rtd = function_rootTemplatesDirectory (inCompiler COMMA_SOURCE_FILE_AT_LINE (303)) ;
    //-------- @ifInstructionForGeneration
    const enumGalgasBool test_1 = GALGAS_bool (kIsNotEqual, var_rtd.objectCompare (GALGAS_string::makeEmptyString ())).boolEnum () ;
    if (kBoolTrue == test_1) {
      //-------- @localVariableOrConstantDeclarationWithSourceExpressionForGeneration
      GALGAS_string var_path = var_rtd.operator_concat (GALGAS_string ("/") COMMA_SOURCE_FILE_AT_LINE (305)).operator_concat (result_string COMMA_SOURCE_FILE_AT_LINE (305)) ;
      //-------- @ifInstructionForGeneration
      const enumGalgasBool test_2 = var_path.reader_directoryExists (SOURCE_FILE_AT_LINE (306)).operator_not (SOURCE_FILE_AT_LINE (306)).boolEnum () ;
      if (kBoolTrue == test_2) {
        //-------- @assignmentInstructionForGeneration
        result_string = GALGAS_string::makeEmptyString () ;
      }
    }else if (kBoolFalse == test_1) {
      //-------- @assignmentInstructionForGeneration
      result_string = GALGAS_string::makeEmptyString () ;
    }
  }
//---
  return result_string ;
}


//---------------------------------------------------------------------------*
//  Function introspection                                                   *
//---------------------------------------------------------------------------*

static const C_galgas_type_descriptor * functionArgs_linker [2] = {
  & kTypeDescriptor_GALGAS_basic_5F_type,
  NULL
} ;

//---------------------------------------------------------------------------*

static GALGAS_object functionWithGenericHeader_linker (C_Compiler * inCompiler,
                                                       const cObjectArray & inEffectiveParameterArray,
                                                       const GALGAS_location & inErrorLocation
                                                       COMMA_LOCATION_ARGS) {
  const GALGAS_basic_5F_type operand0 = GALGAS_basic_5F_type::extractObject (inEffectiveParameterArray.objectAtIndex (0 COMMA_HERE), inCompiler, inErrorLocation COMMA_THERE) ;
  return function_linker (operand0, inCompiler COMMA_THERE).reader_object (THERE) ;
}

//---------------------------------------------------------------------------*

C_galgas_function_descriptor functionDescriptor_linker ("linker",
                                                        functionWithGenericHeader_linker,
                                                        & kTypeDescriptor_GALGAS_string,
                                                        1,
                                                        functionArgs_linker) ;

//---------------------------------------------------------------------------*
//                                                                           *
//                          Function 'void_os_obj'                           *
//                                                                           *
//---------------------------------------------------------------------------*

GALGAS_os_5F_obj function_void_5F_os_5F_obj (C_Compiler * inCompiler
                                             COMMA_UNUSED_LOCATION_ARGS) {
  GALGAS_os_5F_obj result_os_5F_obj ; // Returned variable
  //-------- @localVariableOrConstantDeclarationWithSourceExpressionForGeneration
  GALGAS_void var_void_5F_obj = GALGAS_void::constructor_new (inCompiler->here () COMMA_SOURCE_FILE_AT_LINE (318)) ;
  //-------- @localVariableOrConstantDeclarationWithSourceExpressionForGeneration
  GALGAS_lstring var_emptyString = GALGAS_lstring::constructor_new (GALGAS_string::makeEmptyString (), inCompiler->here () COMMA_SOURCE_FILE_AT_LINE (319)) ;
  //-------- @assignmentInstructionForGeneration
  result_os_5F_obj = GALGAS_os_5F_obj::constructor_new (var_emptyString, var_emptyString, var_void_5F_obj, var_void_5F_obj, var_void_5F_obj, var_void_5F_obj, var_void_5F_obj, var_void_5F_obj, var_emptyString, var_void_5F_obj, var_void_5F_obj, var_void_5F_obj, var_void_5F_obj, var_void_5F_obj, var_void_5F_obj, var_void_5F_obj, GALGAS_lstringlist::constructor_emptyList (SOURCE_FILE_AT_LINE (337)), var_emptyString, var_emptyString, var_emptyString, GALGAS_lstringlist::constructor_emptyList (SOURCE_FILE_AT_LINE (341)), GALGAS_lstringlist::constructor_emptyList (SOURCE_FILE_AT_LINE (342)), GALGAS_lstringlist::constructor_emptyList (SOURCE_FILE_AT_LINE (343)), GALGAS_lstringlist::constructor_emptyList (SOURCE_FILE_AT_LINE (344)), var_emptyString, var_emptyString, GALGAS_trace::constructor_new (inCompiler->here () COMMA_SOURCE_FILE_AT_LINE (347)), GALGAS_ident_5F_map::constructor_emptyMap (SOURCE_FILE_AT_LINE (348)) COMMA_SOURCE_FILE_AT_LINE (320)) ;
//---
  return result_os_5F_obj ;
}


//---------------------------------------------------------------------------*
//  Function introspection                                                   *
//---------------------------------------------------------------------------*

static const C_galgas_type_descriptor * functionArgs_void_5F_os_5F_obj [1] = {
  NULL
} ;

//---------------------------------------------------------------------------*

static GALGAS_object functionWithGenericHeader_void_5F_os_5F_obj (C_Compiler * inCompiler,
                                                                  const cObjectArray & /* inEffectiveParameterArray */,
                                                                  const GALGAS_location & /* inErrorLocation */
                                                                  COMMA_LOCATION_ARGS) {
  return function_void_5F_os_5F_obj (inCompiler COMMA_THERE).reader_object (THERE) ;
}

//---------------------------------------------------------------------------*

C_galgas_function_descriptor functionDescriptor_void_5F_os_5F_obj ("void_os_obj",
                                                                   functionWithGenericHeader_void_5F_os_5F_obj,
                                                                   & kTypeDescriptor_GALGAS_os_5F_obj,
                                                                   0,
                                                                   functionArgs_void_5F_os_5F_obj) ;

//---------------------------------------------------------------------------*

enumComparisonResult GALGAS_memmap_5F_false::objectCompare (const GALGAS_memmap_5F_false & inOperand) const {
  return (isValid () && inOperand.isValid ()) ? kOperandEqual : kOperandNotValid ;
}


//---------------------------------------------------------------------------*

GALGAS_memmap_5F_false::GALGAS_memmap_5F_false (void) :
GALGAS_basic_5F_type () {
}

//---------------------------------------------------------------------------*

GALGAS_memmap_5F_false::GALGAS_memmap_5F_false (const cPtr_memmap_5F_false * inSourcePtr) :
GALGAS_basic_5F_type (inSourcePtr) {
  macroNullOrValidSharedObject (inSourcePtr, const cPtr_memmap_5F_false) ;
}

//---------------------------------------------------------------------------*

GALGAS_memmap_5F_false GALGAS_memmap_5F_false::constructor_new (const GALGAS_location & inAttribute_location
                                                                COMMA_LOCATION_ARGS) {
  GALGAS_memmap_5F_false result ;
  if (inAttribute_location.isValid ()) {
    macroMyNew (result.mObjectPtr, cPtr_memmap_5F_false (inAttribute_location COMMA_THERE)) ;
  }
  return result ;
}

//---------------------------------------------------------------------------*

void GALGAS_memmap_5F_false::insulate (LOCATION_ARGS) {
  if (isValid () && (mObjectPtr->retainCount () > 1)) {
    cPtr_memmap_5F_false * p = (cPtr_memmap_5F_false *) mObjectPtr ;
    macroValidSharedObject (p, cPtr_memmap_5F_false) ;
    cPtr_memmap_5F_false * r = NULL ;
    macroMyNew (r, cPtr_memmap_5F_false (p->mAttribute_location COMMA_THERE)) ;
    macroAssignSharedObject (mObjectPtr, r) ;
    macroDetachSharedObject (r) ;
  }
}

//---------------------------------------------------------------------------*
//                   Pointer class for @memmap_false class                   *
//---------------------------------------------------------------------------*

cPtr_memmap_5F_false::cPtr_memmap_5F_false (const GALGAS_location & in_location
                                            COMMA_LOCATION_ARGS) :
cPtr_basic_5F_type (in_location COMMA_THERE) {
}

//---------------------------------------------------------------------------*

const C_galgas_type_descriptor * cPtr_memmap_5F_false::classDescriptor (void) const {
  return & kTypeDescriptor_GALGAS_memmap_5F_false ;
}

void cPtr_memmap_5F_false::description (C_String & ioString,
                                        const PMSInt32 inIndentation) const {
  ioString << "[@memmap_false:" ;
  mAttribute_location.description (ioString, inIndentation+1) ;
  ioString << "]" ;
}



//---------------------------------------------------------------------------*
//                                                                           *
//                            @memmap_false type                             *
//                                                                           *
//---------------------------------------------------------------------------*

const C_galgas_type_descriptor
kTypeDescriptor_GALGAS_memmap_5F_false ("memmap_false",
                                        & kTypeDescriptor_GALGAS_basic_5F_type) ;

//---------------------------------------------------------------------------*

const C_galgas_type_descriptor * GALGAS_memmap_5F_false::staticTypeDescriptor (void) const {
  return & kTypeDescriptor_GALGAS_memmap_5F_false ;
}

//---------------------------------------------------------------------------*

AC_GALGAS_root * GALGAS_memmap_5F_false::clonedObject (void) const {
  AC_GALGAS_root * result = NULL ;
  if (isValid ()) {
    macroMyNew (result, GALGAS_memmap_5F_false (*this)) ;
  }
  return result ;
}

//---------------------------------------------------------------------------*

GALGAS_memmap_5F_false GALGAS_memmap_5F_false::extractObject (const GALGAS_object & inObject,
                                                              C_Compiler * inCompiler,
                                                              const GALGAS_location & inErrorLocation
                                                              COMMA_LOCATION_ARGS) {
  GALGAS_memmap_5F_false result ;
  const GALGAS_memmap_5F_false * p = (const GALGAS_memmap_5F_false *) inObject.embeddedObject () ;
  if (NULL != p) {
    if (NULL != dynamic_cast <const GALGAS_memmap_5F_false *> (p)) {
      result = *p ;
    }else{
      inCompiler->extractObjectError (inErrorLocation, "memmap_false", p->dynamicTypeDescriptor () COMMA_THERE) ;
    }  
  }
  return result ;
}

//---------------------------------------------------------------------------*

enumComparisonResult GALGAS_memmap_5F_true::objectCompare (const GALGAS_memmap_5F_true & inOperand) const {
  enumComparisonResult result = GALGAS_basic_5F_type::objectCompare (inOperand) ;
  const cPtr_memmap_5F_true * p = (const cPtr_memmap_5F_true *) mObjectPtr ;
  macroNullOrValidSharedObject (p, const cPtr_memmap_5F_true) ;
  const cPtr_memmap_5F_true * q = (const cPtr_memmap_5F_true *) inOperand.mObjectPtr ;
  macroNullOrValidSharedObject (q, const cPtr_memmap_5F_true) ;
  if (kOperandEqual == result) {
    result = p->mAttribute_compiler.objectCompare (q->mAttribute_compiler) ;
  }
  if (kOperandEqual == result) {
    result = p->mAttribute_assembler.objectCompare (q->mAttribute_assembler) ;
  }
  if (kOperandEqual == result) {
    result = p->mAttribute_linker.objectCompare (q->mAttribute_linker) ;
  }
  if (kOperandEqual == result) {
    result = p->mAttribute_memory_5F_prot.objectCompare (q->mAttribute_memory_5F_prot) ;
  }
  return result ;
}


//---------------------------------------------------------------------------*

GALGAS_memmap_5F_true::GALGAS_memmap_5F_true (void) :
GALGAS_basic_5F_type () {
}

//---------------------------------------------------------------------------*

GALGAS_memmap_5F_true::GALGAS_memmap_5F_true (const cPtr_memmap_5F_true * inSourcePtr) :
GALGAS_basic_5F_type (inSourcePtr) {
  macroNullOrValidSharedObject (inSourcePtr, const cPtr_memmap_5F_true) ;
}

//---------------------------------------------------------------------------*

GALGAS_memmap_5F_true GALGAS_memmap_5F_true::constructor_new (const GALGAS_location & inAttribute_location,
                                                              const GALGAS_lstring & inAttribute_compiler,
                                                              const GALGAS_lstring & inAttribute_assembler,
                                                              const GALGAS_basic_5F_type & inAttribute_linker,
                                                              const GALGAS_basic_5F_type & inAttribute_memory_5F_prot
                                                              COMMA_LOCATION_ARGS) {
  GALGAS_memmap_5F_true result ;
  if (inAttribute_location.isValid () && inAttribute_compiler.isValid () && inAttribute_assembler.isValid () && inAttribute_linker.isValid () && inAttribute_memory_5F_prot.isValid ()) {
    macroMyNew (result.mObjectPtr, cPtr_memmap_5F_true (inAttribute_location, inAttribute_compiler, inAttribute_assembler, inAttribute_linker, inAttribute_memory_5F_prot COMMA_THERE)) ;
  }
  return result ;
}

//---------------------------------------------------------------------------*

void GALGAS_memmap_5F_true::insulate (LOCATION_ARGS) {
  if (isValid () && (mObjectPtr->retainCount () > 1)) {
    cPtr_memmap_5F_true * p = (cPtr_memmap_5F_true *) mObjectPtr ;
    macroValidSharedObject (p, cPtr_memmap_5F_true) ;
    cPtr_memmap_5F_true * r = NULL ;
    macroMyNew (r, cPtr_memmap_5F_true (p->mAttribute_location, p->mAttribute_compiler, p->mAttribute_assembler, p->mAttribute_linker, p->mAttribute_memory_5F_prot COMMA_THERE)) ;
    macroAssignSharedObject (mObjectPtr, r) ;
    macroDetachSharedObject (r) ;
  }
}

//---------------------------------------------------------------------------*

GALGAS_lstring GALGAS_memmap_5F_true::reader_compiler (UNUSED_LOCATION_ARGS) const {
  GALGAS_lstring result ;
  if (NULL != mObjectPtr) {
    const cPtr_memmap_5F_true * p = (const cPtr_memmap_5F_true *) mObjectPtr ;
    macroValidSharedObject (p, const cPtr_memmap_5F_true) ;
    result = p->mAttribute_compiler ;
  }
  return result ;
}

//---------------------------------------------------------------------------*

GALGAS_lstring GALGAS_memmap_5F_true::reader_assembler (UNUSED_LOCATION_ARGS) const {
  GALGAS_lstring result ;
  if (NULL != mObjectPtr) {
    const cPtr_memmap_5F_true * p = (const cPtr_memmap_5F_true *) mObjectPtr ;
    macroValidSharedObject (p, const cPtr_memmap_5F_true) ;
    result = p->mAttribute_assembler ;
  }
  return result ;
}

//---------------------------------------------------------------------------*

GALGAS_basic_5F_type GALGAS_memmap_5F_true::reader_linker (UNUSED_LOCATION_ARGS) const {
  GALGAS_basic_5F_type result ;
  if (NULL != mObjectPtr) {
    const cPtr_memmap_5F_true * p = (const cPtr_memmap_5F_true *) mObjectPtr ;
    macroValidSharedObject (p, const cPtr_memmap_5F_true) ;
    result = p->mAttribute_linker ;
  }
  return result ;
}

//---------------------------------------------------------------------------*

GALGAS_basic_5F_type GALGAS_memmap_5F_true::reader_memory_5F_prot (UNUSED_LOCATION_ARGS) const {
  GALGAS_basic_5F_type result ;
  if (NULL != mObjectPtr) {
    const cPtr_memmap_5F_true * p = (const cPtr_memmap_5F_true *) mObjectPtr ;
    macroValidSharedObject (p, const cPtr_memmap_5F_true) ;
    result = p->mAttribute_memory_5F_prot ;
  }
  return result ;
}

//---------------------------------------------------------------------------*
//                   Pointer class for @memmap_true class                    *
//---------------------------------------------------------------------------*

cPtr_memmap_5F_true::cPtr_memmap_5F_true (const GALGAS_location & in_location,
                                          const GALGAS_lstring & in_compiler,
                                          const GALGAS_lstring & in_assembler,
                                          const GALGAS_basic_5F_type & in_linker,
                                          const GALGAS_basic_5F_type & in_memory_5F_prot
                                          COMMA_LOCATION_ARGS) :
cPtr_basic_5F_type (in_location COMMA_THERE),
mAttribute_compiler (in_compiler),
mAttribute_assembler (in_assembler),
mAttribute_linker (in_linker),
mAttribute_memory_5F_prot (in_memory_5F_prot) {
}

//---------------------------------------------------------------------------*

const C_galgas_type_descriptor * cPtr_memmap_5F_true::classDescriptor (void) const {
  return & kTypeDescriptor_GALGAS_memmap_5F_true ;
}

void cPtr_memmap_5F_true::description (C_String & ioString,
                                       const PMSInt32 inIndentation) const {
  ioString << "[@memmap_true:" ;
  mAttribute_location.description (ioString, inIndentation+1) ;
  ioString << ", " ;
  mAttribute_compiler.description (ioString, inIndentation+1) ;
  ioString << ", " ;
  mAttribute_assembler.description (ioString, inIndentation+1) ;
  ioString << ", " ;
  mAttribute_linker.description (ioString, inIndentation+1) ;
  ioString << ", " ;
  mAttribute_memory_5F_prot.description (ioString, inIndentation+1) ;
  ioString << "]" ;
}



//---------------------------------------------------------------------------*
//                                                                           *
//                             @memmap_true type                             *
//                                                                           *
//---------------------------------------------------------------------------*

const C_galgas_type_descriptor
kTypeDescriptor_GALGAS_memmap_5F_true ("memmap_true",
                                       & kTypeDescriptor_GALGAS_basic_5F_type) ;

//---------------------------------------------------------------------------*

const C_galgas_type_descriptor * GALGAS_memmap_5F_true::staticTypeDescriptor (void) const {
  return & kTypeDescriptor_GALGAS_memmap_5F_true ;
}

//---------------------------------------------------------------------------*

AC_GALGAS_root * GALGAS_memmap_5F_true::clonedObject (void) const {
  AC_GALGAS_root * result = NULL ;
  if (isValid ()) {
    macroMyNew (result, GALGAS_memmap_5F_true (*this)) ;
  }
  return result ;
}

//---------------------------------------------------------------------------*

GALGAS_memmap_5F_true GALGAS_memmap_5F_true::extractObject (const GALGAS_object & inObject,
                                                            C_Compiler * inCompiler,
                                                            const GALGAS_location & inErrorLocation
                                                            COMMA_LOCATION_ARGS) {
  GALGAS_memmap_5F_true result ;
  const GALGAS_memmap_5F_true * p = (const GALGAS_memmap_5F_true *) inObject.embeddedObject () ;
  if (NULL != p) {
    if (NULL != dynamic_cast <const GALGAS_memmap_5F_true *> (p)) {
      result = *p ;
    }else{
      inCompiler->extractObjectError (inErrorLocation, "memmap_true", p->dynamicTypeDescriptor () COMMA_THERE) ;
    }  
  }
  return result ;
}

//---------------------------------------------------------------------------*

enumComparisonResult GALGAS_no_5F_linker::objectCompare (const GALGAS_no_5F_linker & inOperand) const {
  return (isValid () && inOperand.isValid ()) ? kOperandEqual : kOperandNotValid ;
}


//---------------------------------------------------------------------------*

GALGAS_no_5F_linker::GALGAS_no_5F_linker (void) :
GALGAS_basic_5F_type () {
}

//---------------------------------------------------------------------------*

GALGAS_no_5F_linker::GALGAS_no_5F_linker (const cPtr_no_5F_linker * inSourcePtr) :
GALGAS_basic_5F_type (inSourcePtr) {
  macroNullOrValidSharedObject (inSourcePtr, const cPtr_no_5F_linker) ;
}

//---------------------------------------------------------------------------*

GALGAS_no_5F_linker GALGAS_no_5F_linker::constructor_new (const GALGAS_location & inAttribute_location
                                                          COMMA_LOCATION_ARGS) {
  GALGAS_no_5F_linker result ;
  if (inAttribute_location.isValid ()) {
    macroMyNew (result.mObjectPtr, cPtr_no_5F_linker (inAttribute_location COMMA_THERE)) ;
  }
  return result ;
}

//---------------------------------------------------------------------------*

void GALGAS_no_5F_linker::insulate (LOCATION_ARGS) {
  if (isValid () && (mObjectPtr->retainCount () > 1)) {
    cPtr_no_5F_linker * p = (cPtr_no_5F_linker *) mObjectPtr ;
    macroValidSharedObject (p, cPtr_no_5F_linker) ;
    cPtr_no_5F_linker * r = NULL ;
    macroMyNew (r, cPtr_no_5F_linker (p->mAttribute_location COMMA_THERE)) ;
    macroAssignSharedObject (mObjectPtr, r) ;
    macroDetachSharedObject (r) ;
  }
}

//---------------------------------------------------------------------------*
//                    Pointer class for @no_linker class                     *
//---------------------------------------------------------------------------*

cPtr_no_5F_linker::cPtr_no_5F_linker (const GALGAS_location & in_location
                                      COMMA_LOCATION_ARGS) :
cPtr_basic_5F_type (in_location COMMA_THERE) {
}

//---------------------------------------------------------------------------*

const C_galgas_type_descriptor * cPtr_no_5F_linker::classDescriptor (void) const {
  return & kTypeDescriptor_GALGAS_no_5F_linker ;
}

void cPtr_no_5F_linker::description (C_String & ioString,
                                     const PMSInt32 inIndentation) const {
  ioString << "[@no_linker:" ;
  mAttribute_location.description (ioString, inIndentation+1) ;
  ioString << "]" ;
}



//---------------------------------------------------------------------------*
//                                                                           *
//                              @no_linker type                              *
//                                                                           *
//---------------------------------------------------------------------------*

const C_galgas_type_descriptor
kTypeDescriptor_GALGAS_no_5F_linker ("no_linker",
                                     & kTypeDescriptor_GALGAS_basic_5F_type) ;

//---------------------------------------------------------------------------*

const C_galgas_type_descriptor * GALGAS_no_5F_linker::staticTypeDescriptor (void) const {
  return & kTypeDescriptor_GALGAS_no_5F_linker ;
}

//---------------------------------------------------------------------------*

AC_GALGAS_root * GALGAS_no_5F_linker::clonedObject (void) const {
  AC_GALGAS_root * result = NULL ;
  if (isValid ()) {
    macroMyNew (result, GALGAS_no_5F_linker (*this)) ;
  }
  return result ;
}

//---------------------------------------------------------------------------*

GALGAS_no_5F_linker GALGAS_no_5F_linker::extractObject (const GALGAS_object & inObject,
                                                        C_Compiler * inCompiler,
                                                        const GALGAS_location & inErrorLocation
                                                        COMMA_LOCATION_ARGS) {
  GALGAS_no_5F_linker result ;
  const GALGAS_no_5F_linker * p = (const GALGAS_no_5F_linker *) inObject.embeddedObject () ;
  if (NULL != p) {
    if (NULL != dynamic_cast <const GALGAS_no_5F_linker *> (p)) {
      result = *p ;
    }else{
      inCompiler->extractObjectError (inErrorLocation, "no_linker", p->dynamicTypeDescriptor () COMMA_THERE) ;
    }  
  }
  return result ;
}

//---------------------------------------------------------------------------*

enumComparisonResult GALGAS_yes_5F_linker::objectCompare (const GALGAS_yes_5F_linker & inOperand) const {
  enumComparisonResult result = GALGAS_basic_5F_type::objectCompare (inOperand) ;
  const cPtr_yes_5F_linker * p = (const cPtr_yes_5F_linker *) mObjectPtr ;
  macroNullOrValidSharedObject (p, const cPtr_yes_5F_linker) ;
  const cPtr_yes_5F_linker * q = (const cPtr_yes_5F_linker *) inOperand.mObjectPtr ;
  macroNullOrValidSharedObject (q, const cPtr_yes_5F_linker) ;
  if (kOperandEqual == result) {
    result = p->mAttribute_linker.objectCompare (q->mAttribute_linker) ;
  }
  if (kOperandEqual == result) {
    result = p->mAttribute_script.objectCompare (q->mAttribute_script) ;
  }
  return result ;
}


//---------------------------------------------------------------------------*

GALGAS_yes_5F_linker::GALGAS_yes_5F_linker (void) :
GALGAS_basic_5F_type () {
}

//---------------------------------------------------------------------------*

GALGAS_yes_5F_linker::GALGAS_yes_5F_linker (const cPtr_yes_5F_linker * inSourcePtr) :
GALGAS_basic_5F_type (inSourcePtr) {
  macroNullOrValidSharedObject (inSourcePtr, const cPtr_yes_5F_linker) ;
}

//---------------------------------------------------------------------------*

GALGAS_yes_5F_linker GALGAS_yes_5F_linker::constructor_new (const GALGAS_location & inAttribute_location,
                                                            const GALGAS_lstring & inAttribute_linker,
                                                            const GALGAS_lstring & inAttribute_script
                                                            COMMA_LOCATION_ARGS) {
  GALGAS_yes_5F_linker result ;
  if (inAttribute_location.isValid () && inAttribute_linker.isValid () && inAttribute_script.isValid ()) {
    macroMyNew (result.mObjectPtr, cPtr_yes_5F_linker (inAttribute_location, inAttribute_linker, inAttribute_script COMMA_THERE)) ;
  }
  return result ;
}

//---------------------------------------------------------------------------*

void GALGAS_yes_5F_linker::insulate (LOCATION_ARGS) {
  if (isValid () && (mObjectPtr->retainCount () > 1)) {
    cPtr_yes_5F_linker * p = (cPtr_yes_5F_linker *) mObjectPtr ;
    macroValidSharedObject (p, cPtr_yes_5F_linker) ;
    cPtr_yes_5F_linker * r = NULL ;
    macroMyNew (r, cPtr_yes_5F_linker (p->mAttribute_location, p->mAttribute_linker, p->mAttribute_script COMMA_THERE)) ;
    macroAssignSharedObject (mObjectPtr, r) ;
    macroDetachSharedObject (r) ;
  }
}

//---------------------------------------------------------------------------*

GALGAS_lstring GALGAS_yes_5F_linker::reader_linker (UNUSED_LOCATION_ARGS) const {
  GALGAS_lstring result ;
  if (NULL != mObjectPtr) {
    const cPtr_yes_5F_linker * p = (const cPtr_yes_5F_linker *) mObjectPtr ;
    macroValidSharedObject (p, const cPtr_yes_5F_linker) ;
    result = p->mAttribute_linker ;
  }
  return result ;
}

//---------------------------------------------------------------------------*

GALGAS_lstring GALGAS_yes_5F_linker::reader_script (UNUSED_LOCATION_ARGS) const {
  GALGAS_lstring result ;
  if (NULL != mObjectPtr) {
    const cPtr_yes_5F_linker * p = (const cPtr_yes_5F_linker *) mObjectPtr ;
    macroValidSharedObject (p, const cPtr_yes_5F_linker) ;
    result = p->mAttribute_script ;
  }
  return result ;
}

//---------------------------------------------------------------------------*
//                    Pointer class for @yes_linker class                    *
//---------------------------------------------------------------------------*

cPtr_yes_5F_linker::cPtr_yes_5F_linker (const GALGAS_location & in_location,
                                        const GALGAS_lstring & in_linker,
                                        const GALGAS_lstring & in_script
                                        COMMA_LOCATION_ARGS) :
cPtr_basic_5F_type (in_location COMMA_THERE),
mAttribute_linker (in_linker),
mAttribute_script (in_script) {
}

//---------------------------------------------------------------------------*

const C_galgas_type_descriptor * cPtr_yes_5F_linker::classDescriptor (void) const {
  return & kTypeDescriptor_GALGAS_yes_5F_linker ;
}

void cPtr_yes_5F_linker::description (C_String & ioString,
                                      const PMSInt32 inIndentation) const {
  ioString << "[@yes_linker:" ;
  mAttribute_location.description (ioString, inIndentation+1) ;
  ioString << ", " ;
  mAttribute_linker.description (ioString, inIndentation+1) ;
  ioString << ", " ;
  mAttribute_script.description (ioString, inIndentation+1) ;
  ioString << "]" ;
}



//---------------------------------------------------------------------------*
//                                                                           *
//                             @yes_linker type                              *
//                                                                           *
//---------------------------------------------------------------------------*

const C_galgas_type_descriptor
kTypeDescriptor_GALGAS_yes_5F_linker ("yes_linker",
                                      & kTypeDescriptor_GALGAS_basic_5F_type) ;

//---------------------------------------------------------------------------*

const C_galgas_type_descriptor * GALGAS_yes_5F_linker::staticTypeDescriptor (void) const {
  return & kTypeDescriptor_GALGAS_yes_5F_linker ;
}

//---------------------------------------------------------------------------*

AC_GALGAS_root * GALGAS_yes_5F_linker::clonedObject (void) const {
  AC_GALGAS_root * result = NULL ;
  if (isValid ()) {
    macroMyNew (result, GALGAS_yes_5F_linker (*this)) ;
  }
  return result ;
}

//---------------------------------------------------------------------------*

GALGAS_yes_5F_linker GALGAS_yes_5F_linker::extractObject (const GALGAS_object & inObject,
                                                          C_Compiler * inCompiler,
                                                          const GALGAS_location & inErrorLocation
                                                          COMMA_LOCATION_ARGS) {
  GALGAS_yes_5F_linker result ;
  const GALGAS_yes_5F_linker * p = (const GALGAS_yes_5F_linker *) inObject.embeddedObject () ;
  if (NULL != p) {
    if (NULL != dynamic_cast <const GALGAS_yes_5F_linker *> (p)) {
      result = *p ;
    }else{
      inCompiler->extractObjectError (inErrorLocation, "yes_linker", p->dynamicTypeDescriptor () COMMA_THERE) ;
    }  
  }
  return result ;
}

//---------------------------------------------------------------------------*

enumComparisonResult GALGAS_os_5F_obj::objectCompare (const GALGAS_os_5F_obj & inOperand) const {
  enumComparisonResult result = GALGAS_oil_5F_obj::objectCompare (inOperand) ;
  const cPtr_os_5F_obj * p = (const cPtr_os_5F_obj *) mObjectPtr ;
  macroNullOrValidSharedObject (p, const cPtr_os_5F_obj) ;
  const cPtr_os_5F_obj * q = (const cPtr_os_5F_obj *) inOperand.mObjectPtr ;
  macroNullOrValidSharedObject (q, const cPtr_os_5F_obj) ;
  if (kOperandEqual == result) {
    result = p->mAttribute_status.objectCompare (q->mAttribute_status) ;
  }
  if (kOperandEqual == result) {
    result = p->mAttribute_startuphook.objectCompare (q->mAttribute_startuphook) ;
  }
  if (kOperandEqual == result) {
    result = p->mAttribute_shutdownhook.objectCompare (q->mAttribute_shutdownhook) ;
  }
  if (kOperandEqual == result) {
    result = p->mAttribute_errorhook.objectCompare (q->mAttribute_errorhook) ;
  }
  if (kOperandEqual == result) {
    result = p->mAttribute_pretaskhook.objectCompare (q->mAttribute_pretaskhook) ;
  }
  if (kOperandEqual == result) {
    result = p->mAttribute_posttaskhook.objectCompare (q->mAttribute_posttaskhook) ;
  }
  if (kOperandEqual == result) {
    result = p->mAttribute_protectionhook.objectCompare (q->mAttribute_protectionhook) ;
  }
  if (kOperandEqual == result) {
    result = p->mAttribute_scalabilityclass.objectCompare (q->mAttribute_scalabilityclass) ;
  }
  if (kOperandEqual == result) {
    result = p->mAttribute_stackmonitoring.objectCompare (q->mAttribute_stackmonitoring) ;
  }
  if (kOperandEqual == result) {
    result = p->mAttribute_usegetserviceid.objectCompare (q->mAttribute_usegetserviceid) ;
  }
  if (kOperandEqual == result) {
    result = p->mAttribute_useparameteraccess.objectCompare (q->mAttribute_useparameteraccess) ;
  }
  if (kOperandEqual == result) {
    result = p->mAttribute_useresscheduler.objectCompare (q->mAttribute_useresscheduler) ;
  }
  if (kOperandEqual == result) {
    result = p->mAttribute_systemcall.objectCompare (q->mAttribute_systemcall) ;
  }
  if (kOperandEqual == result) {
    result = p->mAttribute_debug.objectCompare (q->mAttribute_debug) ;
  }
  if (kOperandEqual == result) {
    result = p->mAttribute_memmap.objectCompare (q->mAttribute_memmap) ;
  }
  if (kOperandEqual == result) {
    result = p->mAttribute_app_5F_src.objectCompare (q->mAttribute_app_5F_src) ;
  }
  if (kOperandEqual == result) {
    result = p->mAttribute_compiler.objectCompare (q->mAttribute_compiler) ;
  }
  if (kOperandEqual == result) {
    result = p->mAttribute_assembler.objectCompare (q->mAttribute_assembler) ;
  }
  if (kOperandEqual == result) {
    result = p->mAttribute_linker.objectCompare (q->mAttribute_linker) ;
  }
  if (kOperandEqual == result) {
    result = p->mAttribute_cflags.objectCompare (q->mAttribute_cflags) ;
  }
  if (kOperandEqual == result) {
    result = p->mAttribute_cppflags.objectCompare (q->mAttribute_cppflags) ;
  }
  if (kOperandEqual == result) {
    result = p->mAttribute_asflags.objectCompare (q->mAttribute_asflags) ;
  }
  if (kOperandEqual == result) {
    result = p->mAttribute_ldflags.objectCompare (q->mAttribute_ldflags) ;
  }
  if (kOperandEqual == result) {
    result = p->mAttribute_app_5F_name.objectCompare (q->mAttribute_app_5F_name) ;
  }
  if (kOperandEqual == result) {
    result = p->mAttribute_tpl_5F_base_5F_path.objectCompare (q->mAttribute_tpl_5F_base_5F_path) ;
  }
  if (kOperandEqual == result) {
    result = p->mAttribute_trace.objectCompare (q->mAttribute_trace) ;
  }
  if (kOperandEqual == result) {
    result = p->mAttribute_others.objectCompare (q->mAttribute_others) ;
  }
  return result ;
}


//---------------------------------------------------------------------------*

GALGAS_os_5F_obj::GALGAS_os_5F_obj (void) :
GALGAS_oil_5F_obj () {
}

//---------------------------------------------------------------------------*

GALGAS_os_5F_obj::GALGAS_os_5F_obj (const cPtr_os_5F_obj * inSourcePtr) :
GALGAS_oil_5F_obj (inSourcePtr) {
  macroNullOrValidSharedObject (inSourcePtr, const cPtr_os_5F_obj) ;
}

//---------------------------------------------------------------------------*

GALGAS_os_5F_obj GALGAS_os_5F_obj::constructor_new (const GALGAS_lstring & inAttribute_desc,
                                                    const GALGAS_lstring & inAttribute_status,
                                                    const GALGAS_basic_5F_type & inAttribute_startuphook,
                                                    const GALGAS_basic_5F_type & inAttribute_shutdownhook,
                                                    const GALGAS_basic_5F_type & inAttribute_errorhook,
                                                    const GALGAS_basic_5F_type & inAttribute_pretaskhook,
                                                    const GALGAS_basic_5F_type & inAttribute_posttaskhook,
                                                    const GALGAS_basic_5F_type & inAttribute_protectionhook,
                                                    const GALGAS_lstring & inAttribute_scalabilityclass,
                                                    const GALGAS_basic_5F_type & inAttribute_stackmonitoring,
                                                    const GALGAS_basic_5F_type & inAttribute_usegetserviceid,
                                                    const GALGAS_basic_5F_type & inAttribute_useparameteraccess,
                                                    const GALGAS_basic_5F_type & inAttribute_useresscheduler,
                                                    const GALGAS_basic_5F_type & inAttribute_systemcall,
                                                    const GALGAS_basic_5F_type & inAttribute_debug,
                                                    const GALGAS_basic_5F_type & inAttribute_memmap,
                                                    const GALGAS_lstringlist & inAttribute_app_5F_src,
                                                    const GALGAS_lstring & inAttribute_compiler,
                                                    const GALGAS_lstring & inAttribute_assembler,
                                                    const GALGAS_lstring & inAttribute_linker,
                                                    const GALGAS_lstringlist & inAttribute_cflags,
                                                    const GALGAS_lstringlist & inAttribute_cppflags,
                                                    const GALGAS_lstringlist & inAttribute_asflags,
                                                    const GALGAS_lstringlist & inAttribute_ldflags,
                                                    const GALGAS_lstring & inAttribute_app_5F_name,
                                                    const GALGAS_lstring & inAttribute_tpl_5F_base_5F_path,
                                                    const GALGAS_trace & inAttribute_trace,
                                                    const GALGAS_ident_5F_map & inAttribute_others
                                                    COMMA_LOCATION_ARGS) {
  GALGAS_os_5F_obj result ;
  if (inAttribute_desc.isValid () && inAttribute_status.isValid () && inAttribute_startuphook.isValid () && inAttribute_shutdownhook.isValid () && inAttribute_errorhook.isValid () && inAttribute_pretaskhook.isValid () && inAttribute_posttaskhook.isValid () && inAttribute_protectionhook.isValid () && inAttribute_scalabilityclass.isValid () && inAttribute_stackmonitoring.isValid () && inAttribute_usegetserviceid.isValid () && inAttribute_useparameteraccess.isValid () && inAttribute_useresscheduler.isValid () && inAttribute_systemcall.isValid () && inAttribute_debug.isValid () && inAttribute_memmap.isValid () && inAttribute_app_5F_src.isValid () && inAttribute_compiler.isValid () && inAttribute_assembler.isValid () && inAttribute_linker.isValid () && inAttribute_cflags.isValid () && inAttribute_cppflags.isValid () && inAttribute_asflags.isValid () && inAttribute_ldflags.isValid () && inAttribute_app_5F_name.isValid () && inAttribute_tpl_5F_base_5F_path.isValid () && inAttribute_trace.isValid () && inAttribute_others.isValid ()) {
    macroMyNew (result.mObjectPtr, cPtr_os_5F_obj (inAttribute_desc, inAttribute_status, inAttribute_startuphook, inAttribute_shutdownhook, inAttribute_errorhook, inAttribute_pretaskhook, inAttribute_posttaskhook, inAttribute_protectionhook, inAttribute_scalabilityclass, inAttribute_stackmonitoring, inAttribute_usegetserviceid, inAttribute_useparameteraccess, inAttribute_useresscheduler, inAttribute_systemcall, inAttribute_debug, inAttribute_memmap, inAttribute_app_5F_src, inAttribute_compiler, inAttribute_assembler, inAttribute_linker, inAttribute_cflags, inAttribute_cppflags, inAttribute_asflags, inAttribute_ldflags, inAttribute_app_5F_name, inAttribute_tpl_5F_base_5F_path, inAttribute_trace, inAttribute_others COMMA_THERE)) ;
  }
  return result ;
}

//---------------------------------------------------------------------------*

void GALGAS_os_5F_obj::insulate (LOCATION_ARGS) {
  if (isValid () && (mObjectPtr->retainCount () > 1)) {
    cPtr_os_5F_obj * p = (cPtr_os_5F_obj *) mObjectPtr ;
    macroValidSharedObject (p, cPtr_os_5F_obj) ;
    cPtr_os_5F_obj * r = NULL ;
    macroMyNew (r, cPtr_os_5F_obj (p->mAttribute_desc, p->mAttribute_status, p->mAttribute_startuphook, p->mAttribute_shutdownhook, p->mAttribute_errorhook, p->mAttribute_pretaskhook, p->mAttribute_posttaskhook, p->mAttribute_protectionhook, p->mAttribute_scalabilityclass, p->mAttribute_stackmonitoring, p->mAttribute_usegetserviceid, p->mAttribute_useparameteraccess, p->mAttribute_useresscheduler, p->mAttribute_systemcall, p->mAttribute_debug, p->mAttribute_memmap, p->mAttribute_app_5F_src, p->mAttribute_compiler, p->mAttribute_assembler, p->mAttribute_linker, p->mAttribute_cflags, p->mAttribute_cppflags, p->mAttribute_asflags, p->mAttribute_ldflags, p->mAttribute_app_5F_name, p->mAttribute_tpl_5F_base_5F_path, p->mAttribute_trace, p->mAttribute_others COMMA_THERE)) ;
    macroAssignSharedObject (mObjectPtr, r) ;
    macroDetachSharedObject (r) ;
  }
}

//---------------------------------------------------------------------------*

GALGAS_lstring GALGAS_os_5F_obj::reader_status (UNUSED_LOCATION_ARGS) const {
  GALGAS_lstring result ;
  if (NULL != mObjectPtr) {
    const cPtr_os_5F_obj * p = (const cPtr_os_5F_obj *) mObjectPtr ;
    macroValidSharedObject (p, const cPtr_os_5F_obj) ;
    result = p->mAttribute_status ;
  }
  return result ;
}

//---------------------------------------------------------------------------*

GALGAS_basic_5F_type GALGAS_os_5F_obj::reader_startuphook (UNUSED_LOCATION_ARGS) const {
  GALGAS_basic_5F_type result ;
  if (NULL != mObjectPtr) {
    const cPtr_os_5F_obj * p = (const cPtr_os_5F_obj *) mObjectPtr ;
    macroValidSharedObject (p, const cPtr_os_5F_obj) ;
    result = p->mAttribute_startuphook ;
  }
  return result ;
}

//---------------------------------------------------------------------------*

GALGAS_basic_5F_type GALGAS_os_5F_obj::reader_shutdownhook (UNUSED_LOCATION_ARGS) const {
  GALGAS_basic_5F_type result ;
  if (NULL != mObjectPtr) {
    const cPtr_os_5F_obj * p = (const cPtr_os_5F_obj *) mObjectPtr ;
    macroValidSharedObject (p, const cPtr_os_5F_obj) ;
    result = p->mAttribute_shutdownhook ;
  }
  return result ;
}

//---------------------------------------------------------------------------*

GALGAS_basic_5F_type GALGAS_os_5F_obj::reader_errorhook (UNUSED_LOCATION_ARGS) const {
  GALGAS_basic_5F_type result ;
  if (NULL != mObjectPtr) {
    const cPtr_os_5F_obj * p = (const cPtr_os_5F_obj *) mObjectPtr ;
    macroValidSharedObject (p, const cPtr_os_5F_obj) ;
    result = p->mAttribute_errorhook ;
  }
  return result ;
}

//---------------------------------------------------------------------------*

GALGAS_basic_5F_type GALGAS_os_5F_obj::reader_pretaskhook (UNUSED_LOCATION_ARGS) const {
  GALGAS_basic_5F_type result ;
  if (NULL != mObjectPtr) {
    const cPtr_os_5F_obj * p = (const cPtr_os_5F_obj *) mObjectPtr ;
    macroValidSharedObject (p, const cPtr_os_5F_obj) ;
    result = p->mAttribute_pretaskhook ;
  }
  return result ;
}

//---------------------------------------------------------------------------*

GALGAS_basic_5F_type GALGAS_os_5F_obj::reader_posttaskhook (UNUSED_LOCATION_ARGS) const {
  GALGAS_basic_5F_type result ;
  if (NULL != mObjectPtr) {
    const cPtr_os_5F_obj * p = (const cPtr_os_5F_obj *) mObjectPtr ;
    macroValidSharedObject (p, const cPtr_os_5F_obj) ;
    result = p->mAttribute_posttaskhook ;
  }
  return result ;
}

//---------------------------------------------------------------------------*

GALGAS_basic_5F_type GALGAS_os_5F_obj::reader_protectionhook (UNUSED_LOCATION_ARGS) const {
  GALGAS_basic_5F_type result ;
  if (NULL != mObjectPtr) {
    const cPtr_os_5F_obj * p = (const cPtr_os_5F_obj *) mObjectPtr ;
    macroValidSharedObject (p, const cPtr_os_5F_obj) ;
    result = p->mAttribute_protectionhook ;
  }
  return result ;
}

//---------------------------------------------------------------------------*

GALGAS_lstring GALGAS_os_5F_obj::reader_scalabilityclass (UNUSED_LOCATION_ARGS) const {
  GALGAS_lstring result ;
  if (NULL != mObjectPtr) {
    const cPtr_os_5F_obj * p = (const cPtr_os_5F_obj *) mObjectPtr ;
    macroValidSharedObject (p, const cPtr_os_5F_obj) ;
    result = p->mAttribute_scalabilityclass ;
  }
  return result ;
}

//---------------------------------------------------------------------------*

GALGAS_basic_5F_type GALGAS_os_5F_obj::reader_stackmonitoring (UNUSED_LOCATION_ARGS) const {
  GALGAS_basic_5F_type result ;
  if (NULL != mObjectPtr) {
    const cPtr_os_5F_obj * p = (const cPtr_os_5F_obj *) mObjectPtr ;
    macroValidSharedObject (p, const cPtr_os_5F_obj) ;
    result = p->mAttribute_stackmonitoring ;
  }
  return result ;
}

//---------------------------------------------------------------------------*

GALGAS_basic_5F_type GALGAS_os_5F_obj::reader_usegetserviceid (UNUSED_LOCATION_ARGS) const {
  GALGAS_basic_5F_type result ;
  if (NULL != mObjectPtr) {
    const cPtr_os_5F_obj * p = (const cPtr_os_5F_obj *) mObjectPtr ;
    macroValidSharedObject (p, const cPtr_os_5F_obj) ;
    result = p->mAttribute_usegetserviceid ;
  }
  return result ;
}

//---------------------------------------------------------------------------*

GALGAS_basic_5F_type GALGAS_os_5F_obj::reader_useparameteraccess (UNUSED_LOCATION_ARGS) const {
  GALGAS_basic_5F_type result ;
  if (NULL != mObjectPtr) {
    const cPtr_os_5F_obj * p = (const cPtr_os_5F_obj *) mObjectPtr ;
    macroValidSharedObject (p, const cPtr_os_5F_obj) ;
    result = p->mAttribute_useparameteraccess ;
  }
  return result ;
}

//---------------------------------------------------------------------------*

GALGAS_basic_5F_type GALGAS_os_5F_obj::reader_useresscheduler (UNUSED_LOCATION_ARGS) const {
  GALGAS_basic_5F_type result ;
  if (NULL != mObjectPtr) {
    const cPtr_os_5F_obj * p = (const cPtr_os_5F_obj *) mObjectPtr ;
    macroValidSharedObject (p, const cPtr_os_5F_obj) ;
    result = p->mAttribute_useresscheduler ;
  }
  return result ;
}

//---------------------------------------------------------------------------*

GALGAS_basic_5F_type GALGAS_os_5F_obj::reader_systemcall (UNUSED_LOCATION_ARGS) const {
  GALGAS_basic_5F_type result ;
  if (NULL != mObjectPtr) {
    const cPtr_os_5F_obj * p = (const cPtr_os_5F_obj *) mObjectPtr ;
    macroValidSharedObject (p, const cPtr_os_5F_obj) ;
    result = p->mAttribute_systemcall ;
  }
  return result ;
}

//---------------------------------------------------------------------------*

GALGAS_basic_5F_type GALGAS_os_5F_obj::reader_debug (UNUSED_LOCATION_ARGS) const {
  GALGAS_basic_5F_type result ;
  if (NULL != mObjectPtr) {
    const cPtr_os_5F_obj * p = (const cPtr_os_5F_obj *) mObjectPtr ;
    macroValidSharedObject (p, const cPtr_os_5F_obj) ;
    result = p->mAttribute_debug ;
  }
  return result ;
}

//---------------------------------------------------------------------------*

GALGAS_basic_5F_type GALGAS_os_5F_obj::reader_memmap (UNUSED_LOCATION_ARGS) const {
  GALGAS_basic_5F_type result ;
  if (NULL != mObjectPtr) {
    const cPtr_os_5F_obj * p = (const cPtr_os_5F_obj *) mObjectPtr ;
    macroValidSharedObject (p, const cPtr_os_5F_obj) ;
    result = p->mAttribute_memmap ;
  }
  return result ;
}

//---------------------------------------------------------------------------*

GALGAS_lstringlist GALGAS_os_5F_obj::reader_app_5F_src (UNUSED_LOCATION_ARGS) const {
  GALGAS_lstringlist result ;
  if (NULL != mObjectPtr) {
    const cPtr_os_5F_obj * p = (const cPtr_os_5F_obj *) mObjectPtr ;
    macroValidSharedObject (p, const cPtr_os_5F_obj) ;
    result = p->mAttribute_app_5F_src ;
  }
  return result ;
}

//---------------------------------------------------------------------------*

GALGAS_lstring GALGAS_os_5F_obj::reader_compiler (UNUSED_LOCATION_ARGS) const {
  GALGAS_lstring result ;
  if (NULL != mObjectPtr) {
    const cPtr_os_5F_obj * p = (const cPtr_os_5F_obj *) mObjectPtr ;
    macroValidSharedObject (p, const cPtr_os_5F_obj) ;
    result = p->mAttribute_compiler ;
  }
  return result ;
}

//---------------------------------------------------------------------------*

GALGAS_lstring GALGAS_os_5F_obj::reader_assembler (UNUSED_LOCATION_ARGS) const {
  GALGAS_lstring result ;
  if (NULL != mObjectPtr) {
    const cPtr_os_5F_obj * p = (const cPtr_os_5F_obj *) mObjectPtr ;
    macroValidSharedObject (p, const cPtr_os_5F_obj) ;
    result = p->mAttribute_assembler ;
  }
  return result ;
}

//---------------------------------------------------------------------------*

GALGAS_lstring GALGAS_os_5F_obj::reader_linker (UNUSED_LOCATION_ARGS) const {
  GALGAS_lstring result ;
  if (NULL != mObjectPtr) {
    const cPtr_os_5F_obj * p = (const cPtr_os_5F_obj *) mObjectPtr ;
    macroValidSharedObject (p, const cPtr_os_5F_obj) ;
    result = p->mAttribute_linker ;
  }
  return result ;
}

//---------------------------------------------------------------------------*

GALGAS_lstringlist GALGAS_os_5F_obj::reader_cflags (UNUSED_LOCATION_ARGS) const {
  GALGAS_lstringlist result ;
  if (NULL != mObjectPtr) {
    const cPtr_os_5F_obj * p = (const cPtr_os_5F_obj *) mObjectPtr ;
    macroValidSharedObject (p, const cPtr_os_5F_obj) ;
    result = p->mAttribute_cflags ;
  }
  return result ;
}

//---------------------------------------------------------------------------*

GALGAS_lstringlist GALGAS_os_5F_obj::reader_cppflags (UNUSED_LOCATION_ARGS) const {
  GALGAS_lstringlist result ;
  if (NULL != mObjectPtr) {
    const cPtr_os_5F_obj * p = (const cPtr_os_5F_obj *) mObjectPtr ;
    macroValidSharedObject (p, const cPtr_os_5F_obj) ;
    result = p->mAttribute_cppflags ;
  }
  return result ;
}

//---------------------------------------------------------------------------*

GALGAS_lstringlist GALGAS_os_5F_obj::reader_asflags (UNUSED_LOCATION_ARGS) const {
  GALGAS_lstringlist result ;
  if (NULL != mObjectPtr) {
    const cPtr_os_5F_obj * p = (const cPtr_os_5F_obj *) mObjectPtr ;
    macroValidSharedObject (p, const cPtr_os_5F_obj) ;
    result = p->mAttribute_asflags ;
  }
  return result ;
}

//---------------------------------------------------------------------------*

GALGAS_lstringlist GALGAS_os_5F_obj::reader_ldflags (UNUSED_LOCATION_ARGS) const {
  GALGAS_lstringlist result ;
  if (NULL != mObjectPtr) {
    const cPtr_os_5F_obj * p = (const cPtr_os_5F_obj *) mObjectPtr ;
    macroValidSharedObject (p, const cPtr_os_5F_obj) ;
    result = p->mAttribute_ldflags ;
  }
  return result ;
}

//---------------------------------------------------------------------------*

GALGAS_lstring GALGAS_os_5F_obj::reader_app_5F_name (UNUSED_LOCATION_ARGS) const {
  GALGAS_lstring result ;
  if (NULL != mObjectPtr) {
    const cPtr_os_5F_obj * p = (const cPtr_os_5F_obj *) mObjectPtr ;
    macroValidSharedObject (p, const cPtr_os_5F_obj) ;
    result = p->mAttribute_app_5F_name ;
  }
  return result ;
}

//---------------------------------------------------------------------------*

GALGAS_lstring GALGAS_os_5F_obj::reader_tpl_5F_base_5F_path (UNUSED_LOCATION_ARGS) const {
  GALGAS_lstring result ;
  if (NULL != mObjectPtr) {
    const cPtr_os_5F_obj * p = (const cPtr_os_5F_obj *) mObjectPtr ;
    macroValidSharedObject (p, const cPtr_os_5F_obj) ;
    result = p->mAttribute_tpl_5F_base_5F_path ;
  }
  return result ;
}

//---------------------------------------------------------------------------*

GALGAS_trace GALGAS_os_5F_obj::reader_trace (UNUSED_LOCATION_ARGS) const {
  GALGAS_trace result ;
  if (NULL != mObjectPtr) {
    const cPtr_os_5F_obj * p = (const cPtr_os_5F_obj *) mObjectPtr ;
    macroValidSharedObject (p, const cPtr_os_5F_obj) ;
    result = p->mAttribute_trace ;
  }
  return result ;
}

//---------------------------------------------------------------------------*

GALGAS_ident_5F_map GALGAS_os_5F_obj::reader_others (UNUSED_LOCATION_ARGS) const {
  GALGAS_ident_5F_map result ;
  if (NULL != mObjectPtr) {
    const cPtr_os_5F_obj * p = (const cPtr_os_5F_obj *) mObjectPtr ;
    macroValidSharedObject (p, const cPtr_os_5F_obj) ;
    result = p->mAttribute_others ;
  }
  return result ;
}

//---------------------------------------------------------------------------*

void GALGAS_os_5F_obj::modifier_setStatus (GALGAS_lstring inValue
                                           COMMA_UNUSED_LOCATION_ARGS) {
  if (NULL != mObjectPtr) {
    cPtr_os_5F_obj * p = (cPtr_os_5F_obj *) mObjectPtr ;
    macroValidSharedObject (p, cPtr_os_5F_obj) ;
    p->mAttribute_status = inValue ;
  }
}

//---------------------------------------------------------------------------*

void GALGAS_os_5F_obj::modifier_setStartuphook (GALGAS_basic_5F_type inValue
                                                COMMA_UNUSED_LOCATION_ARGS) {
  if (NULL != mObjectPtr) {
    cPtr_os_5F_obj * p = (cPtr_os_5F_obj *) mObjectPtr ;
    macroValidSharedObject (p, cPtr_os_5F_obj) ;
    p->mAttribute_startuphook = inValue ;
  }
}

//---------------------------------------------------------------------------*

void GALGAS_os_5F_obj::modifier_setShutdownhook (GALGAS_basic_5F_type inValue
                                                 COMMA_UNUSED_LOCATION_ARGS) {
  if (NULL != mObjectPtr) {
    cPtr_os_5F_obj * p = (cPtr_os_5F_obj *) mObjectPtr ;
    macroValidSharedObject (p, cPtr_os_5F_obj) ;
    p->mAttribute_shutdownhook = inValue ;
  }
}

//---------------------------------------------------------------------------*

void GALGAS_os_5F_obj::modifier_setErrorhook (GALGAS_basic_5F_type inValue
                                              COMMA_UNUSED_LOCATION_ARGS) {
  if (NULL != mObjectPtr) {
    cPtr_os_5F_obj * p = (cPtr_os_5F_obj *) mObjectPtr ;
    macroValidSharedObject (p, cPtr_os_5F_obj) ;
    p->mAttribute_errorhook = inValue ;
  }
}

//---------------------------------------------------------------------------*

void GALGAS_os_5F_obj::modifier_setPretaskhook (GALGAS_basic_5F_type inValue
                                                COMMA_UNUSED_LOCATION_ARGS) {
  if (NULL != mObjectPtr) {
    cPtr_os_5F_obj * p = (cPtr_os_5F_obj *) mObjectPtr ;
    macroValidSharedObject (p, cPtr_os_5F_obj) ;
    p->mAttribute_pretaskhook = inValue ;
  }
}

//---------------------------------------------------------------------------*

void GALGAS_os_5F_obj::modifier_setPosttaskhook (GALGAS_basic_5F_type inValue
                                                 COMMA_UNUSED_LOCATION_ARGS) {
  if (NULL != mObjectPtr) {
    cPtr_os_5F_obj * p = (cPtr_os_5F_obj *) mObjectPtr ;
    macroValidSharedObject (p, cPtr_os_5F_obj) ;
    p->mAttribute_posttaskhook = inValue ;
  }
}

//---------------------------------------------------------------------------*

void GALGAS_os_5F_obj::modifier_setProtectionhook (GALGAS_basic_5F_type inValue
                                                   COMMA_UNUSED_LOCATION_ARGS) {
  if (NULL != mObjectPtr) {
    cPtr_os_5F_obj * p = (cPtr_os_5F_obj *) mObjectPtr ;
    macroValidSharedObject (p, cPtr_os_5F_obj) ;
    p->mAttribute_protectionhook = inValue ;
  }
}

//---------------------------------------------------------------------------*

void GALGAS_os_5F_obj::modifier_setScalabilityclass (GALGAS_lstring inValue
                                                     COMMA_UNUSED_LOCATION_ARGS) {
  if (NULL != mObjectPtr) {
    cPtr_os_5F_obj * p = (cPtr_os_5F_obj *) mObjectPtr ;
    macroValidSharedObject (p, cPtr_os_5F_obj) ;
    p->mAttribute_scalabilityclass = inValue ;
  }
}

//---------------------------------------------------------------------------*

void GALGAS_os_5F_obj::modifier_setStackmonitoring (GALGAS_basic_5F_type inValue
                                                    COMMA_UNUSED_LOCATION_ARGS) {
  if (NULL != mObjectPtr) {
    cPtr_os_5F_obj * p = (cPtr_os_5F_obj *) mObjectPtr ;
    macroValidSharedObject (p, cPtr_os_5F_obj) ;
    p->mAttribute_stackmonitoring = inValue ;
  }
}

//---------------------------------------------------------------------------*

void GALGAS_os_5F_obj::modifier_setUsegetserviceid (GALGAS_basic_5F_type inValue
                                                    COMMA_UNUSED_LOCATION_ARGS) {
  if (NULL != mObjectPtr) {
    cPtr_os_5F_obj * p = (cPtr_os_5F_obj *) mObjectPtr ;
    macroValidSharedObject (p, cPtr_os_5F_obj) ;
    p->mAttribute_usegetserviceid = inValue ;
  }
}

//---------------------------------------------------------------------------*

void GALGAS_os_5F_obj::modifier_setUseparameteraccess (GALGAS_basic_5F_type inValue
                                                       COMMA_UNUSED_LOCATION_ARGS) {
  if (NULL != mObjectPtr) {
    cPtr_os_5F_obj * p = (cPtr_os_5F_obj *) mObjectPtr ;
    macroValidSharedObject (p, cPtr_os_5F_obj) ;
    p->mAttribute_useparameteraccess = inValue ;
  }
}

//---------------------------------------------------------------------------*

void GALGAS_os_5F_obj::modifier_setUseresscheduler (GALGAS_basic_5F_type inValue
                                                    COMMA_UNUSED_LOCATION_ARGS) {
  if (NULL != mObjectPtr) {
    cPtr_os_5F_obj * p = (cPtr_os_5F_obj *) mObjectPtr ;
    macroValidSharedObject (p, cPtr_os_5F_obj) ;
    p->mAttribute_useresscheduler = inValue ;
  }
}

//---------------------------------------------------------------------------*

void GALGAS_os_5F_obj::modifier_setSystemcall (GALGAS_basic_5F_type inValue
                                               COMMA_UNUSED_LOCATION_ARGS) {
  if (NULL != mObjectPtr) {
    cPtr_os_5F_obj * p = (cPtr_os_5F_obj *) mObjectPtr ;
    macroValidSharedObject (p, cPtr_os_5F_obj) ;
    p->mAttribute_systemcall = inValue ;
  }
}

//---------------------------------------------------------------------------*

void GALGAS_os_5F_obj::modifier_setDebug (GALGAS_basic_5F_type inValue
                                          COMMA_UNUSED_LOCATION_ARGS) {
  if (NULL != mObjectPtr) {
    cPtr_os_5F_obj * p = (cPtr_os_5F_obj *) mObjectPtr ;
    macroValidSharedObject (p, cPtr_os_5F_obj) ;
    p->mAttribute_debug = inValue ;
  }
}

//---------------------------------------------------------------------------*

void GALGAS_os_5F_obj::modifier_setMemmap (GALGAS_basic_5F_type inValue
                                           COMMA_UNUSED_LOCATION_ARGS) {
  if (NULL != mObjectPtr) {
    cPtr_os_5F_obj * p = (cPtr_os_5F_obj *) mObjectPtr ;
    macroValidSharedObject (p, cPtr_os_5F_obj) ;
    p->mAttribute_memmap = inValue ;
  }
}

//---------------------------------------------------------------------------*

void GALGAS_os_5F_obj::modifier_setApp_5F_src (GALGAS_lstringlist inValue
                                               COMMA_UNUSED_LOCATION_ARGS) {
  if (NULL != mObjectPtr) {
    cPtr_os_5F_obj * p = (cPtr_os_5F_obj *) mObjectPtr ;
    macroValidSharedObject (p, cPtr_os_5F_obj) ;
    p->mAttribute_app_5F_src = inValue ;
  }
}

//---------------------------------------------------------------------------*

void GALGAS_os_5F_obj::modifier_setCompiler (GALGAS_lstring inValue
                                             COMMA_UNUSED_LOCATION_ARGS) {
  if (NULL != mObjectPtr) {
    cPtr_os_5F_obj * p = (cPtr_os_5F_obj *) mObjectPtr ;
    macroValidSharedObject (p, cPtr_os_5F_obj) ;
    p->mAttribute_compiler = inValue ;
  }
}

//---------------------------------------------------------------------------*

void GALGAS_os_5F_obj::modifier_setAssembler (GALGAS_lstring inValue
                                              COMMA_UNUSED_LOCATION_ARGS) {
  if (NULL != mObjectPtr) {
    cPtr_os_5F_obj * p = (cPtr_os_5F_obj *) mObjectPtr ;
    macroValidSharedObject (p, cPtr_os_5F_obj) ;
    p->mAttribute_assembler = inValue ;
  }
}

//---------------------------------------------------------------------------*

void GALGAS_os_5F_obj::modifier_setLinker (GALGAS_lstring inValue
                                           COMMA_UNUSED_LOCATION_ARGS) {
  if (NULL != mObjectPtr) {
    cPtr_os_5F_obj * p = (cPtr_os_5F_obj *) mObjectPtr ;
    macroValidSharedObject (p, cPtr_os_5F_obj) ;
    p->mAttribute_linker = inValue ;
  }
}

//---------------------------------------------------------------------------*

void GALGAS_os_5F_obj::modifier_setCflags (GALGAS_lstringlist inValue
                                           COMMA_UNUSED_LOCATION_ARGS) {
  if (NULL != mObjectPtr) {
    cPtr_os_5F_obj * p = (cPtr_os_5F_obj *) mObjectPtr ;
    macroValidSharedObject (p, cPtr_os_5F_obj) ;
    p->mAttribute_cflags = inValue ;
  }
}

//---------------------------------------------------------------------------*

void GALGAS_os_5F_obj::modifier_setCppflags (GALGAS_lstringlist inValue
                                             COMMA_UNUSED_LOCATION_ARGS) {
  if (NULL != mObjectPtr) {
    cPtr_os_5F_obj * p = (cPtr_os_5F_obj *) mObjectPtr ;
    macroValidSharedObject (p, cPtr_os_5F_obj) ;
    p->mAttribute_cppflags = inValue ;
  }
}

//---------------------------------------------------------------------------*

void GALGAS_os_5F_obj::modifier_setAsflags (GALGAS_lstringlist inValue
                                            COMMA_UNUSED_LOCATION_ARGS) {
  if (NULL != mObjectPtr) {
    cPtr_os_5F_obj * p = (cPtr_os_5F_obj *) mObjectPtr ;
    macroValidSharedObject (p, cPtr_os_5F_obj) ;
    p->mAttribute_asflags = inValue ;
  }
}

//---------------------------------------------------------------------------*

void GALGAS_os_5F_obj::modifier_setLdflags (GALGAS_lstringlist inValue
                                            COMMA_UNUSED_LOCATION_ARGS) {
  if (NULL != mObjectPtr) {
    cPtr_os_5F_obj * p = (cPtr_os_5F_obj *) mObjectPtr ;
    macroValidSharedObject (p, cPtr_os_5F_obj) ;
    p->mAttribute_ldflags = inValue ;
  }
}

//---------------------------------------------------------------------------*

void GALGAS_os_5F_obj::modifier_setApp_5F_name (GALGAS_lstring inValue
                                                COMMA_UNUSED_LOCATION_ARGS) {
  if (NULL != mObjectPtr) {
    cPtr_os_5F_obj * p = (cPtr_os_5F_obj *) mObjectPtr ;
    macroValidSharedObject (p, cPtr_os_5F_obj) ;
    p->mAttribute_app_5F_name = inValue ;
  }
}

//---------------------------------------------------------------------------*

void GALGAS_os_5F_obj::modifier_setTpl_5F_base_5F_path (GALGAS_lstring inValue
                                                        COMMA_UNUSED_LOCATION_ARGS) {
  if (NULL != mObjectPtr) {
    cPtr_os_5F_obj * p = (cPtr_os_5F_obj *) mObjectPtr ;
    macroValidSharedObject (p, cPtr_os_5F_obj) ;
    p->mAttribute_tpl_5F_base_5F_path = inValue ;
  }
}

//---------------------------------------------------------------------------*

void GALGAS_os_5F_obj::modifier_setTrace (GALGAS_trace inValue
                                          COMMA_UNUSED_LOCATION_ARGS) {
  if (NULL != mObjectPtr) {
    cPtr_os_5F_obj * p = (cPtr_os_5F_obj *) mObjectPtr ;
    macroValidSharedObject (p, cPtr_os_5F_obj) ;
    p->mAttribute_trace = inValue ;
  }
}

//---------------------------------------------------------------------------*

void GALGAS_os_5F_obj::modifier_setOthers (GALGAS_ident_5F_map inValue
                                           COMMA_UNUSED_LOCATION_ARGS) {
  if (NULL != mObjectPtr) {
    cPtr_os_5F_obj * p = (cPtr_os_5F_obj *) mObjectPtr ;
    macroValidSharedObject (p, cPtr_os_5F_obj) ;
    p->mAttribute_others = inValue ;
  }
}

//---------------------------------------------------------------------------*
//                      Pointer class for @os_obj class                      *
//---------------------------------------------------------------------------*

cPtr_os_5F_obj::cPtr_os_5F_obj (const GALGAS_lstring & in_desc,
                                const GALGAS_lstring & in_status,
                                const GALGAS_basic_5F_type & in_startuphook,
                                const GALGAS_basic_5F_type & in_shutdownhook,
                                const GALGAS_basic_5F_type & in_errorhook,
                                const GALGAS_basic_5F_type & in_pretaskhook,
                                const GALGAS_basic_5F_type & in_posttaskhook,
                                const GALGAS_basic_5F_type & in_protectionhook,
                                const GALGAS_lstring & in_scalabilityclass,
                                const GALGAS_basic_5F_type & in_stackmonitoring,
                                const GALGAS_basic_5F_type & in_usegetserviceid,
                                const GALGAS_basic_5F_type & in_useparameteraccess,
                                const GALGAS_basic_5F_type & in_useresscheduler,
                                const GALGAS_basic_5F_type & in_systemcall,
                                const GALGAS_basic_5F_type & in_debug,
                                const GALGAS_basic_5F_type & in_memmap,
                                const GALGAS_lstringlist & in_app_5F_src,
                                const GALGAS_lstring & in_compiler,
                                const GALGAS_lstring & in_assembler,
                                const GALGAS_lstring & in_linker,
                                const GALGAS_lstringlist & in_cflags,
                                const GALGAS_lstringlist & in_cppflags,
                                const GALGAS_lstringlist & in_asflags,
                                const GALGAS_lstringlist & in_ldflags,
                                const GALGAS_lstring & in_app_5F_name,
                                const GALGAS_lstring & in_tpl_5F_base_5F_path,
                                const GALGAS_trace & in_trace,
                                const GALGAS_ident_5F_map & in_others
                                COMMA_LOCATION_ARGS) :
cPtr_oil_5F_obj (in_desc COMMA_THERE),
mAttribute_status (in_status),
mAttribute_startuphook (in_startuphook),
mAttribute_shutdownhook (in_shutdownhook),
mAttribute_errorhook (in_errorhook),
mAttribute_pretaskhook (in_pretaskhook),
mAttribute_posttaskhook (in_posttaskhook),
mAttribute_protectionhook (in_protectionhook),
mAttribute_scalabilityclass (in_scalabilityclass),
mAttribute_stackmonitoring (in_stackmonitoring),
mAttribute_usegetserviceid (in_usegetserviceid),
mAttribute_useparameteraccess (in_useparameteraccess),
mAttribute_useresscheduler (in_useresscheduler),
mAttribute_systemcall (in_systemcall),
mAttribute_debug (in_debug),
mAttribute_memmap (in_memmap),
mAttribute_app_5F_src (in_app_5F_src),
mAttribute_compiler (in_compiler),
mAttribute_assembler (in_assembler),
mAttribute_linker (in_linker),
mAttribute_cflags (in_cflags),
mAttribute_cppflags (in_cppflags),
mAttribute_asflags (in_asflags),
mAttribute_ldflags (in_ldflags),
mAttribute_app_5F_name (in_app_5F_name),
mAttribute_tpl_5F_base_5F_path (in_tpl_5F_base_5F_path),
mAttribute_trace (in_trace),
mAttribute_others (in_others) {
}

//---------------------------------------------------------------------------*

const C_galgas_type_descriptor * cPtr_os_5F_obj::classDescriptor (void) const {
  return & kTypeDescriptor_GALGAS_os_5F_obj ;
}

void cPtr_os_5F_obj::description (C_String & ioString,
                                  const PMSInt32 inIndentation) const {
  ioString << "[@os_obj:" ;
  mAttribute_desc.description (ioString, inIndentation+1) ;
  ioString << ", " ;
  mAttribute_status.description (ioString, inIndentation+1) ;
  ioString << ", " ;
  mAttribute_startuphook.description (ioString, inIndentation+1) ;
  ioString << ", " ;
  mAttribute_shutdownhook.description (ioString, inIndentation+1) ;
  ioString << ", " ;
  mAttribute_errorhook.description (ioString, inIndentation+1) ;
  ioString << ", " ;
  mAttribute_pretaskhook.description (ioString, inIndentation+1) ;
  ioString << ", " ;
  mAttribute_posttaskhook.description (ioString, inIndentation+1) ;
  ioString << ", " ;
  mAttribute_protectionhook.description (ioString, inIndentation+1) ;
  ioString << ", " ;
  mAttribute_scalabilityclass.description (ioString, inIndentation+1) ;
  ioString << ", " ;
  mAttribute_stackmonitoring.description (ioString, inIndentation+1) ;
  ioString << ", " ;
  mAttribute_usegetserviceid.description (ioString, inIndentation+1) ;
  ioString << ", " ;
  mAttribute_useparameteraccess.description (ioString, inIndentation+1) ;
  ioString << ", " ;
  mAttribute_useresscheduler.description (ioString, inIndentation+1) ;
  ioString << ", " ;
  mAttribute_systemcall.description (ioString, inIndentation+1) ;
  ioString << ", " ;
  mAttribute_debug.description (ioString, inIndentation+1) ;
  ioString << ", " ;
  mAttribute_memmap.description (ioString, inIndentation+1) ;
  ioString << ", " ;
  mAttribute_app_5F_src.description (ioString, inIndentation+1) ;
  ioString << ", " ;
  mAttribute_compiler.description (ioString, inIndentation+1) ;
  ioString << ", " ;
  mAttribute_assembler.description (ioString, inIndentation+1) ;
  ioString << ", " ;
  mAttribute_linker.description (ioString, inIndentation+1) ;
  ioString << ", " ;
  mAttribute_cflags.description (ioString, inIndentation+1) ;
  ioString << ", " ;
  mAttribute_cppflags.description (ioString, inIndentation+1) ;
  ioString << ", " ;
  mAttribute_asflags.description (ioString, inIndentation+1) ;
  ioString << ", " ;
  mAttribute_ldflags.description (ioString, inIndentation+1) ;
  ioString << ", " ;
  mAttribute_app_5F_name.description (ioString, inIndentation+1) ;
  ioString << ", " ;
  mAttribute_tpl_5F_base_5F_path.description (ioString, inIndentation+1) ;
  ioString << ", " ;
  mAttribute_trace.description (ioString, inIndentation+1) ;
  ioString << ", " ;
  mAttribute_others.description (ioString, inIndentation+1) ;
  ioString << "]" ;
}



//---------------------------------------------------------------------------*
//                                                                           *
//                               @os_obj type                                *
//                                                                           *
//---------------------------------------------------------------------------*

const C_galgas_type_descriptor
kTypeDescriptor_GALGAS_os_5F_obj ("os_obj",
                                  & kTypeDescriptor_GALGAS_oil_5F_obj) ;

//---------------------------------------------------------------------------*

const C_galgas_type_descriptor * GALGAS_os_5F_obj::staticTypeDescriptor (void) const {
  return & kTypeDescriptor_GALGAS_os_5F_obj ;
}

//---------------------------------------------------------------------------*

AC_GALGAS_root * GALGAS_os_5F_obj::clonedObject (void) const {
  AC_GALGAS_root * result = NULL ;
  if (isValid ()) {
    macroMyNew (result, GALGAS_os_5F_obj (*this)) ;
  }
  return result ;
}

//---------------------------------------------------------------------------*

GALGAS_os_5F_obj GALGAS_os_5F_obj::extractObject (const GALGAS_object & inObject,
                                                  C_Compiler * inCompiler,
                                                  const GALGAS_location & inErrorLocation
                                                  COMMA_LOCATION_ARGS) {
  GALGAS_os_5F_obj result ;
  const GALGAS_os_5F_obj * p = (const GALGAS_os_5F_obj *) inObject.embeddedObject () ;
  if (NULL != p) {
    if (NULL != dynamic_cast <const GALGAS_os_5F_obj *> (p)) {
      result = *p ;
    }else{
      inCompiler->extractObjectError (inErrorLocation, "os_obj", p->dynamicTypeDescriptor () COMMA_THERE) ;
    }  
  }
  return result ;
}

//---------------------------------------------------------------------------*

enumComparisonResult GALGAS_trace::objectCompare (const GALGAS_trace & inOperand) const {
  enumComparisonResult result = kOperandEqual ;
  const cPtr_trace * p = (const cPtr_trace *) mObjectPtr ;
  macroNullOrValidSharedObject (p, const cPtr_trace) ;
  const cPtr_trace * q = (const cPtr_trace *) inOperand.mObjectPtr ;
  macroNullOrValidSharedObject (q, const cPtr_trace) ;
  if (kOperandEqual == result) {
    result = p->mAttribute_loc.objectCompare (q->mAttribute_loc) ;
  }
  return result ;
}


//---------------------------------------------------------------------------*

GALGAS_trace::GALGAS_trace (void) :
AC_GALGAS_class () {
}

//---------------------------------------------------------------------------*

GALGAS_trace::GALGAS_trace (const cPtr_trace * inSourcePtr) :
AC_GALGAS_class (inSourcePtr) {
  macroNullOrValidSharedObject (inSourcePtr, const cPtr_trace) ;
}

//---------------------------------------------------------------------------*

GALGAS_trace GALGAS_trace::constructor_new (const GALGAS_location & inAttribute_loc
                                            COMMA_LOCATION_ARGS) {
  GALGAS_trace result ;
  if (inAttribute_loc.isValid ()) {
    macroMyNew (result.mObjectPtr, cPtr_trace (inAttribute_loc COMMA_THERE)) ;
  }
  return result ;
}

//---------------------------------------------------------------------------*

void GALGAS_trace::insulate (LOCATION_ARGS) {
  if (isValid () && (mObjectPtr->retainCount () > 1)) {
    cPtr_trace * p = (cPtr_trace *) mObjectPtr ;
    macroValidSharedObject (p, cPtr_trace) ;
    cPtr_trace * r = NULL ;
    macroMyNew (r, cPtr_trace (p->mAttribute_loc COMMA_THERE)) ;
    macroAssignSharedObject (mObjectPtr, r) ;
    macroDetachSharedObject (r) ;
  }
}

//---------------------------------------------------------------------------*

GALGAS_location GALGAS_trace::reader_loc (UNUSED_LOCATION_ARGS) const {
  GALGAS_location result ;
  if (NULL != mObjectPtr) {
    const cPtr_trace * p = (const cPtr_trace *) mObjectPtr ;
    macroValidSharedObject (p, const cPtr_trace) ;
    result = p->mAttribute_loc ;
  }
  return result ;
}

//---------------------------------------------------------------------------*
//                      Pointer class for @trace class                       *
//---------------------------------------------------------------------------*

cPtr_trace::cPtr_trace (const GALGAS_location & in_loc
                        COMMA_LOCATION_ARGS) :
acPtr_class (THERE),
mAttribute_loc (in_loc) {
}

//---------------------------------------------------------------------------*

const C_galgas_type_descriptor * cPtr_trace::classDescriptor (void) const {
  return & kTypeDescriptor_GALGAS_trace ;
}

void cPtr_trace::description (C_String & ioString,
                              const PMSInt32 inIndentation) const {
  ioString << "[@trace:" ;
  mAttribute_loc.description (ioString, inIndentation+1) ;
  ioString << "]" ;
}



//---------------------------------------------------------------------------*
//                                                                           *
//                                @trace type                                *
//                                                                           *
//---------------------------------------------------------------------------*

const C_galgas_type_descriptor
kTypeDescriptor_GALGAS_trace ("trace",
                              NULL) ;

//---------------------------------------------------------------------------*

const C_galgas_type_descriptor * GALGAS_trace::staticTypeDescriptor (void) const {
  return & kTypeDescriptor_GALGAS_trace ;
}

//---------------------------------------------------------------------------*

AC_GALGAS_root * GALGAS_trace::clonedObject (void) const {
  AC_GALGAS_root * result = NULL ;
  if (isValid ()) {
    macroMyNew (result, GALGAS_trace (*this)) ;
  }
  return result ;
}

//---------------------------------------------------------------------------*

GALGAS_trace GALGAS_trace::extractObject (const GALGAS_object & inObject,
                                          C_Compiler * inCompiler,
                                          const GALGAS_location & inErrorLocation
                                          COMMA_LOCATION_ARGS) {
  GALGAS_trace result ;
  const GALGAS_trace * p = (const GALGAS_trace *) inObject.embeddedObject () ;
  if (NULL != p) {
    if (NULL != dynamic_cast <const GALGAS_trace *> (p)) {
      result = *p ;
    }else{
      inCompiler->extractObjectError (inErrorLocation, "trace", p->dynamicTypeDescriptor () COMMA_THERE) ;
    }  
  }
  return result ;
}

//---------------------------------------------------------------------------*

enumComparisonResult GALGAS_trace_5F_off::objectCompare (const GALGAS_trace_5F_off & inOperand) const {
  return (isValid () && inOperand.isValid ()) ? kOperandEqual : kOperandNotValid ;
}


//---------------------------------------------------------------------------*

GALGAS_trace_5F_off::GALGAS_trace_5F_off (void) :
GALGAS_trace () {
}

//---------------------------------------------------------------------------*

GALGAS_trace_5F_off::GALGAS_trace_5F_off (const cPtr_trace_5F_off * inSourcePtr) :
GALGAS_trace (inSourcePtr) {
  macroNullOrValidSharedObject (inSourcePtr, const cPtr_trace_5F_off) ;
}

//---------------------------------------------------------------------------*

GALGAS_trace_5F_off GALGAS_trace_5F_off::constructor_new (const GALGAS_location & inAttribute_loc
                                                          COMMA_LOCATION_ARGS) {
  GALGAS_trace_5F_off result ;
  if (inAttribute_loc.isValid ()) {
    macroMyNew (result.mObjectPtr, cPtr_trace_5F_off (inAttribute_loc COMMA_THERE)) ;
  }
  return result ;
}

//---------------------------------------------------------------------------*

void GALGAS_trace_5F_off::insulate (LOCATION_ARGS) {
  if (isValid () && (mObjectPtr->retainCount () > 1)) {
    cPtr_trace_5F_off * p = (cPtr_trace_5F_off *) mObjectPtr ;
    macroValidSharedObject (p, cPtr_trace_5F_off) ;
    cPtr_trace_5F_off * r = NULL ;
    macroMyNew (r, cPtr_trace_5F_off (p->mAttribute_loc COMMA_THERE)) ;
    macroAssignSharedObject (mObjectPtr, r) ;
    macroDetachSharedObject (r) ;
  }
}

//---------------------------------------------------------------------------*
//                    Pointer class for @trace_off class                     *
//---------------------------------------------------------------------------*

cPtr_trace_5F_off::cPtr_trace_5F_off (const GALGAS_location & in_loc
                                      COMMA_LOCATION_ARGS) :
cPtr_trace (in_loc COMMA_THERE) {
}

//---------------------------------------------------------------------------*

const C_galgas_type_descriptor * cPtr_trace_5F_off::classDescriptor (void) const {
  return & kTypeDescriptor_GALGAS_trace_5F_off ;
}

void cPtr_trace_5F_off::description (C_String & ioString,
                                     const PMSInt32 inIndentation) const {
  ioString << "[@trace_off:" ;
  mAttribute_loc.description (ioString, inIndentation+1) ;
  ioString << "]" ;
}



//---------------------------------------------------------------------------*
//                                                                           *
//                              @trace_off type                              *
//                                                                           *
//---------------------------------------------------------------------------*

const C_galgas_type_descriptor
kTypeDescriptor_GALGAS_trace_5F_off ("trace_off",
                                     & kTypeDescriptor_GALGAS_trace) ;

//---------------------------------------------------------------------------*

const C_galgas_type_descriptor * GALGAS_trace_5F_off::staticTypeDescriptor (void) const {
  return & kTypeDescriptor_GALGAS_trace_5F_off ;
}

//---------------------------------------------------------------------------*

AC_GALGAS_root * GALGAS_trace_5F_off::clonedObject (void) const {
  AC_GALGAS_root * result = NULL ;
  if (isValid ()) {
    macroMyNew (result, GALGAS_trace_5F_off (*this)) ;
  }
  return result ;
}

//---------------------------------------------------------------------------*

GALGAS_trace_5F_off GALGAS_trace_5F_off::extractObject (const GALGAS_object & inObject,
                                                        C_Compiler * inCompiler,
                                                        const GALGAS_location & inErrorLocation
                                                        COMMA_LOCATION_ARGS) {
  GALGAS_trace_5F_off result ;
  const GALGAS_trace_5F_off * p = (const GALGAS_trace_5F_off *) inObject.embeddedObject () ;
  if (NULL != p) {
    if (NULL != dynamic_cast <const GALGAS_trace_5F_off *> (p)) {
      result = *p ;
    }else{
      inCompiler->extractObjectError (inErrorLocation, "trace_off", p->dynamicTypeDescriptor () COMMA_THERE) ;
    }  
  }
  return result ;
}

//---------------------------------------------------------------------------*

enumComparisonResult GALGAS_trace_5F_on::objectCompare (const GALGAS_trace_5F_on & inOperand) const {
  enumComparisonResult result = GALGAS_trace::objectCompare (inOperand) ;
  const cPtr_trace_5F_on * p = (const cPtr_trace_5F_on *) mObjectPtr ;
  macroNullOrValidSharedObject (p, const cPtr_trace_5F_on) ;
  const cPtr_trace_5F_on * q = (const cPtr_trace_5F_on *) inOperand.mObjectPtr ;
  macroNullOrValidSharedObject (q, const cPtr_trace_5F_on) ;
  if (kOperandEqual == result) {
    result = p->mAttribute_form.objectCompare (q->mAttribute_form) ;
  }
  if (kOperandEqual == result) {
    result = p->mAttribute_meth.objectCompare (q->mAttribute_meth) ;
  }
  if (kOperandEqual == result) {
    result = p->mAttribute_trace_5F_task.objectCompare (q->mAttribute_trace_5F_task) ;
  }
  if (kOperandEqual == result) {
    result = p->mAttribute_trace_5F_isr.objectCompare (q->mAttribute_trace_5F_isr) ;
  }
  if (kOperandEqual == result) {
    result = p->mAttribute_trace_5F_resource.objectCompare (q->mAttribute_trace_5F_resource) ;
  }
  if (kOperandEqual == result) {
    result = p->mAttribute_trace_5F_alarm.objectCompare (q->mAttribute_trace_5F_alarm) ;
  }
  if (kOperandEqual == result) {
    result = p->mAttribute_trace_5F_user_5F_event.objectCompare (q->mAttribute_trace_5F_user_5F_event) ;
  }
  if (kOperandEqual == result) {
    result = p->mAttribute_desc.objectCompare (q->mAttribute_desc) ;
  }
  return result ;
}


//---------------------------------------------------------------------------*

GALGAS_trace_5F_on::GALGAS_trace_5F_on (void) :
GALGAS_trace () {
}

//---------------------------------------------------------------------------*

GALGAS_trace_5F_on::GALGAS_trace_5F_on (const cPtr_trace_5F_on * inSourcePtr) :
GALGAS_trace (inSourcePtr) {
  macroNullOrValidSharedObject (inSourcePtr, const cPtr_trace_5F_on) ;
}

//---------------------------------------------------------------------------*

GALGAS_trace_5F_on GALGAS_trace_5F_on::constructor_new (const GALGAS_location & inAttribute_loc,
                                                        const GALGAS_lstring & inAttribute_form,
                                                        const GALGAS_trace_5F_method & inAttribute_meth,
                                                        const GALGAS_basic_5F_type & inAttribute_trace_5F_task,
                                                        const GALGAS_basic_5F_type & inAttribute_trace_5F_isr,
                                                        const GALGAS_basic_5F_type & inAttribute_trace_5F_resource,
                                                        const GALGAS_basic_5F_type & inAttribute_trace_5F_alarm,
                                                        const GALGAS_basic_5F_type & inAttribute_trace_5F_user_5F_event,
                                                        const GALGAS_basic_5F_type & inAttribute_desc
                                                        COMMA_LOCATION_ARGS) {
  GALGAS_trace_5F_on result ;
  if (inAttribute_loc.isValid () && inAttribute_form.isValid () && inAttribute_meth.isValid () && inAttribute_trace_5F_task.isValid () && inAttribute_trace_5F_isr.isValid () && inAttribute_trace_5F_resource.isValid () && inAttribute_trace_5F_alarm.isValid () && inAttribute_trace_5F_user_5F_event.isValid () && inAttribute_desc.isValid ()) {
    macroMyNew (result.mObjectPtr, cPtr_trace_5F_on (inAttribute_loc, inAttribute_form, inAttribute_meth, inAttribute_trace_5F_task, inAttribute_trace_5F_isr, inAttribute_trace_5F_resource, inAttribute_trace_5F_alarm, inAttribute_trace_5F_user_5F_event, inAttribute_desc COMMA_THERE)) ;
  }
  return result ;
}

//---------------------------------------------------------------------------*

void GALGAS_trace_5F_on::insulate (LOCATION_ARGS) {
  if (isValid () && (mObjectPtr->retainCount () > 1)) {
    cPtr_trace_5F_on * p = (cPtr_trace_5F_on *) mObjectPtr ;
    macroValidSharedObject (p, cPtr_trace_5F_on) ;
    cPtr_trace_5F_on * r = NULL ;
    macroMyNew (r, cPtr_trace_5F_on (p->mAttribute_loc, p->mAttribute_form, p->mAttribute_meth, p->mAttribute_trace_5F_task, p->mAttribute_trace_5F_isr, p->mAttribute_trace_5F_resource, p->mAttribute_trace_5F_alarm, p->mAttribute_trace_5F_user_5F_event, p->mAttribute_desc COMMA_THERE)) ;
    macroAssignSharedObject (mObjectPtr, r) ;
    macroDetachSharedObject (r) ;
  }
}

//---------------------------------------------------------------------------*

GALGAS_lstring GALGAS_trace_5F_on::reader_form (UNUSED_LOCATION_ARGS) const {
  GALGAS_lstring result ;
  if (NULL != mObjectPtr) {
    const cPtr_trace_5F_on * p = (const cPtr_trace_5F_on *) mObjectPtr ;
    macroValidSharedObject (p, const cPtr_trace_5F_on) ;
    result = p->mAttribute_form ;
  }
  return result ;
}

//---------------------------------------------------------------------------*

GALGAS_trace_5F_method GALGAS_trace_5F_on::reader_meth (UNUSED_LOCATION_ARGS) const {
  GALGAS_trace_5F_method result ;
  if (NULL != mObjectPtr) {
    const cPtr_trace_5F_on * p = (const cPtr_trace_5F_on *) mObjectPtr ;
    macroValidSharedObject (p, const cPtr_trace_5F_on) ;
    result = p->mAttribute_meth ;
  }
  return result ;
}

//---------------------------------------------------------------------------*

GALGAS_basic_5F_type GALGAS_trace_5F_on::reader_trace_5F_task (UNUSED_LOCATION_ARGS) const {
  GALGAS_basic_5F_type result ;
  if (NULL != mObjectPtr) {
    const cPtr_trace_5F_on * p = (const cPtr_trace_5F_on *) mObjectPtr ;
    macroValidSharedObject (p, const cPtr_trace_5F_on) ;
    result = p->mAttribute_trace_5F_task ;
  }
  return result ;
}

//---------------------------------------------------------------------------*

GALGAS_basic_5F_type GALGAS_trace_5F_on::reader_trace_5F_isr (UNUSED_LOCATION_ARGS) const {
  GALGAS_basic_5F_type result ;
  if (NULL != mObjectPtr) {
    const cPtr_trace_5F_on * p = (const cPtr_trace_5F_on *) mObjectPtr ;
    macroValidSharedObject (p, const cPtr_trace_5F_on) ;
    result = p->mAttribute_trace_5F_isr ;
  }
  return result ;
}

//---------------------------------------------------------------------------*

GALGAS_basic_5F_type GALGAS_trace_5F_on::reader_trace_5F_resource (UNUSED_LOCATION_ARGS) const {
  GALGAS_basic_5F_type result ;
  if (NULL != mObjectPtr) {
    const cPtr_trace_5F_on * p = (const cPtr_trace_5F_on *) mObjectPtr ;
    macroValidSharedObject (p, const cPtr_trace_5F_on) ;
    result = p->mAttribute_trace_5F_resource ;
  }
  return result ;
}

//---------------------------------------------------------------------------*

GALGAS_basic_5F_type GALGAS_trace_5F_on::reader_trace_5F_alarm (UNUSED_LOCATION_ARGS) const {
  GALGAS_basic_5F_type result ;
  if (NULL != mObjectPtr) {
    const cPtr_trace_5F_on * p = (const cPtr_trace_5F_on *) mObjectPtr ;
    macroValidSharedObject (p, const cPtr_trace_5F_on) ;
    result = p->mAttribute_trace_5F_alarm ;
  }
  return result ;
}

//---------------------------------------------------------------------------*

GALGAS_basic_5F_type GALGAS_trace_5F_on::reader_trace_5F_user_5F_event (UNUSED_LOCATION_ARGS) const {
  GALGAS_basic_5F_type result ;
  if (NULL != mObjectPtr) {
    const cPtr_trace_5F_on * p = (const cPtr_trace_5F_on *) mObjectPtr ;
    macroValidSharedObject (p, const cPtr_trace_5F_on) ;
    result = p->mAttribute_trace_5F_user_5F_event ;
  }
  return result ;
}

//---------------------------------------------------------------------------*

GALGAS_basic_5F_type GALGAS_trace_5F_on::reader_desc (UNUSED_LOCATION_ARGS) const {
  GALGAS_basic_5F_type result ;
  if (NULL != mObjectPtr) {
    const cPtr_trace_5F_on * p = (const cPtr_trace_5F_on *) mObjectPtr ;
    macroValidSharedObject (p, const cPtr_trace_5F_on) ;
    result = p->mAttribute_desc ;
  }
  return result ;
}

//---------------------------------------------------------------------------*
//                     Pointer class for @trace_on class                     *
//---------------------------------------------------------------------------*

cPtr_trace_5F_on::cPtr_trace_5F_on (const GALGAS_location & in_loc,
                                    const GALGAS_lstring & in_form,
                                    const GALGAS_trace_5F_method & in_meth,
                                    const GALGAS_basic_5F_type & in_trace_5F_task,
                                    const GALGAS_basic_5F_type & in_trace_5F_isr,
                                    const GALGAS_basic_5F_type & in_trace_5F_resource,
                                    const GALGAS_basic_5F_type & in_trace_5F_alarm,
                                    const GALGAS_basic_5F_type & in_trace_5F_user_5F_event,
                                    const GALGAS_basic_5F_type & in_desc
                                    COMMA_LOCATION_ARGS) :
cPtr_trace (in_loc COMMA_THERE),
mAttribute_form (in_form),
mAttribute_meth (in_meth),
mAttribute_trace_5F_task (in_trace_5F_task),
mAttribute_trace_5F_isr (in_trace_5F_isr),
mAttribute_trace_5F_resource (in_trace_5F_resource),
mAttribute_trace_5F_alarm (in_trace_5F_alarm),
mAttribute_trace_5F_user_5F_event (in_trace_5F_user_5F_event),
mAttribute_desc (in_desc) {
}

//---------------------------------------------------------------------------*

const C_galgas_type_descriptor * cPtr_trace_5F_on::classDescriptor (void) const {
  return & kTypeDescriptor_GALGAS_trace_5F_on ;
}

void cPtr_trace_5F_on::description (C_String & ioString,
                                    const PMSInt32 inIndentation) const {
  ioString << "[@trace_on:" ;
  mAttribute_loc.description (ioString, inIndentation+1) ;
  ioString << ", " ;
  mAttribute_form.description (ioString, inIndentation+1) ;
  ioString << ", " ;
  mAttribute_meth.description (ioString, inIndentation+1) ;
  ioString << ", " ;
  mAttribute_trace_5F_task.description (ioString, inIndentation+1) ;
  ioString << ", " ;
  mAttribute_trace_5F_isr.description (ioString, inIndentation+1) ;
  ioString << ", " ;
  mAttribute_trace_5F_resource.description (ioString, inIndentation+1) ;
  ioString << ", " ;
  mAttribute_trace_5F_alarm.description (ioString, inIndentation+1) ;
  ioString << ", " ;
  mAttribute_trace_5F_user_5F_event.description (ioString, inIndentation+1) ;
  ioString << ", " ;
  mAttribute_desc.description (ioString, inIndentation+1) ;
  ioString << "]" ;
}



//---------------------------------------------------------------------------*
//                                                                           *
//                              @trace_on type                               *
//                                                                           *
//---------------------------------------------------------------------------*

const C_galgas_type_descriptor
kTypeDescriptor_GALGAS_trace_5F_on ("trace_on",
                                    & kTypeDescriptor_GALGAS_trace) ;

//---------------------------------------------------------------------------*

const C_galgas_type_descriptor * GALGAS_trace_5F_on::staticTypeDescriptor (void) const {
  return & kTypeDescriptor_GALGAS_trace_5F_on ;
}

//---------------------------------------------------------------------------*

AC_GALGAS_root * GALGAS_trace_5F_on::clonedObject (void) const {
  AC_GALGAS_root * result = NULL ;
  if (isValid ()) {
    macroMyNew (result, GALGAS_trace_5F_on (*this)) ;
  }
  return result ;
}

//---------------------------------------------------------------------------*

GALGAS_trace_5F_on GALGAS_trace_5F_on::extractObject (const GALGAS_object & inObject,
                                                      C_Compiler * inCompiler,
                                                      const GALGAS_location & inErrorLocation
                                                      COMMA_LOCATION_ARGS) {
  GALGAS_trace_5F_on result ;
  const GALGAS_trace_5F_on * p = (const GALGAS_trace_5F_on *) inObject.embeddedObject () ;
  if (NULL != p) {
    if (NULL != dynamic_cast <const GALGAS_trace_5F_on *> (p)) {
      result = *p ;
    }else{
      inCompiler->extractObjectError (inErrorLocation, "trace_on", p->dynamicTypeDescriptor () COMMA_THERE) ;
    }  
  }
  return result ;
}

//---------------------------------------------------------------------------*

enumComparisonResult GALGAS_trace_5F_method::objectCompare (const GALGAS_trace_5F_method & inOperand) const {
  enumComparisonResult result = kOperandEqual ;
  const cPtr_trace_5F_method * p = (const cPtr_trace_5F_method *) mObjectPtr ;
  macroNullOrValidSharedObject (p, const cPtr_trace_5F_method) ;
  const cPtr_trace_5F_method * q = (const cPtr_trace_5F_method *) inOperand.mObjectPtr ;
  macroNullOrValidSharedObject (q, const cPtr_trace_5F_method) ;
  if (kOperandEqual == result) {
    result = p->mAttribute_loc.objectCompare (q->mAttribute_loc) ;
  }
  return result ;
}


//---------------------------------------------------------------------------*

GALGAS_trace_5F_method::GALGAS_trace_5F_method (void) :
AC_GALGAS_class () {
}

//---------------------------------------------------------------------------*

GALGAS_trace_5F_method::GALGAS_trace_5F_method (const cPtr_trace_5F_method * inSourcePtr) :
AC_GALGAS_class (inSourcePtr) {
  macroNullOrValidSharedObject (inSourcePtr, const cPtr_trace_5F_method) ;
}

//---------------------------------------------------------------------------*

GALGAS_location GALGAS_trace_5F_method::reader_loc (UNUSED_LOCATION_ARGS) const {
  GALGAS_location result ;
  if (NULL != mObjectPtr) {
    const cPtr_trace_5F_method * p = (const cPtr_trace_5F_method *) mObjectPtr ;
    macroValidSharedObject (p, const cPtr_trace_5F_method) ;
    result = p->mAttribute_loc ;
  }
  return result ;
}

//---------------------------------------------------------------------------*
//                   Pointer class for @trace_method class                   *
//---------------------------------------------------------------------------*

cPtr_trace_5F_method::cPtr_trace_5F_method (const GALGAS_location & in_loc
                                            COMMA_LOCATION_ARGS) :
acPtr_class (THERE),
mAttribute_loc (in_loc) {
}



//---------------------------------------------------------------------------*
//                                                                           *
//                            @trace_method type                             *
//                                                                           *
//---------------------------------------------------------------------------*

const C_galgas_type_descriptor
kTypeDescriptor_GALGAS_trace_5F_method ("trace_method",
                                        NULL) ;

//---------------------------------------------------------------------------*

const C_galgas_type_descriptor * GALGAS_trace_5F_method::staticTypeDescriptor (void) const {
  return & kTypeDescriptor_GALGAS_trace_5F_method ;
}

//---------------------------------------------------------------------------*

AC_GALGAS_root * GALGAS_trace_5F_method::clonedObject (void) const {
  AC_GALGAS_root * result = NULL ;
  if (isValid ()) {
    macroMyNew (result, GALGAS_trace_5F_method (*this)) ;
  }
  return result ;
}

//---------------------------------------------------------------------------*

GALGAS_trace_5F_method GALGAS_trace_5F_method::extractObject (const GALGAS_object & inObject,
                                                              C_Compiler * inCompiler,
                                                              const GALGAS_location & inErrorLocation
                                                              COMMA_LOCATION_ARGS) {
  GALGAS_trace_5F_method result ;
  const GALGAS_trace_5F_method * p = (const GALGAS_trace_5F_method *) inObject.embeddedObject () ;
  if (NULL != p) {
    if (NULL != dynamic_cast <const GALGAS_trace_5F_method *> (p)) {
      result = *p ;
    }else{
      inCompiler->extractObjectError (inErrorLocation, "trace_method", p->dynamicTypeDescriptor () COMMA_THERE) ;
    }  
  }
  return result ;
}

//---------------------------------------------------------------------------*

enumComparisonResult GALGAS_trace_5F_file::objectCompare (const GALGAS_trace_5F_file & inOperand) const {
  enumComparisonResult result = GALGAS_trace_5F_method::objectCompare (inOperand) ;
  const cPtr_trace_5F_file * p = (const cPtr_trace_5F_file *) mObjectPtr ;
  macroNullOrValidSharedObject (p, const cPtr_trace_5F_file) ;
  const cPtr_trace_5F_file * q = (const cPtr_trace_5F_file *) inOperand.mObjectPtr ;
  macroNullOrValidSharedObject (q, const cPtr_trace_5F_file) ;
  if (kOperandEqual == result) {
    result = p->mAttribute_name.objectCompare (q->mAttribute_name) ;
  }
  return result ;
}


//---------------------------------------------------------------------------*

GALGAS_trace_5F_file::GALGAS_trace_5F_file (void) :
GALGAS_trace_5F_method () {
}

//---------------------------------------------------------------------------*

GALGAS_trace_5F_file::GALGAS_trace_5F_file (const cPtr_trace_5F_file * inSourcePtr) :
GALGAS_trace_5F_method (inSourcePtr) {
  macroNullOrValidSharedObject (inSourcePtr, const cPtr_trace_5F_file) ;
}

//---------------------------------------------------------------------------*

GALGAS_trace_5F_file GALGAS_trace_5F_file::constructor_new (const GALGAS_location & inAttribute_loc,
                                                            const GALGAS_lstring & inAttribute_name
                                                            COMMA_LOCATION_ARGS) {
  GALGAS_trace_5F_file result ;
  if (inAttribute_loc.isValid () && inAttribute_name.isValid ()) {
    macroMyNew (result.mObjectPtr, cPtr_trace_5F_file (inAttribute_loc, inAttribute_name COMMA_THERE)) ;
  }
  return result ;
}

//---------------------------------------------------------------------------*

void GALGAS_trace_5F_file::insulate (LOCATION_ARGS) {
  if (isValid () && (mObjectPtr->retainCount () > 1)) {
    cPtr_trace_5F_file * p = (cPtr_trace_5F_file *) mObjectPtr ;
    macroValidSharedObject (p, cPtr_trace_5F_file) ;
    cPtr_trace_5F_file * r = NULL ;
    macroMyNew (r, cPtr_trace_5F_file (p->mAttribute_loc, p->mAttribute_name COMMA_THERE)) ;
    macroAssignSharedObject (mObjectPtr, r) ;
    macroDetachSharedObject (r) ;
  }
}

//---------------------------------------------------------------------------*

GALGAS_lstring GALGAS_trace_5F_file::reader_name (UNUSED_LOCATION_ARGS) const {
  GALGAS_lstring result ;
  if (NULL != mObjectPtr) {
    const cPtr_trace_5F_file * p = (const cPtr_trace_5F_file *) mObjectPtr ;
    macroValidSharedObject (p, const cPtr_trace_5F_file) ;
    result = p->mAttribute_name ;
  }
  return result ;
}

//---------------------------------------------------------------------------*
//                    Pointer class for @trace_file class                    *
//---------------------------------------------------------------------------*

cPtr_trace_5F_file::cPtr_trace_5F_file (const GALGAS_location & in_loc,
                                        const GALGAS_lstring & in_name
                                        COMMA_LOCATION_ARGS) :
cPtr_trace_5F_method (in_loc COMMA_THERE),
mAttribute_name (in_name) {
}

//---------------------------------------------------------------------------*

const C_galgas_type_descriptor * cPtr_trace_5F_file::classDescriptor (void) const {
  return & kTypeDescriptor_GALGAS_trace_5F_file ;
}

void cPtr_trace_5F_file::description (C_String & ioString,
                                      const PMSInt32 inIndentation) const {
  ioString << "[@trace_file:" ;
  mAttribute_loc.description (ioString, inIndentation+1) ;
  ioString << ", " ;
  mAttribute_name.description (ioString, inIndentation+1) ;
  ioString << "]" ;
}



//---------------------------------------------------------------------------*
//                                                                           *
//                             @trace_file type                              *
//                                                                           *
//---------------------------------------------------------------------------*

const C_galgas_type_descriptor
kTypeDescriptor_GALGAS_trace_5F_file ("trace_file",
                                      & kTypeDescriptor_GALGAS_trace_5F_method) ;

//---------------------------------------------------------------------------*

const C_galgas_type_descriptor * GALGAS_trace_5F_file::staticTypeDescriptor (void) const {
  return & kTypeDescriptor_GALGAS_trace_5F_file ;
}

//---------------------------------------------------------------------------*

AC_GALGAS_root * GALGAS_trace_5F_file::clonedObject (void) const {
  AC_GALGAS_root * result = NULL ;
  if (isValid ()) {
    macroMyNew (result, GALGAS_trace_5F_file (*this)) ;
  }
  return result ;
}

//---------------------------------------------------------------------------*

GALGAS_trace_5F_file GALGAS_trace_5F_file::extractObject (const GALGAS_object & inObject,
                                                          C_Compiler * inCompiler,
                                                          const GALGAS_location & inErrorLocation
                                                          COMMA_LOCATION_ARGS) {
  GALGAS_trace_5F_file result ;
  const GALGAS_trace_5F_file * p = (const GALGAS_trace_5F_file *) inObject.embeddedObject () ;
  if (NULL != p) {
    if (NULL != dynamic_cast <const GALGAS_trace_5F_file *> (p)) {
      result = *p ;
    }else{
      inCompiler->extractObjectError (inErrorLocation, "trace_file", p->dynamicTypeDescriptor () COMMA_THERE) ;
    }  
  }
  return result ;
}

//---------------------------------------------------------------------------*

enumComparisonResult GALGAS_trace_5F_void::objectCompare (const GALGAS_trace_5F_void & inOperand) const {
  return (isValid () && inOperand.isValid ()) ? kOperandEqual : kOperandNotValid ;
}


//---------------------------------------------------------------------------*

GALGAS_trace_5F_void::GALGAS_trace_5F_void (void) :
GALGAS_trace_5F_method () {
}

//---------------------------------------------------------------------------*

GALGAS_trace_5F_void::GALGAS_trace_5F_void (const cPtr_trace_5F_void * inSourcePtr) :
GALGAS_trace_5F_method (inSourcePtr) {
  macroNullOrValidSharedObject (inSourcePtr, const cPtr_trace_5F_void) ;
}

//---------------------------------------------------------------------------*

GALGAS_trace_5F_void GALGAS_trace_5F_void::constructor_new (const GALGAS_location & inAttribute_loc
                                                            COMMA_LOCATION_ARGS) {
  GALGAS_trace_5F_void result ;
  if (inAttribute_loc.isValid ()) {
    macroMyNew (result.mObjectPtr, cPtr_trace_5F_void (inAttribute_loc COMMA_THERE)) ;
  }
  return result ;
}

//---------------------------------------------------------------------------*

void GALGAS_trace_5F_void::insulate (LOCATION_ARGS) {
  if (isValid () && (mObjectPtr->retainCount () > 1)) {
    cPtr_trace_5F_void * p = (cPtr_trace_5F_void *) mObjectPtr ;
    macroValidSharedObject (p, cPtr_trace_5F_void) ;
    cPtr_trace_5F_void * r = NULL ;
    macroMyNew (r, cPtr_trace_5F_void (p->mAttribute_loc COMMA_THERE)) ;
    macroAssignSharedObject (mObjectPtr, r) ;
    macroDetachSharedObject (r) ;
  }
}

//---------------------------------------------------------------------------*
//                    Pointer class for @trace_void class                    *
//---------------------------------------------------------------------------*

cPtr_trace_5F_void::cPtr_trace_5F_void (const GALGAS_location & in_loc
                                        COMMA_LOCATION_ARGS) :
cPtr_trace_5F_method (in_loc COMMA_THERE) {
}

//---------------------------------------------------------------------------*

const C_galgas_type_descriptor * cPtr_trace_5F_void::classDescriptor (void) const {
  return & kTypeDescriptor_GALGAS_trace_5F_void ;
}

void cPtr_trace_5F_void::description (C_String & ioString,
                                      const PMSInt32 inIndentation) const {
  ioString << "[@trace_void:" ;
  mAttribute_loc.description (ioString, inIndentation+1) ;
  ioString << "]" ;
}



//---------------------------------------------------------------------------*
//                                                                           *
//                             @trace_void type                              *
//                                                                           *
//---------------------------------------------------------------------------*

const C_galgas_type_descriptor
kTypeDescriptor_GALGAS_trace_5F_void ("trace_void",
                                      & kTypeDescriptor_GALGAS_trace_5F_method) ;

//---------------------------------------------------------------------------*

const C_galgas_type_descriptor * GALGAS_trace_5F_void::staticTypeDescriptor (void) const {
  return & kTypeDescriptor_GALGAS_trace_5F_void ;
}

//---------------------------------------------------------------------------*

AC_GALGAS_root * GALGAS_trace_5F_void::clonedObject (void) const {
  AC_GALGAS_root * result = NULL ;
  if (isValid ()) {
    macroMyNew (result, GALGAS_trace_5F_void (*this)) ;
  }
  return result ;
}

//---------------------------------------------------------------------------*

GALGAS_trace_5F_void GALGAS_trace_5F_void::extractObject (const GALGAS_object & inObject,
                                                          C_Compiler * inCompiler,
                                                          const GALGAS_location & inErrorLocation
                                                          COMMA_LOCATION_ARGS) {
  GALGAS_trace_5F_void result ;
  const GALGAS_trace_5F_void * p = (const GALGAS_trace_5F_void *) inObject.embeddedObject () ;
  if (NULL != p) {
    if (NULL != dynamic_cast <const GALGAS_trace_5F_void *> (p)) {
      result = *p ;
    }else{
      inCompiler->extractObjectError (inErrorLocation, "trace_void", p->dynamicTypeDescriptor () COMMA_THERE) ;
    }  
  }
  return result ;
}

//--- START OF USER ZONE 2


//--- END OF USER ZONE 2


