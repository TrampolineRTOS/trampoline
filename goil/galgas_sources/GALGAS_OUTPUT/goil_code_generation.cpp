//---------------------------------------------------------------------------*
//                                                                           *
//                     File 'goil_code_generation.cpp'                       *
//                       Generated by version 1.9.11                         *
//                      april 30th, 2010, at 16h49'49"                       *
//                                                                           *
//---------------------------------------------------------------------------*

//--- START OF USER ZONE 1


//--- END OF USER ZONE 1

//---------------------------------------------------------------------------*

#include "version_libpm.h"
#if CURRENT_LIBPM_VERSION != 725
  #error "This file has been compiled with a version of GALGAS that uses libpm version 725, different than the current version (CURRENT_LIBPM_VERSION) of libpm"
#endif

//---------------------------------------------------------------------------*

#include <typeinfo>
#include "utilities/MF_MemoryControl.h"
#include "files/C_TextFileWrite.h"
#include "galgas/C_galgas_CLI_Options.h"
#include "goil_code_generation.h"

//---------------------------------------------------------------------------*

#ifndef DO_NOT_GENERATE_CHECKINGS
  #define SOURCE_FILE_AT_LINE(line) "goil_code_generation.gSemantics", line
  #define COMMA_SOURCE_FILE_AT_LINE(line) , SOURCE_FILE_AT_LINE(line)
#else
  #define SOURCE_FILE_AT_LINE(line) 
  #define COMMA_SOURCE_FILE_AT_LINE(line) 
#endif

//---------------------------------------------------------------------------*
//                                                                           *
//             Include directives generated by grammar includes              *
//                                                                           *
//---------------------------------------------------------------------------*

#include "api_grammar.h"
#include "cfg_grammar.h"

//--- START OF USER ZONE 2


//--- END OF USER ZONE 2

//---------------------------------------------------------------------------*
//                                                                           *
//             Implementation of routine "generate_signed_type"              *
//                                                                           *
//---------------------------------------------------------------------------*

void routine_generate_signed_type (C_Compiler & inLexique,
                                GGS_uint64   var_cas_count,
                                GGS_string  var_cas_err,
                                GGS_string & var_cas_type COMMA_UNUSED_LOCATION_ARGS) {
  #ifdef DEBUG_TRACE_ENABLED
    printf ("ENTER routine_generate_signed_type at %s:%d\n", __FILE__, __LINE__) ;
  #endif
  GGS_uint64  var_cas_max_s8 = GGS_uint64 (1ULL).left_shift_operation (inLexique, GGS_uint (7U) COMMA_SOURCE_FILE_AT_LINE (56)) ;
  GGS_uint64  var_cas_max_s16 = GGS_uint64 (1ULL).left_shift_operation (inLexique, GGS_uint (15U) COMMA_SOURCE_FILE_AT_LINE (57)) ;
  GGS_uint64  var_cas_max_s32 = GGS_uint64 (1ULL).left_shift_operation (inLexique, GGS_uint (31U) COMMA_SOURCE_FILE_AT_LINE (58)) ;
  const GGS_bool cond_1833 = (var_cas_count).operator_strictInf (var_cas_max_s8) ;
  if (cond_1833.isBuiltAndTrue ()) {
    var_cas_type = GGS_string ("s8") ;
  }else if (cond_1833.isBuiltAndFalse ()) {
    const GGS_bool cond_1891 = (var_cas_count).operator_strictInf (var_cas_max_s16) ;
    if (cond_1891.isBuiltAndTrue ()) {
      var_cas_type = GGS_string ("s16") ;
    }else if (cond_1891.isBuiltAndFalse ()) {
      const GGS_bool cond_1955 = (var_cas_count).operator_strictInf (var_cas_max_s32) ;
      if (cond_1955.isBuiltAndTrue ()) {
        var_cas_type = GGS_string ("s32") ;
      }else if (cond_1955.isBuiltAndFalse ()) {
        var_cas_type = GGS_string ("") ;
        GGS_location (inLexique).reader_location (inLexique COMMA_HERE).signalGGSSemanticError (inLexique, var_cas_err COMMA_SOURCE_FILE_AT_LINE (71)) ;
      }
    }
  }
  #ifdef DEBUG_TRACE_ENABLED
    printf ("LEAVE routine_generate_signed_type\n") ;
  #endif
}

//---------------------------------------------------------------------------*
//                                                                           *
//            Implementation of routine "generate_unsigned_type"             *
//                                                                           *
//---------------------------------------------------------------------------*

void routine_generate_unsigned_type (C_Compiler & inLexique,
                                GGS_uint64   var_cas_count,
                                GGS_string  var_cas_err,
                                GGS_string & var_cas_type COMMA_UNUSED_LOCATION_ARGS) {
  #ifdef DEBUG_TRACE_ENABLED
    printf ("ENTER routine_generate_unsigned_type at %s:%d\n", __FILE__, __LINE__) ;
  #endif
  GGS_uint64  var_cas_max_u8 = GGS_uint64 (1ULL).left_shift_operation (inLexique, GGS_uint (8U) COMMA_SOURCE_FILE_AT_LINE (82)) ;
  GGS_uint64  var_cas_max_u16 = GGS_uint64 (1ULL).left_shift_operation (inLexique, GGS_uint (16U) COMMA_SOURCE_FILE_AT_LINE (83)) ;
  GGS_uint64  var_cas_max_u32 = GGS_uint64 (1ULL).left_shift_operation (inLexique, GGS_uint (32U) COMMA_SOURCE_FILE_AT_LINE (84)) ;
  const GGS_bool cond_2309 = (var_cas_count).operator_strictInf (var_cas_max_u8) ;
  if (cond_2309.isBuiltAndTrue ()) {
    var_cas_type = GGS_string ("u8") ;
  }else if (cond_2309.isBuiltAndFalse ()) {
    const GGS_bool cond_2367 = (var_cas_count).operator_strictInf (var_cas_max_u16) ;
    if (cond_2367.isBuiltAndTrue ()) {
      var_cas_type = GGS_string ("u16") ;
    }else if (cond_2367.isBuiltAndFalse ()) {
      const GGS_bool cond_2431 = (var_cas_count).operator_strictInf (var_cas_max_u32) ;
      if (cond_2431.isBuiltAndTrue ()) {
        var_cas_type = GGS_string ("u32") ;
      }else if (cond_2431.isBuiltAndFalse ()) {
        var_cas_type = GGS_string ("") ;
        GGS_location (inLexique).reader_location (inLexique COMMA_HERE).signalGGSSemanticError (inLexique, var_cas_err COMMA_SOURCE_FILE_AT_LINE (97)) ;
      }
    }
  }
  #ifdef DEBUG_TRACE_ENABLED
    printf ("LEAVE routine_generate_unsigned_type\n") ;
  #endif
}

//---------------------------------------------------------------------------*
//                                                                           *
//              Implementation of routine "generate_mask_type"               *
//                                                                           *
//---------------------------------------------------------------------------*

void routine_generate_mask_type (C_Compiler & inLexique,
                                GGS_uint64   var_cas_count,
                                GGS_string  var_cas_err,
                                GGS_string & var_cas_type COMMA_UNUSED_LOCATION_ARGS) {
  #ifdef DEBUG_TRACE_ENABLED
    printf ("ENTER routine_generate_mask_type at %s:%d\n", __FILE__, __LINE__) ;
  #endif
  GGS_uint64  var_cas_max_u8 = GGS_uint64 (8ULL) ;
  GGS_uint64  var_cas_max_u16 = GGS_uint64 (16ULL) ;
  GGS_uint64  var_cas_max_u32 = GGS_uint64 (32ULL) ;
  const GGS_bool cond_2767 = (var_cas_count).operator_infOrEqual (var_cas_max_u8) ;
  if (cond_2767.isBuiltAndTrue ()) {
    var_cas_type = GGS_string ("u8") ;
  }else if (cond_2767.isBuiltAndFalse ()) {
    const GGS_bool cond_2826 = (var_cas_count).operator_infOrEqual (var_cas_max_u16) ;
    if (cond_2826.isBuiltAndTrue ()) {
      var_cas_type = GGS_string ("u16") ;
    }else if (cond_2826.isBuiltAndFalse ()) {
      const GGS_bool cond_2891 = (var_cas_count).operator_infOrEqual (var_cas_max_u32) ;
      if (cond_2891.isBuiltAndTrue ()) {
        var_cas_type = GGS_string ("u32") ;
      }else if (cond_2891.isBuiltAndFalse ()) {
        var_cas_type = GGS_string ("") ;
        GGS_location (inLexique).reader_location (inLexique COMMA_HERE).signalGGSSemanticError (inLexique, var_cas_err COMMA_SOURCE_FILE_AT_LINE (123)) ;
      }
    }
  }
  #ifdef DEBUG_TRACE_ENABLED
    printf ("LEAVE routine_generate_mask_type\n") ;
  #endif
}

//---------------------------------------------------------------------------*
//                                                                           *
//                Implementation of routine "generate_types"                 *
//                                                                           *
//---------------------------------------------------------------------------*

void routine_generate_types (C_Compiler & inLexique,
                                GGS_task_map   var_cas_tasks,
                                GGS_isr_map   var_cas_isrs,
                                GGS_alarm_map   var_cas_alarms,
                                GGS_counter_map   var_cas_counters,
                                GGS_resource_map   var_cas_resources,
                                GGS_scheduletable_map   var_cas_schedtables,
                                GGS_app_map   var_cas_apps,
                                GGS_uint   var_cas_max_priority,
                                GGS_string & var_cas_types COMMA_UNUSED_LOCATION_ARGS) {
  #ifdef DEBUG_TRACE_ENABLED
    printf ("ENTER routine_generate_types at %s:%d\n", __FILE__, __LINE__) ;
  #endif
  GGS_string var_cas_type ;
  GGS_uint64  var_cas_max = GGS_uint64 (0ULL) ;
  GGS_uint64  var_cas_c ;
  var_cas_c = var_cas_tasks.reader_count ().reader_uint64 (inLexique COMMA_SOURCE_FILE_AT_LINE (144)).add_operation (inLexique, var_cas_isrs.reader_count ().reader_uint64 (inLexique COMMA_SOURCE_FILE_AT_LINE (144)) COMMA_SOURCE_FILE_AT_LINE (144)) ;
  const GGS_bool cond_3456 = (var_cas_c).operator_strictSup (var_cas_max) ;
  if (cond_3456.isBuiltAndTrue ()) {
    var_cas_max = var_cas_c ;
  }
  ::routine_generate_signed_type (inLexique,  var_cas_c,  GGS_string ("Too many processes (tasks and ISRs)"),  var_cas_type COMMA_SOURCE_FILE_AT_LINE (146)) ;
  var_cas_types = var_cas_types.reader_stringByReplacingStringByString (inLexique, GGS_string ("$PROC_ID_T$"), var_cas_type COMMA_SOURCE_FILE_AT_LINE (147)) ;
  ::routine_generate_signed_type (inLexique,  var_cas_max_priority.reader_uint64 (inLexique COMMA_SOURCE_FILE_AT_LINE (150)),  GGS_string ("Maximum priority too high"),  var_cas_type COMMA_SOURCE_FILE_AT_LINE (150)) ;
  var_cas_types = var_cas_types.reader_stringByReplacingStringByString (inLexique, GGS_string ("$PRIORITY_T$"), var_cas_type COMMA_SOURCE_FILE_AT_LINE (152)) ;
  GGS_uint  var_cas_max_act = GGS_uint (0U) ;
  {
    GGS_task_map::cEnumerator enumerator_3977 (var_cas_tasks, true) ;
    const GGS_task_map::cElement * operand_3977 = NULL ;
    while (((operand_3977 = enumerator_3977.nextObject ()))) {
      macroValidPointer (operand_3977) ;
      { const GGS_basic_type _var_4245 = operand_3977->mInfo.task.reader_activation (inLexique COMMA_SOURCE_FILE_AT_LINE (158)) ; // CAST instruction
        if (_var_4245.getPtr () != NULL) {
          macroValidPointer (_var_4245.getPtr ()) ;
          if (typeid (cPtr_uint32_class) == typeid (* (_var_4245.getPtr ()))) {
            const GGS_uint32_class var_cas_ui (_var_4245.getPtr ()) ;
            const GGS_bool cond_4127 = (var_cas_ui.reader_value (inLexique COMMA_SOURCE_FILE_AT_LINE (159))).operator_strictSup (var_cas_max_act) ;
            if (cond_4127.isBuiltAndTrue ()) {
              var_cas_max_act = var_cas_ui.reader_value (inLexique COMMA_SOURCE_FILE_AT_LINE (159)) ;
            }
          }else{
            operand_3977->mKey.reader_location (inLexique COMMA_HERE).signalGGSSemanticError (inLexique, ((GGS_string ("Internal error, task ")).operator_concat (operand_3977->mKey.reader_string (inLexique COMMA_SOURCE_FILE_AT_LINE (160)))).operator_concat (GGS_string (" has wrong type for the ACTIVATION attribute")) COMMA_SOURCE_FILE_AT_LINE (161)) ;
          }
        }
      }
    }
  }
  ::routine_generate_unsigned_type (inLexique,  var_cas_max_act.reader_uint64 (inLexique COMMA_SOURCE_FILE_AT_LINE (163)),  GGS_string ("Maximum ACTIVATION too high"),  var_cas_type COMMA_SOURCE_FILE_AT_LINE (163)) ;
  var_cas_types = var_cas_types.reader_stringByReplacingStringByString (inLexique, GGS_string ("$ACTIVATION_T$"), var_cas_type COMMA_SOURCE_FILE_AT_LINE (165)) ;
  GGS_uint  var_cas_max_ev = GGS_uint (0U) ;
  {
    GGS_task_map::cEnumerator enumerator_4614 (var_cas_tasks, true) ;
    const GGS_task_map::cElement * operand_4614 = NULL ;
    while (((operand_4614 = enumerator_4614.nextObject ()))) {
      macroValidPointer (operand_4614) ;
      GGS_lstringlist  var_cas_evts = operand_4614->mInfo.task.reader_events (inLexique COMMA_SOURCE_FILE_AT_LINE (171)) ;
      const GGS_bool cond_4751 = (var_cas_evts.reader_length ()).operator_strictSup (var_cas_max_ev) ;
      if (cond_4751.isBuiltAndTrue ()) {
        var_cas_max_ev = var_cas_evts.reader_length () ;
      }
    }
  }
  ::routine_generate_mask_type (inLexique,  var_cas_max_ev.reader_uint64 (inLexique COMMA_SOURCE_FILE_AT_LINE (174)),  GGS_string ("Too much events"),  var_cas_type COMMA_SOURCE_FILE_AT_LINE (174)) ;
  var_cas_types = var_cas_types.reader_stringByReplacingStringByString (inLexique, GGS_string ("$EVENTMASK_T$"), var_cas_type COMMA_SOURCE_FILE_AT_LINE (175)) ;
  var_cas_c = var_cas_alarms.reader_count ().reader_uint64 (inLexique COMMA_SOURCE_FILE_AT_LINE (178)) ;
  const GGS_bool cond_5012 = (var_cas_c).operator_strictSup (var_cas_max) ;
  if (cond_5012.isBuiltAndTrue ()) {
    var_cas_max = var_cas_c ;
  }
  ::routine_generate_unsigned_type (inLexique,  var_cas_c,  GGS_string ("too many alarms"),  var_cas_type COMMA_SOURCE_FILE_AT_LINE (180)) ;
  var_cas_types = var_cas_types.reader_stringByReplacingStringByString (inLexique, GGS_string ("$ALARM_ID_T$"), var_cas_type COMMA_SOURCE_FILE_AT_LINE (182)) ;
  var_cas_c = var_cas_resources.reader_count ().reader_uint64 (inLexique COMMA_SOURCE_FILE_AT_LINE (185)) ;
  const GGS_bool cond_5300 = (var_cas_c).operator_strictSup (var_cas_max) ;
  if (cond_5300.isBuiltAndTrue ()) {
    var_cas_max = var_cas_c ;
  }
  ::routine_generate_unsigned_type (inLexique,  var_cas_c,  GGS_string ("too many resources"),  var_cas_type COMMA_SOURCE_FILE_AT_LINE (187)) ;
  var_cas_types = var_cas_types.reader_stringByReplacingStringByString (inLexique, GGS_string ("$RESOURCE_ID_T$"), var_cas_type COMMA_SOURCE_FILE_AT_LINE (189)) ;
  var_cas_c = var_cas_counters.reader_count ().reader_uint64 (inLexique COMMA_SOURCE_FILE_AT_LINE (192)) ;
  const GGS_bool cond_5592 = (var_cas_c).operator_strictSup (var_cas_max) ;
  if (cond_5592.isBuiltAndTrue ()) {
    var_cas_max = var_cas_c ;
  }
  ::routine_generate_unsigned_type (inLexique,  var_cas_c,  GGS_string ("too many counters"),  var_cas_type COMMA_SOURCE_FILE_AT_LINE (194)) ;
  var_cas_types = var_cas_types.reader_stringByReplacingStringByString (inLexique, GGS_string ("$COUNTER_ID_T$"), var_cas_type COMMA_SOURCE_FILE_AT_LINE (196)) ;
  var_cas_c = var_cas_schedtables.reader_count ().reader_uint64 (inLexique COMMA_SOURCE_FILE_AT_LINE (199)) ;
  const GGS_bool cond_5888 = (var_cas_c).operator_strictSup (var_cas_max) ;
  if (cond_5888.isBuiltAndTrue ()) {
    var_cas_max = var_cas_c ;
  }
  ::routine_generate_unsigned_type (inLexique,  var_cas_c,  GGS_string ("too many schedule tables"),  var_cas_type COMMA_SOURCE_FILE_AT_LINE (201)) ;
  var_cas_types = var_cas_types.reader_stringByReplacingStringByString (inLexique, GGS_string ("$SCHEDTABLE_ID_T$"), var_cas_type COMMA_SOURCE_FILE_AT_LINE (203)) ;
  const GGS_bool cond_6276 = (var_cas_alarms.reader_count ()).operator_strictSup (var_cas_schedtables.reader_count ()) ;
  if (cond_6276.isBuiltAndTrue ()) {
    var_cas_c = var_cas_alarms.reader_count ().reader_uint64 (inLexique COMMA_SOURCE_FILE_AT_LINE (208)) ;
  }else if (cond_6276.isBuiltAndFalse ()) {
    var_cas_c = var_cas_schedtables.reader_count ().reader_uint64 (inLexique COMMA_SOURCE_FILE_AT_LINE (210)) ;
  }
  const GGS_bool cond_6357 = (var_cas_c).operator_strictSup (var_cas_max) ;
  if (cond_6357.isBuiltAndTrue ()) {
    var_cas_max = var_cas_c ;
  }
  ::routine_generate_unsigned_type (inLexique,  var_cas_c,  GGS_string ("too many time objects"),  var_cas_type COMMA_SOURCE_FILE_AT_LINE (213)) ;
  var_cas_types = var_cas_types.reader_stringByReplacingStringByString (inLexique, GGS_string ("$TIMEOBJ_ID_T$"), var_cas_type COMMA_SOURCE_FILE_AT_LINE (214)) ;
  ::routine_generate_unsigned_type (inLexique,  var_cas_apps.reader_count ().reader_uint64 (inLexique COMMA_SOURCE_FILE_AT_LINE (217)).add_operation (inLexique, GGS_uint64 (1ULL) COMMA_SOURCE_FILE_AT_LINE (217)),  GGS_string ("too many OS applications"),  var_cas_type COMMA_SOURCE_FILE_AT_LINE (217)) ;
  ::routine_doReplace (inLexique,  var_cas_types,  GGS_string ("$OSAPPLICATION_ID_T$"),  var_cas_type COMMA_SOURCE_FILE_AT_LINE (219)) ;
  GGS_stringset  var_cas_tfs = GGS_stringset ::constructor_emptySet () ;
  {
    GGS_app_map::cEnumerator enumerator_6824 (var_cas_apps, true) ;
    const GGS_app_map::cElement * operand_6824 = NULL ;
    while (((operand_6824 = enumerator_6824.nextObject ()))) {
      macroValidPointer (operand_6824) ;
      { const GGS_app_trusted_obj _var_6984 = operand_6824->mInfo.app.reader_trusted (inLexique COMMA_SOURCE_FILE_AT_LINE (225)) ; // CAST instruction
        if (_var_6984.getPtr () != NULL) {
          macroValidPointer (_var_6984.getPtr ()) ;
          if (typeid (cPtr_app_trusted_true) == typeid (* (_var_6984.getPtr ()))) {
            const GGS_app_trusted_true var_cas_t (_var_6984.getPtr ()) ;
            {
              GGS_stringset::cEnumerator enumerator_6903 (var_cas_t.reader_trusted_fcts (inLexique COMMA_SOURCE_FILE_AT_LINE (227)), true) ;
              while (enumerator_6903.hasCurrentObject ()) {
                var_cas_tfs.addAssign_operation (enumerator_6903._key (HERE)) ;
                enumerator_6903.next () ;
              }
            }
          }else{
          }
        }
      }
    }
  }
  ::routine_generate_unsigned_type (inLexique,  var_cas_tfs.reader_count ().reader_uint64 (inLexique COMMA_SOURCE_FILE_AT_LINE (233)),  GGS_string ("Too many Trusted Functions"),  var_cas_type COMMA_SOURCE_FILE_AT_LINE (233)) ;
  ::routine_doReplace (inLexique,  var_cas_types,  GGS_string ("$TRUSTED_FCT_ID_T$"),  var_cas_type COMMA_SOURCE_FILE_AT_LINE (234)) ;
  ::routine_generate_unsigned_type (inLexique,  var_cas_max,  GGS_string ("too many objects"),  var_cas_type COMMA_SOURCE_FILE_AT_LINE (237)) ;
  ::routine_doReplace (inLexique,  var_cas_types,  GGS_string ("$GENERIC_ID_T$"),  var_cas_type COMMA_SOURCE_FILE_AT_LINE (239)) ;
  #ifdef DEBUG_TRACE_ENABLED
    printf ("LEAVE routine_generate_types\n") ;
  #endif
}

//---------------------------------------------------------------------------*
//                                                                           *
//             Implementation of routine "generate_timing_prot"              *
//                                                                           *
//---------------------------------------------------------------------------*

void routine_generate_timing_prot (C_Compiler & inLexique,
                                GGS_task_map   var_cas_tasks,
                                GGS_resource_map   var_cas_rez,
                                GGS_string & var_cas_obj_header COMMA_UNUSED_LOCATION_ARGS) {
  #ifdef DEBUG_TRACE_ENABLED
    printf ("ENTER routine_generate_timing_prot at %s:%d\n", __FILE__, __LINE__) ;
  #endif
  GGS_uint  var_cas_max_sched_wd = var_cas_rez.reader_count ().add_operation (inLexique, GGS_uint (4U).multiply_operation (inLexique, var_cas_tasks.reader_count () COMMA_SOURCE_FILE_AT_LINE (249)) COMMA_SOURCE_FILE_AT_LINE (249)) ;
  var_cas_obj_header = var_cas_obj_header.reader_stringByReplacingStringByString (inLexique, GGS_string ("$MAX_WATCH_DOG$"), var_cas_max_sched_wd.reader_string (inLexique COMMA_SOURCE_FILE_AT_LINE (251)) COMMA_SOURCE_FILE_AT_LINE (251)) ;
  #ifdef DEBUG_TRACE_ENABLED
    printf ("LEAVE routine_generate_timing_prot\n") ;
  #endif
}

//---------------------------------------------------------------------------*
//                                                                           *
//         Implementation of routine "compute_actual_task_priority"          *
//                                                                           *
//---------------------------------------------------------------------------*

void routine_compute_actual_task_priority (C_Compiler & inLexique,
                                GGS_task_map   var_cas_tasks,
                                GGS_prio_map  & var_cas_prio_for_task,
                                GGS_uint  & var_cas_max_prio COMMA_UNUSED_LOCATION_ARGS) {
  #ifdef DEBUG_TRACE_ENABLED
    printf ("ENTER routine_compute_actual_task_priority at %s:%d\n", __FILE__, __LINE__) ;
  #endif
  GGS_objs_by_prio  var_cas_tl = GGS_objs_by_prio ::constructor_emptySortedList () ;
  {
    GGS_task_map::cEnumerator enumerator_8181 (var_cas_tasks, true) ;
    const GGS_task_map::cElement * operand_8181 = NULL ;
    while (((operand_8181 = enumerator_8181.nextObject ()))) {
      macroValidPointer (operand_8181) ;
      GGS_basic_type  var_cas_prio_as_basic ;
      GGS_basic_type  var_cas_act_as_basic ;
      GGS_uint  var_cas_prio = GGS_uint (0U) ;
      GGS_uint  var_cas_act = GGS_uint (0U) ;
      var_cas_prio_as_basic = operand_8181->mInfo.task.reader_priority (inLexique COMMA_SOURCE_FILE_AT_LINE (274)) ;
      var_cas_act_as_basic = operand_8181->mInfo.task.reader_activation (inLexique COMMA_SOURCE_FILE_AT_LINE (275)) ;
      { const GGS_basic_type _var_8604 = var_cas_prio_as_basic ; // CAST instruction
        if (_var_8604.getPtr () != NULL) {
          macroValidPointer (_var_8604.getPtr ()) ;
          if (typeid (cPtr_uint32_class) == typeid (* (_var_8604.getPtr ()))) {
            const GGS_uint32_class var_cas_ui (_var_8604.getPtr ()) ;
            var_cas_prio = var_cas_ui.reader_value (inLexique COMMA_SOURCE_FILE_AT_LINE (278)) ;
          }else{
            var_cas_prio_as_basic.reader_location (inLexique COMMA_SOURCE_FILE_AT_LINE (279)).reader_location (inLexique COMMA_HERE).signalGGSSemanticError (inLexique, GGS_string ("TASK PRIORITY attribute undefined") COMMA_SOURCE_FILE_AT_LINE (280)) ;
          }
        }
      }
      { const GGS_basic_type _var_8790 = var_cas_act_as_basic ; // CAST instruction
        if (_var_8790.getPtr () != NULL) {
          macroValidPointer (_var_8790.getPtr ()) ;
          if (typeid (cPtr_uint32_class) == typeid (* (_var_8790.getPtr ()))) {
            const GGS_uint32_class var_cas_ui (_var_8790.getPtr ()) ;
            var_cas_act = var_cas_ui.reader_value (inLexique COMMA_SOURCE_FILE_AT_LINE (283)) ;
          }else{
            var_cas_act_as_basic.reader_location (inLexique COMMA_SOURCE_FILE_AT_LINE (284)).reader_location (inLexique COMMA_HERE).signalGGSSemanticError (inLexique, GGS_string ("TASK ACTIVATION attribute undefined") COMMA_SOURCE_FILE_AT_LINE (285)) ;
          }
        }
      }
      var_cas_tl.addAssign_operation (var_cas_prio, var_cas_act, operand_8181->mKey) ;
    }
  }
  GGS_uint  var_cas_actual_prio = GGS_uint (1U) ;
  GGS_uint  var_cas_cur_rel_prio = GGS_uint (0U) ;
  const GGS_bool cond_9031 = (var_cas_tl.reader_length ()).operator_strictSup (GGS_uint (0U)) ;
  if (cond_9031.isBuiltAndTrue ()) {
    GGS_uint  automatic_var_9022_0 ;
    GGS_lstring  automatic_var_9022_1 ;
    const GGS_objs_by_prio  temp_9001 = var_cas_tl ;
    if (temp_9001.isBuilt ()) {
      temp_9001 (HERE)->method_smallest (inLexique, var_cas_cur_rel_prio, automatic_var_9022_0, automatic_var_9022_1 COMMA_SOURCE_FILE_AT_LINE (296)) ;
    }
  }
  {
    GGS_objs_by_prio::cEnumerator enumerator_9126 (var_cas_tl, true) ;
    const GGS_objs_by_prio::cElement * operand_9126 = NULL ;
    while (((operand_9126 = enumerator_9126.nextObject ()))) {
      macroValidPointer (operand_9126) ;
      const GGS_bool cond_9382 = (operand_9126->prio).operator_strictSup (var_cas_cur_rel_prio) ;
      if (cond_9382.isBuiltAndTrue ()) {
        var_cas_cur_rel_prio = operand_9126->prio ;
        var_cas_actual_prio.increment_operation (inLexique COMMA_SOURCE_FILE_AT_LINE (306)) ;
      }
      var_cas_prio_for_task.modifier_put (inLexique, operand_9126->name, var_cas_actual_prio, operand_9126->act COMMA_SOURCE_FILE_AT_LINE (309)) ;
    }
  }
  var_cas_max_prio = var_cas_actual_prio ;
  #ifdef DEBUG_TRACE_ENABLED
    printf ("LEAVE routine_compute_actual_task_priority\n") ;
  #endif
}

//---------------------------------------------------------------------------*
//                                                                           *
//         Implementation of routine "compute_actual_isr_priority"           *
//                                                                           *
//---------------------------------------------------------------------------*

void routine_compute_actual_isr_priority (C_Compiler & inLexique,
                                GGS_isr_map   var_cas_isrs,
                                GGS_prio_map  & var_cas_prio_for_isr,
                                GGS_uint   var_cas_floor,
                                GGS_uint  & var_cas_max_prio COMMA_UNUSED_LOCATION_ARGS) {
  #ifdef DEBUG_TRACE_ENABLED
    printf ("ENTER routine_compute_actual_isr_priority at %s:%d\n", __FILE__, __LINE__) ;
  #endif
  GGS_objs_by_prio  var_cas_il = GGS_objs_by_prio ::constructor_emptySortedList () ;
  const GGS_bool cond_11684 = (var_cas_isrs.reader_count ()).operator_isNotEqual (GGS_uint (0U)) ;
  if (cond_11684.isBuiltAndTrue ()) {
    {
      GGS_isr_map::cEnumerator enumerator_10134 (var_cas_isrs, true) ;
      const GGS_isr_map::cElement * operand_10134 = NULL ;
      while (((operand_10134 = enumerator_10134.nextObject ()))) {
        macroValidPointer (operand_10134) ;
        GGS_basic_type  var_cas_prio_as_basic ;
        GGS_basic_type  var_cas_act_as_basic ;
        GGS_uint  var_cas_prio = GGS_uint (0U) ;
        var_cas_prio_as_basic = operand_10134->mInfo.isr.reader_priority (inLexique COMMA_SOURCE_FILE_AT_LINE (339)) ;
        { const GGS_basic_type _var_10587 = var_cas_prio_as_basic ; // CAST instruction
          if (_var_10587.getPtr () != NULL) {
            macroValidPointer (_var_10587.getPtr ()) ;
            if (typeid (cPtr_uint32_class) == typeid (* (_var_10587.getPtr ()))) {
              const GGS_uint32_class var_cas_ui (_var_10587.getPtr ()) ;
              var_cas_prio = var_cas_ui.reader_value (inLexique COMMA_SOURCE_FILE_AT_LINE (343)) ;
            }else{
              var_cas_prio_as_basic.reader_location (inLexique COMMA_SOURCE_FILE_AT_LINE (344)).reader_location (inLexique COMMA_HERE).signalGGSSemanticError (inLexique, GGS_string ("ISR PRIORITY attribute undefined") COMMA_SOURCE_FILE_AT_LINE (345)) ;
            }
          }
        }
        var_cas_il.addAssign_operation (var_cas_prio, GGS_uint (1U), operand_10134->mKey) ;
      }
    }
    GGS_uint  var_cas_actual_prio = var_cas_floor.add_operation (inLexique, GGS_uint (1U) COMMA_SOURCE_FILE_AT_LINE (358)) ;
    GGS_uint  var_cas_cur_rel_prio = GGS_uint (0U) ;
    const GGS_bool cond_11078 = (var_cas_il.reader_length ()).operator_strictSup (GGS_uint (0U)) ;
    if (cond_11078.isBuiltAndTrue ()) {
      GGS_uint  automatic_var_11065_0 ;
      GGS_lstring  automatic_var_11065_1 ;
      const GGS_objs_by_prio  temp_11044 = var_cas_il ;
      if (temp_11044.isBuilt ()) {
        temp_11044 (HERE)->method_smallest (inLexique, var_cas_cur_rel_prio, automatic_var_11065_0, automatic_var_11065_1 COMMA_SOURCE_FILE_AT_LINE (361)) ;
      }
    }
    {
      GGS_objs_by_prio::cEnumerator enumerator_11196 (var_cas_il, true) ;
      const GGS_objs_by_prio::cElement * operand_11196 = NULL ;
      while (((operand_11196 = enumerator_11196.nextObject ()))) {
        macroValidPointer (operand_11196) ;
        const GGS_bool cond_11472 = (operand_11196->prio).operator_strictSup (var_cas_cur_rel_prio) ;
        if (cond_11472.isBuiltAndTrue ()) {
          var_cas_cur_rel_prio = operand_11196->prio ;
          var_cas_actual_prio.increment_operation (inLexique COMMA_SOURCE_FILE_AT_LINE (371)) ;
        }
        var_cas_prio_for_isr.modifier_put (inLexique, operand_11196->name, var_cas_actual_prio, operand_11196->act COMMA_SOURCE_FILE_AT_LINE (374)) ;
      }
    }
    var_cas_max_prio = var_cas_actual_prio ;
  }else if (cond_11684.isBuiltAndFalse ()) {
    var_cas_max_prio = var_cas_floor ;
  }
  #ifdef DEBUG_TRACE_ENABLED
    printf ("LEAVE routine_compute_actual_isr_priority\n") ;
  #endif
}

//---------------------------------------------------------------------------*
//                                                                           *
//             Implementation of routine "compute_rez_priority"              *
//                                                                           *
//---------------------------------------------------------------------------*

void routine_compute_rez_priority (C_Compiler & inLexique,
                                GGS_resource_map   var_cas_rez,
                                GGS_task_map   var_cas_tasks,
                                GGS_isr_map   var_cas_isrs,
                                GGS_prio_map   var_cas_prio_for_process,
                                GGS_prio_map  & var_cas_prio_for_rez,
                                GGS_stringMap  & var_cas_comments COMMA_UNUSED_LOCATION_ARGS) {
  #ifdef DEBUG_TRACE_ENABLED
    printf ("ENTER routine_compute_rez_priority at %s:%d\n", __FILE__, __LINE__) ;
  #endif
  var_cas_prio_for_rez = GGS_prio_map ::constructor_emptyMap (inLexique COMMA_SOURCE_FILE_AT_LINE (395)) ;
  var_cas_comments = GGS_stringMap ::constructor_emptyMap (inLexique COMMA_SOURCE_FILE_AT_LINE (396)) ;
  {
    GGS_resource_map::cEnumerator enumerator_12549 (var_cas_rez, true) ;
    const GGS_resource_map::cElement * operand_12549 = NULL ;
    while (((operand_12549 = enumerator_12549.nextObject ()))) {
      macroValidPointer (operand_12549) ;
      GGS_uint  var_cas_rez_prio = GGS_uint (0U) ;
      GGS_uint  var_cas_rez_act = GGS_uint (0U) ;
      GGS_string var_cas_rez_comment = GGS_string ("") ;
      {
        GGS_task_map::cEnumerator enumerator_12690 (var_cas_tasks, true) ;
        const GGS_task_map::cElement * operand_12690 = NULL ;
        while (((operand_12690 = enumerator_12690.nextObject ()))) {
          macroValidPointer (operand_12690) ;
          GGS_lstringlist  var_cas_owned_rez = operand_12690->mInfo.task.reader_resources (inLexique COMMA_SOURCE_FILE_AT_LINE (412)) ;
          GGS_bool var_cas_owned ;
          GGS_lstring  automatic_var_12859_0 ;
          ::routine_is_in_lstringlist (inLexique,  var_cas_owned_rez,  operand_12549->mKey,  automatic_var_12859_0,  var_cas_owned COMMA_SOURCE_FILE_AT_LINE (414)) ;
          const GGS_bool cond_13241 = var_cas_owned ;
          if (cond_13241.isBuiltAndTrue ()) {
            GGS_uint  var_cas_prio ;
            GGS_uint  var_cas_act ;
            const GGS_prio_map  temp_12978 = var_cas_prio_for_process ;
            if (temp_12978.isBuilt ()) {
              temp_12978 (HERE)->method_get (inLexique, operand_12690->mKey, var_cas_prio, var_cas_act COMMA_SOURCE_FILE_AT_LINE (418)) ;
            }
            const GGS_bool cond_13093 = (var_cas_prio).operator_strictSup (var_cas_rez_prio) ;
            if (cond_13093.isBuiltAndTrue ()) {
              var_cas_rez_prio = var_cas_prio ;
            }
            var_cas_rez_act = var_cas_rez_act.add_operation (inLexique, var_cas_act COMMA_SOURCE_FILE_AT_LINE (422)) ;
            var_cas_rez_comment.appendCString (" used by task ") ;
            var_cas_rez_comment.dotAssign_operation (operand_12690->mKey.reader_string (inLexique COMMA_SOURCE_FILE_AT_LINE (423))) ;
            var_cas_rez_comment.appendCString (" (") ;
            var_cas_rez_comment.dotAssign_operation (var_cas_prio.reader_string (inLexique COMMA_SOURCE_FILE_AT_LINE (423))) ;
            var_cas_rez_comment.appendCString (")\n") ;
          }
        }
      }
      {
        GGS_isr_map::cEnumerator enumerator_13287 (var_cas_isrs, true) ;
        const GGS_isr_map::cElement * operand_13287 = NULL ;
        while (((operand_13287 = enumerator_13287.nextObject ()))) {
          macroValidPointer (operand_13287) ;
          GGS_lstringlist  var_cas_owned_rez = operand_13287->mInfo.isr.reader_resources (inLexique COMMA_SOURCE_FILE_AT_LINE (427)) ;
          GGS_bool var_cas_owned ;
          GGS_lstring  automatic_var_13456_0 ;
          ::routine_is_in_lstringlist (inLexique,  var_cas_owned_rez,  operand_12549->mKey,  automatic_var_13456_0,  var_cas_owned COMMA_SOURCE_FILE_AT_LINE (429)) ;
          const GGS_bool cond_13839 = var_cas_owned ;
          if (cond_13839.isBuiltAndTrue ()) {
            GGS_uint  var_cas_prio ;
            GGS_uint  var_cas_act ;
            const GGS_prio_map  temp_13575 = var_cas_prio_for_process ;
            if (temp_13575.isBuilt ()) {
              temp_13575 (HERE)->method_get (inLexique, operand_13287->mKey, var_cas_prio, var_cas_act COMMA_SOURCE_FILE_AT_LINE (433)) ;
            }
            const GGS_bool cond_13691 = (var_cas_prio).operator_strictSup (var_cas_rez_prio) ;
            if (cond_13691.isBuiltAndTrue ()) {
              var_cas_rez_prio = var_cas_prio ;
            }
            var_cas_rez_act = var_cas_rez_act.add_operation (inLexique, var_cas_act COMMA_SOURCE_FILE_AT_LINE (437)) ;
            var_cas_rez_comment.appendCString (" used by isr ") ;
            var_cas_rez_comment.dotAssign_operation (operand_13287->mKey.reader_string (inLexique COMMA_SOURCE_FILE_AT_LINE (438))) ;
            var_cas_rez_comment.appendCString (" (") ;
            var_cas_rez_comment.dotAssign_operation (var_cas_prio.reader_string (inLexique COMMA_SOURCE_FILE_AT_LINE (438))) ;
            var_cas_rez_comment.appendCString (")\n") ;
          }
        }
      }
      const GGS_bool cond_13949 = (var_cas_rez_comment).operator_isEqual (GGS_string ("")) ;
      if (cond_13949.isBuiltAndTrue ()) {
        var_cas_rez_comment = GGS_string (" none\n") ;
      }
      {
        GGS_task_map::cEnumerator enumerator_14138 (var_cas_tasks, true) ;
        const GGS_task_map::cElement * operand_14138 = NULL ;
        while (((operand_14138 = enumerator_14138.nextObject ()))) {
          macroValidPointer (operand_14138) ;
          GGS_lstringlist  var_cas_owned_rez = operand_14138->mInfo.task.reader_resources (inLexique COMMA_SOURCE_FILE_AT_LINE (451)) ;
          GGS_bool var_cas_owned ;
          GGS_lstring  automatic_var_14307_0 ;
          ::routine_is_in_lstringlist (inLexique,  var_cas_owned_rez,  operand_12549->mKey,  automatic_var_14307_0,  var_cas_owned COMMA_SOURCE_FILE_AT_LINE (453)) ;
          const GGS_bool cond_14570 = var_cas_owned ;
          if (cond_14570.isBuiltAndTrue ()) {
            GGS_uint  var_cas_prio ;
            GGS_uint  var_cas_act ;
            const GGS_prio_map  temp_14426 = var_cas_prio_for_process ;
            if (temp_14426.isBuilt ()) {
              temp_14426 (HERE)->method_get (inLexique, operand_14138->mKey, var_cas_prio, var_cas_act COMMA_SOURCE_FILE_AT_LINE (457)) ;
            }
            const GGS_bool cond_14550 = (var_cas_prio).operator_isEqual (var_cas_rez_prio) ;
            if (cond_14550.isBuiltAndTrue ()) {
              var_cas_rez_act = var_cas_rez_act.substract_operation (inLexique, var_cas_act COMMA_SOURCE_FILE_AT_LINE (459)) ;
            }
          }
        }
      }
      {
        GGS_isr_map::cEnumerator enumerator_14616 (var_cas_isrs, true) ;
        const GGS_isr_map::cElement * operand_14616 = NULL ;
        while (((operand_14616 = enumerator_14616.nextObject ()))) {
          macroValidPointer (operand_14616) ;
          GGS_lstringlist  var_cas_owned_rez = operand_14616->mInfo.isr.reader_resources (inLexique COMMA_SOURCE_FILE_AT_LINE (464)) ;
          GGS_bool var_cas_owned ;
          GGS_lstring  automatic_var_14785_0 ;
          ::routine_is_in_lstringlist (inLexique,  var_cas_owned_rez,  operand_12549->mKey,  automatic_var_14785_0,  var_cas_owned COMMA_SOURCE_FILE_AT_LINE (466)) ;
          const GGS_bool cond_15049 = var_cas_owned ;
          if (cond_15049.isBuiltAndTrue ()) {
            GGS_uint  var_cas_prio ;
            GGS_uint  var_cas_act ;
            const GGS_prio_map  temp_14904 = var_cas_prio_for_process ;
            if (temp_14904.isBuilt ()) {
              temp_14904 (HERE)->method_get (inLexique, operand_14616->mKey, var_cas_prio, var_cas_act COMMA_SOURCE_FILE_AT_LINE (470)) ;
            }
            const GGS_bool cond_15029 = (var_cas_prio).operator_isEqual (var_cas_rez_prio) ;
            if (cond_15029.isBuiltAndTrue ()) {
              var_cas_rez_act = var_cas_rez_act.substract_operation (inLexique, var_cas_act COMMA_SOURCE_FILE_AT_LINE (472)) ;
            }
          }
        }
      }
      var_cas_prio_for_rez.modifier_put (inLexique, operand_12549->mKey, var_cas_rez_prio, var_cas_rez_act COMMA_SOURCE_FILE_AT_LINE (477)) ;
      var_cas_comments.modifier_put (inLexique, operand_12549->mKey, var_cas_rez_comment COMMA_SOURCE_FILE_AT_LINE (478)) ;
    }
  }
  #ifdef DEBUG_TRACE_ENABLED
    printf ("LEAVE routine_compute_rez_priority\n") ;
  #endif
}

//---------------------------------------------------------------------------*
//                                                                           *
//              Implementation of routine "compute_ready_list"               *
//                                                                           *
//---------------------------------------------------------------------------*

void routine_compute_ready_list (C_Compiler & inLexique,
                                GGS_prio_map   var_cas_prio_for_process,
                                GGS_prio_map   var_cas_prio_for_rez,
                                GGS_uint   var_cas_max_task_prio,
                                GGS_uint   var_cas_max_prio,
                                GGS_prio_list  & var_cas_ready_list COMMA_UNUSED_LOCATION_ARGS) {
  #ifdef DEBUG_TRACE_ENABLED
    printf ("ENTER routine_compute_ready_list at %s:%d\n", __FILE__, __LINE__) ;
  #endif
  var_cas_ready_list = GGS_prio_list ::constructor_emptyList () ;
  var_cas_ready_list.addAssign_operation (GGS_uint (1U)) ;
  GGS_uint  var_cas_prio = GGS_uint (1U) ;
  GGS_uint _variant_16524 = var_cas_max_prio ;
  GGS_bool _condition_16524 (_variant_16524.isBuilt (), true) ;
  while (_condition_16524.isBuiltAndTrue ()) {
    _condition_16524 = (var_cas_prio).operator_infOrEqual (var_cas_max_prio) ;
    if (_condition_16524.isBuiltAndTrue ()) {
      if (_variant_16524.uintValue () == 0) {
        inLexique.onTheFlyRunTimeError ("loop variant error" COMMA_SOURCE_FILE_AT_LINE (519)) ;
        _condition_16524 = GGS_bool (false) ;
      }else{
        _variant_16524.decrement_operation (inLexique COMMA_HERE) ;
        GGS_uint  var_cas_fifosize = GGS_uint (0U) ;
        {
          GGS_prio_map::cEnumerator enumerator_16027 (var_cas_prio_for_process, true) ;
          const GGS_prio_map::cElement * operand_16027 = NULL ;
          while (((operand_16027 = enumerator_16027.nextObject ()))) {
            macroValidPointer (operand_16027) ;
            const GGS_bool cond_16119 = (operand_16027->mInfo.prio).operator_isEqual (var_cas_prio) ;
            if (cond_16119.isBuiltAndTrue ()) {
              var_cas_fifosize = var_cas_fifosize.add_operation (inLexique, operand_16027->mInfo.act COMMA_SOURCE_FILE_AT_LINE (507)) ;
            }
          }
        }
        {
          GGS_prio_map::cEnumerator enumerator_16173 (var_cas_prio_for_rez, true) ;
          const GGS_prio_map::cElement * operand_16173 = NULL ;
          while (((operand_16173 = enumerator_16173.nextObject ()))) {
            macroValidPointer (operand_16173) ;
            const GGS_bool cond_16265 = (operand_16173->mInfo.prio).operator_isEqual (var_cas_prio) ;
            if (cond_16265.isBuiltAndTrue ()) {
              var_cas_fifosize = var_cas_fifosize.add_operation (inLexique, operand_16173->mInfo.act COMMA_SOURCE_FILE_AT_LINE (510)) ;
            }
          }
        }
        const GGS_bool cond_16462 = (var_cas_prio).operator_isEqual (var_cas_max_task_prio) ;
        if (cond_16462.isBuiltAndTrue ()) {
          var_cas_fifosize.increment_operation (inLexique COMMA_SOURCE_FILE_AT_LINE (515)) ;
        }
        var_cas_ready_list.addAssign_operation (var_cas_fifosize) ;
        var_cas_prio.increment_operation (inLexique COMMA_SOURCE_FILE_AT_LINE (518)) ;
      }
    }
  }
  #ifdef DEBUG_TRACE_ENABLED
    printf ("LEAVE routine_compute_ready_list\n") ;
  #endif
}

//---------------------------------------------------------------------------*
//                                                                           *
//             Implementation of routine "compute_app_for_obj"               *
//                                                                           *
//---------------------------------------------------------------------------*

void routine_compute_app_for_obj (C_Compiler & inLexique,
                                GGS_app_map   var_cas_apps,
                                GGS_stringMap  & var_cas_app_for_obj COMMA_UNUSED_LOCATION_ARGS) {
  #ifdef DEBUG_TRACE_ENABLED
    printf ("ENTER routine_compute_app_for_obj at %s:%d\n", __FILE__, __LINE__) ;
  #endif
  var_cas_app_for_obj = GGS_stringMap ::constructor_emptyMap (inLexique COMMA_SOURCE_FILE_AT_LINE (528)) ;
  {
    GGS_app_map::cEnumerator enumerator_16698 (var_cas_apps, true) ;
    const GGS_app_map::cElement * operand_16698 = NULL ;
    while (((operand_16698 = enumerator_16698.nextObject ()))) {
      macroValidPointer (operand_16698) ;
      GGS_string var_cas_app_name = operand_16698->mKey.reader_string (inLexique COMMA_SOURCE_FILE_AT_LINE (531)) ;
      {
        GGS_ident_map::cEnumerator enumerator_16753 (operand_16698->mInfo.app.reader_tasks (inLexique COMMA_SOURCE_FILE_AT_LINE (532)), true) ;
        const GGS_ident_map::cElement * operand_16753 = NULL ;
        while (((operand_16753 = enumerator_16753.nextObject ()))) {
          macroValidPointer (operand_16753) ;
          const GGS_bool cond_16873 = (var_cas_app_for_obj.reader_hasKey (operand_16753->mKey.reader_string (inLexique COMMA_SOURCE_FILE_AT_LINE (533)))).operator_not () ;
          if (cond_16873.isBuiltAndTrue ()) {
            var_cas_app_for_obj.modifier_put (inLexique, operand_16753->mKey, var_cas_app_name COMMA_SOURCE_FILE_AT_LINE (534)) ;
          }
        }
      }
      {
        GGS_ident_map::cEnumerator enumerator_16908 (operand_16698->mInfo.app.reader_isrs (inLexique COMMA_SOURCE_FILE_AT_LINE (537)), true) ;
        const GGS_ident_map::cElement * operand_16908 = NULL ;
        while (((operand_16908 = enumerator_16908.nextObject ()))) {
          macroValidPointer (operand_16908) ;
          const GGS_bool cond_17027 = (var_cas_app_for_obj.reader_hasKey (operand_16908->mKey.reader_string (inLexique COMMA_SOURCE_FILE_AT_LINE (538)))).operator_not () ;
          if (cond_17027.isBuiltAndTrue ()) {
            var_cas_app_for_obj.modifier_put (inLexique, operand_16908->mKey, var_cas_app_name COMMA_SOURCE_FILE_AT_LINE (539)) ;
          }
        }
      }
      {
        GGS_ident_map::cEnumerator enumerator_17062 (operand_16698->mInfo.app.reader_alarms (inLexique COMMA_SOURCE_FILE_AT_LINE (542)), true) ;
        const GGS_ident_map::cElement * operand_17062 = NULL ;
        while (((operand_17062 = enumerator_17062.nextObject ()))) {
          macroValidPointer (operand_17062) ;
          const GGS_bool cond_17183 = (var_cas_app_for_obj.reader_hasKey (operand_17062->mKey.reader_string (inLexique COMMA_SOURCE_FILE_AT_LINE (543)))).operator_not () ;
          if (cond_17183.isBuiltAndTrue ()) {
            var_cas_app_for_obj.modifier_put (inLexique, operand_17062->mKey, var_cas_app_name COMMA_SOURCE_FILE_AT_LINE (544)) ;
          }
        }
      }
      {
        GGS_ident_map::cEnumerator enumerator_17218 (operand_16698->mInfo.app.reader_scheduletables (inLexique COMMA_SOURCE_FILE_AT_LINE (547)), true) ;
        const GGS_ident_map::cElement * operand_17218 = NULL ;
        while (((operand_17218 = enumerator_17218.nextObject ()))) {
          macroValidPointer (operand_17218) ;
          const GGS_bool cond_17347 = (var_cas_app_for_obj.reader_hasKey (operand_17218->mKey.reader_string (inLexique COMMA_SOURCE_FILE_AT_LINE (548)))).operator_not () ;
          if (cond_17347.isBuiltAndTrue ()) {
            var_cas_app_for_obj.modifier_put (inLexique, operand_17218->mKey, var_cas_app_name COMMA_SOURCE_FILE_AT_LINE (549)) ;
          }
        }
      }
      {
        GGS_ident_map::cEnumerator enumerator_17382 (operand_16698->mInfo.app.reader_counters (inLexique COMMA_SOURCE_FILE_AT_LINE (552)), true) ;
        const GGS_ident_map::cElement * operand_17382 = NULL ;
        while (((operand_17382 = enumerator_17382.nextObject ()))) {
          macroValidPointer (operand_17382) ;
          const GGS_bool cond_17505 = (var_cas_app_for_obj.reader_hasKey (operand_17382->mKey.reader_string (inLexique COMMA_SOURCE_FILE_AT_LINE (553)))).operator_not () ;
          if (cond_17505.isBuiltAndTrue ()) {
            var_cas_app_for_obj.modifier_put (inLexique, operand_17382->mKey, var_cas_app_name COMMA_SOURCE_FILE_AT_LINE (554)) ;
          }
        }
      }
      {
        GGS_ident_map::cEnumerator enumerator_17540 (operand_16698->mInfo.app.reader_resources (inLexique COMMA_SOURCE_FILE_AT_LINE (557)), true) ;
        const GGS_ident_map::cElement * operand_17540 = NULL ;
        while (((operand_17540 = enumerator_17540.nextObject ()))) {
          macroValidPointer (operand_17540) ;
          const GGS_bool cond_17664 = (var_cas_app_for_obj.reader_hasKey (operand_17540->mKey.reader_string (inLexique COMMA_SOURCE_FILE_AT_LINE (558)))).operator_not () ;
          if (cond_17664.isBuiltAndTrue ()) {
            var_cas_app_for_obj.modifier_put (inLexique, operand_17540->mKey, var_cas_app_name COMMA_SOURCE_FILE_AT_LINE (559)) ;
          }
        }
      }
    }
  }
  #ifdef DEBUG_TRACE_ENABLED
    printf ("LEAVE routine_compute_app_for_obj\n") ;
  #endif
}

//---------------------------------------------------------------------------*
//                                                                           *
//                Implementation of routine "computeEvents"                  *
//                                                                           *
//---------------------------------------------------------------------------*

void routine_computeEvents (C_Compiler & inLexique,
                                const GGS_root_obj   var_cas_cpu,
                                GGS_eventMaskMap  & var_cas_eventMasks COMMA_UNUSED_LOCATION_ARGS) {
  #ifdef DEBUG_TRACE_ENABLED
    printf ("ENTER routine_computeEvents at %s:%d\n", __FILE__, __LINE__) ;
  #endif
  var_cas_eventMasks = GGS_eventMaskMap ::constructor_emptyMap (inLexique COMMA_SOURCE_FILE_AT_LINE (572)) ;
  GGS_task_mask  var_cas_maskForTask = GGS_task_mask ::constructor_emptyMap (inLexique COMMA_SOURCE_FILE_AT_LINE (573)) ;
  GGS_event_usage_map  var_cas_evt_usage = GGS_event_usage_map ::constructor_emptyMap (inLexique COMMA_SOURCE_FILE_AT_LINE (586)) ;
  GGS_stringset_map  var_cas_tasksForEvent = GGS_stringset_map ::constructor_emptyMap (inLexique COMMA_SOURCE_FILE_AT_LINE (587)) ;
  {
    GGS_task_map::cEnumerator enumerator_18565 (var_cas_cpu.reader_tasks (inLexique COMMA_SOURCE_FILE_AT_LINE (589)), true) ;
    const GGS_task_map::cElement * operand_18565 = NULL ;
    while (((operand_18565 = enumerator_18565.nextObject ()))) {
      macroValidPointer (operand_18565) ;
      GGS_lstringlist  var_cas_events_used ;
      var_cas_events_used = operand_18565->mInfo.task.reader_events (inLexique COMMA_SOURCE_FILE_AT_LINE (591)) ;
      GGS_uint64  var_cas_event_mask = GGS_uint64 (0ULL) ;
      {
        GGS_lstringlist::cEnumerator enumerator_18731 (var_cas_events_used, true) ;
        const GGS_lstringlist::cElement * operand_18731 = NULL ;
        while (((operand_18731 = enumerator_18731.nextObject ()))) {
          macroValidPointer (operand_18731) ;
          GGS_event_obj  var_cas_event ;
          const GGS_event_map  temp_18802 = var_cas_cpu.reader_events (inLexique COMMA_SOURCE_FILE_AT_LINE (595)) ;
          if (temp_18802.isBuilt ()) {
            temp_18802 (HERE)->method_get (inLexique, operand_18731->mValue, var_cas_event COMMA_SOURCE_FILE_AT_LINE (595)) ;
          }
          GGS_event_mask_obj  var_cas_mask_obj ;
          var_cas_mask_obj = var_cas_event.reader_mask (inLexique COMMA_SOURCE_FILE_AT_LINE (597)) ;
          { const GGS_event_mask_obj _var_19504 = var_cas_mask_obj ; // CAST instruction
            if (_var_19504.getPtr () != NULL) {
              macroValidPointer (_var_19504.getPtr ()) ;
              if (typeid (cPtr_event_mask_user_obj) == typeid (* (_var_19504.getPtr ()))) {
                const GGS_event_mask_user_obj var_cas_emu (_var_19504.getPtr ()) ;
                const GGS_bool cond_19077 = ((var_cas_event_mask).operator_and (var_cas_emu.reader_mask (inLexique COMMA_SOURCE_FILE_AT_LINE (600)).reader_uint64 (inLexique COMMA_SOURCE_FILE_AT_LINE (600)))).operator_isEqual (GGS_uint64 (0ULL)) ;
                if (cond_19077.isBuiltAndTrue ()) {
                  var_cas_event_mask = (var_cas_event_mask).operator_or (var_cas_emu.reader_mask (inLexique COMMA_SOURCE_FILE_AT_LINE (601)).reader_uint64 (inLexique COMMA_SOURCE_FILE_AT_LINE (601))) ;
                }else if (cond_19077.isBuiltAndFalse ()) {
                  var_cas_emu.reader_mask (inLexique COMMA_SOURCE_FILE_AT_LINE (603)).reader_location (inLexique COMMA_HERE).signalGGSSemanticError (inLexique, ((GGS_string ("MASK of event ")).operator_concat (operand_18731->mValue.reader_string (inLexique COMMA_SOURCE_FILE_AT_LINE (603)))).operator_concat (GGS_string (" conflicts with previous declarations")) COMMA_SOURCE_FILE_AT_LINE (604)) ;
                }
              }else if (typeid (cPtr_event_mask_auto_obj) == typeid (* (_var_19504.getPtr ()))) {
                GGS_uint  var_cas_count ;
                const GGS_bool cond_19392 = var_cas_evt_usage.reader_hasKey (operand_18731->mValue.reader_string (inLexique COMMA_SOURCE_FILE_AT_LINE (607))) ;
                if (cond_19392.isBuiltAndTrue ()) {
                  var_cas_evt_usage.modifier_delete (inLexique, operand_18731->mValue, var_cas_count COMMA_SOURCE_FILE_AT_LINE (608)) ;
                  var_cas_count.increment_operation (inLexique COMMA_SOURCE_FILE_AT_LINE (609)) ;
                }else if (cond_19392.isBuiltAndFalse ()) {
                  var_cas_count = GGS_uint (1U) ;
                }
                var_cas_evt_usage.modifier_insert_count (inLexique, operand_18731->mValue, var_cas_count COMMA_SOURCE_FILE_AT_LINE (613)) ;
              }else{
              }
            }
          }
          GGS_stringset  var_cas_refTasks = GGS_stringset ::constructor_emptySet () ;
          const GGS_bool cond_19668 = var_cas_tasksForEvent.reader_hasKey (operand_18731->mValue.reader_string (inLexique COMMA_SOURCE_FILE_AT_LINE (617))) ;
          if (cond_19668.isBuiltAndTrue ()) {
            var_cas_tasksForEvent.modifier_delete (inLexique, operand_18731->mValue, var_cas_refTasks COMMA_SOURCE_FILE_AT_LINE (618)) ;
          }
          var_cas_refTasks.addAssign_operation (operand_18565->mKey.reader_string (inLexique COMMA_SOURCE_FILE_AT_LINE (620))) ;
          var_cas_tasksForEvent.modifier_add (inLexique, operand_18731->mValue, var_cas_refTasks COMMA_SOURCE_FILE_AT_LINE (621)) ;
        }
      }
      var_cas_maskForTask.modifier_insert_mask (inLexique, operand_18565->mKey, var_cas_event_mask COMMA_SOURCE_FILE_AT_LINE (623)) ;
    }
  }
  {
    GGS_event_map::cEnumerator enumerator_19894 (var_cas_cpu.reader_events (inLexique COMMA_SOURCE_FILE_AT_LINE (629)), true) ;
    const GGS_event_map::cElement * operand_19894 = NULL ;
    while (((operand_19894 = enumerator_19894.nextObject ()))) {
      macroValidPointer (operand_19894) ;
      GGS_event_mask_obj  var_cas_eventMask = operand_19894->mInfo.event.reader_mask (inLexique COMMA_SOURCE_FILE_AT_LINE (630)) ;
      { const GGS_event_mask_obj _var_20125 = var_cas_eventMask ; // CAST instruction
        if (_var_20125.getPtr () != NULL) {
          macroValidPointer (_var_20125.getPtr ()) ;
          if (typeid (cPtr_event_mask_user_obj) == typeid (* (_var_20125.getPtr ()))) {
            const GGS_event_mask_user_obj var_cas_emu (_var_20125.getPtr ()) ;
            var_cas_eventMasks.modifier_put (inLexique, operand_19894->mKey, var_cas_emu.reader_mask (inLexique COMMA_SOURCE_FILE_AT_LINE (633)).reader_uint64 (inLexique COMMA_SOURCE_FILE_AT_LINE (633)) COMMA_SOURCE_FILE_AT_LINE (633)) ;
          }else{
          }
        }
      }
    }
  }
  GGS_sorted_events  var_cas_sortedEvents = GGS_sorted_events ::constructor_emptySortedList () ;
  {
    GGS_event_usage_map::cEnumerator enumerator_20289 (var_cas_evt_usage, true) ;
    const GGS_event_usage_map::cElement * operand_20289 = NULL ;
    while (((operand_20289 = enumerator_20289.nextObject ()))) {
      macroValidPointer (operand_20289) ;
      var_cas_sortedEvents.addAssign_operation (operand_20289->mKey, operand_20289->mInfo.count) ;
    }
  }
  {
    GGS_sorted_events::cEnumerator enumerator_20465 (var_cas_sortedEvents, true) ;
    const GGS_sorted_events::cElement * operand_20465 = NULL ;
    while (((operand_20465 = enumerator_20465.nextObject ()))) {
      macroValidPointer (operand_20465) ;
      const GGS_bool cond_21850 = var_cas_tasksForEvent.reader_hasKey (operand_20465->event_name.reader_string (inLexique COMMA_SOURCE_FILE_AT_LINE (653))) ;
      if (cond_21850.isBuiltAndTrue ()) {
        GGS_stringset  var_cas_tasks ;
        const GGS_stringset_map  temp_20573 = var_cas_tasksForEvent ;
        if (temp_20573.isBuilt ()) {
          temp_20573 (HERE)->method_get (inLexique, operand_20465->event_name, var_cas_tasks COMMA_SOURCE_FILE_AT_LINE (655)) ;
        }
        GGS_uint64  var_cas_mask = GGS_uint64 (0ULL) ;
        {
          GGS_stringset::cEnumerator enumerator_20640 (var_cas_tasks, true) ;
          while (enumerator_20640.hasCurrentObject ()) {
            GGS_uint64  var_cas_tm ;
            const GGS_task_mask  temp_20705 = var_cas_maskForTask ;
            if (temp_20705.isBuilt ()) {
              temp_20705 (HERE)->method_get_mask (inLexique, GGS_lstring ::constructor_new (inLexique, enumerator_20640._key (HERE), GGS_location (inLexique) COMMA_SOURCE_FILE_AT_LINE (659)), var_cas_tm COMMA_SOURCE_FILE_AT_LINE (659)) ;
            }
            var_cas_mask = (var_cas_mask).operator_or (var_cas_tm) ;
            enumerator_20640.next () ;
          }
        }
        GGS_uint64  var_cas_bit = GGS_uint64 (1ULL) ;
        GGS_uint _variant_21032 = GGS_uint (32U) ;
        GGS_bool _condition_21032 (_variant_21032.isBuilt (), true) ;
        while (_condition_21032.isBuiltAndTrue ()) {
          _condition_21032 = ((var_cas_bit).operator_strictInf (GGS_uint ::constructor_max (inLexique COMMA_SOURCE_FILE_AT_LINE (666)).reader_uint64 (inLexique COMMA_SOURCE_FILE_AT_LINE (666)))).operator_and (((var_cas_bit).operator_and ((var_cas_mask).operator_tilde ())).operator_isEqual (GGS_uint64 (0ULL))) ;
          if (_condition_21032.isBuiltAndTrue ()) {
            if (_variant_21032.uintValue () == 0) {
              inLexique.onTheFlyRunTimeError ("loop variant error" COMMA_SOURCE_FILE_AT_LINE (668)) ;
              _condition_21032 = GGS_bool (false) ;
            }else{
              _variant_21032.decrement_operation (inLexique COMMA_HERE) ;
              var_cas_bit = var_cas_bit.left_shift_operation (inLexique, GGS_uint (1U) COMMA_SOURCE_FILE_AT_LINE (667)) ;
            }
          }
        }
        const GGS_bool cond_21203 = (var_cas_bit).operator_strictSup (GGS_uint ::constructor_max (inLexique COMMA_SOURCE_FILE_AT_LINE (669)).reader_uint64 (inLexique COMMA_SOURCE_FILE_AT_LINE (669))) ;
        if (cond_21203.isBuiltAndTrue ()) {
          operand_20465->event_name.reader_location (inLexique COMMA_HERE).signalGGSSemanticError (inLexique, ((GGS_string ("All event mask bits are already use, event ")).operator_concat (operand_20465->event_name.reader_string (inLexique COMMA_SOURCE_FILE_AT_LINE (670)))).operator_concat (GGS_string (" can't be created")) COMMA_SOURCE_FILE_AT_LINE (671)) ;
        }
        {
          GGS_stringset::cEnumerator enumerator_21327 (var_cas_tasks, true) ;
          while (enumerator_21327.hasCurrentObject ()) {
            GGS_uint64  var_cas_tm ;
            var_cas_maskForTask.modifier_del_mask (inLexique, GGS_lstring ::constructor_new (inLexique, enumerator_21327._key (HERE), GGS_location (inLexique) COMMA_SOURCE_FILE_AT_LINE (676)), var_cas_tm COMMA_SOURCE_FILE_AT_LINE (676)) ;
            var_cas_tm = (var_cas_bit).operator_or (var_cas_tm) ;
            var_cas_maskForTask.modifier_insert_mask (inLexique, GGS_lstring ::constructor_new (inLexique, enumerator_21327._key (HERE), GGS_location (inLexique) COMMA_SOURCE_FILE_AT_LINE (678)), var_cas_tm COMMA_SOURCE_FILE_AT_LINE (678)) ;
            enumerator_21327.next () ;
          }
        }
        var_cas_eventMasks.modifier_put (inLexique, operand_20465->event_name, var_cas_bit COMMA_SOURCE_FILE_AT_LINE (681)) ;
      }
    }
  }
  #ifdef DEBUG_TRACE_ENABLED
    printf ("LEAVE routine_computeEvents\n") ;
  #endif
}

//---------------------------------------------------------------------------*
//                                                                           *
//                 Implementation of routine "generate_all"                  *
//                                                                           *
//---------------------------------------------------------------------------*

void routine_generate_all (C_Compiler & inLexique,
                                const GGS_root_obj   var_cas_cpu COMMA_UNUSED_LOCATION_ARGS) {
  #ifdef DEBUG_TRACE_ENABLED
    printf ("ENTER routine_generate_all at %s:%d\n", __FILE__, __LINE__) ;
  #endif
  GGS_string var_cas_temp_dir = function_templates_directory (inLexique, GGS_string ("code") COMMA_SOURCE_FILE_AT_LINE (705)) ;
  const GGS_bool cond_26721 = (var_cas_temp_dir).operator_isNotEqual (GGS_string ("")) ;
  if (cond_26721.isBuiltAndTrue ()) {
    GGS_string var_cas_target = gOption_goil_5F_options_target_5F_platform.reader_value () ;
    const GGS_bool cond_26633 = (var_cas_target).operator_isNotEqual (GGS_string ("")) ;
    if (cond_26633.isBuiltAndTrue ()) {
      GGS_string var_cas_types = function_template_string (inLexique, GGS_string ("code"), GGS_string ("types") COMMA_SOURCE_FILE_AT_LINE (711)) ;
      GGS_config  var_cas_cfg = GGS_config ::constructor_emptyMap (inLexique COMMA_SOURCE_FILE_AT_LINE (713)) ;
      GGS_lstring  var_cas_cfg_file = function_config_file (inLexique COMMA_SOURCE_FILE_AT_LINE (714)) ;
      const GGS_bool cond_22574 = (var_cas_cfg_file.reader_string (inLexique COMMA_SOURCE_FILE_AT_LINE (715))).operator_isNotEqual (GGS_string ("")) ;
      if (cond_22574.isBuiltAndTrue ()) {
        const GGS_string _depExtension = GGS_string ("") ;
        const GGS_string _depPath = GGS_string ("") ;
        if (_depExtension.isBuilt () && _depPath.isBuilt ()) {
          C_Grammar_cfg_5F_grammar::_performSourceFileParsing_ (inLexique,
                                        _depExtension.string (),
                                        _depPath.string (),
                                        NULL,
                                        var_cas_cfg_file,
                                        var_cas_cfg
                                        COMMA_SOURCE_FILE_AT_LINE (716)) ;
        }
      }
      GGS_lstring  var_cas_extra_cfg_file = function_extra_config_file (inLexique COMMA_SOURCE_FILE_AT_LINE (719)) ;
      const GGS_bool cond_22757 = (var_cas_extra_cfg_file.reader_string (inLexique COMMA_SOURCE_FILE_AT_LINE (720))).operator_isNotEqual (GGS_string ("")) ;
      if (cond_22757.isBuiltAndTrue ()) {
        const GGS_string _depExtension = GGS_string ("") ;
        const GGS_string _depPath = GGS_string ("") ;
        if (_depExtension.isBuilt () && _depPath.isBuilt ()) {
          C_Grammar_cfg_5F_grammar::_performSourceFileParsing_ (inLexique,
                                        _depExtension.string (),
                                        _depPath.string (),
                                        NULL,
                                        var_cas_extra_cfg_file,
                                        var_cas_cfg
                                        COMMA_SOURCE_FILE_AT_LINE (721)) ;
        }
      }
      GGS_os_config  var_cas_generated_conf = function_os_cfg (inLexique, var_cas_cpu COMMA_SOURCE_FILE_AT_LINE (724)) ;
      GGS_uint  var_cas_max_task_prio ;
      GGS_uint  var_cas_max_prio ;
      GGS_prio_map  var_cas_actual_prio = GGS_prio_map ::constructor_emptyMap (inLexique COMMA_SOURCE_FILE_AT_LINE (728)) ;
      ::routine_compute_actual_task_priority (inLexique,  var_cas_cpu.reader_tasks (inLexique COMMA_SOURCE_FILE_AT_LINE (730)),  var_cas_actual_prio,  var_cas_max_task_prio COMMA_SOURCE_FILE_AT_LINE (729)) ;
      ::routine_compute_actual_isr_priority (inLexique,  var_cas_cpu.reader_isrs (inLexique COMMA_SOURCE_FILE_AT_LINE (735)),  var_cas_actual_prio,  var_cas_max_task_prio,  var_cas_max_prio COMMA_SOURCE_FILE_AT_LINE (734)) ;
      GGS_prio_map  var_cas_rez_actual_prio ;
      GGS_stringMap  var_cas_rez_comments ;
      ::routine_compute_rez_priority (inLexique,  var_cas_cpu.reader_resources (inLexique COMMA_SOURCE_FILE_AT_LINE (743)),  var_cas_cpu.reader_tasks (inLexique COMMA_SOURCE_FILE_AT_LINE (744)),  var_cas_cpu.reader_isrs (inLexique COMMA_SOURCE_FILE_AT_LINE (745)),  var_cas_actual_prio,  var_cas_rez_actual_prio,  var_cas_rez_comments COMMA_SOURCE_FILE_AT_LINE (742)) ;
      GGS_prio_list  var_cas_ready_list ;
      ::routine_compute_ready_list (inLexique,  var_cas_actual_prio,  var_cas_rez_actual_prio,  var_cas_max_task_prio,  var_cas_max_prio,  var_cas_ready_list COMMA_SOURCE_FILE_AT_LINE (751)) ;
      GGS_stringMap  var_cas_app_for_obj ;
      ::routine_compute_app_for_obj (inLexique,  var_cas_cpu.reader_applis (inLexique COMMA_SOURCE_FILE_AT_LINE (760)),  var_cas_app_for_obj COMMA_SOURCE_FILE_AT_LINE (759)) ;
      ::routine_generate_types (inLexique,  var_cas_cpu.reader_tasks (inLexique COMMA_SOURCE_FILE_AT_LINE (765)),  var_cas_cpu.reader_isrs (inLexique COMMA_SOURCE_FILE_AT_LINE (766)),  var_cas_cpu.reader_alarms (inLexique COMMA_SOURCE_FILE_AT_LINE (767)),  var_cas_cpu.reader_counters (inLexique COMMA_SOURCE_FILE_AT_LINE (768)),  var_cas_cpu.reader_resources (inLexique COMMA_SOURCE_FILE_AT_LINE (769)),  var_cas_cpu.reader_scheduletables (inLexique COMMA_SOURCE_FILE_AT_LINE (770)),  var_cas_cpu.reader_applis (inLexique COMMA_SOURCE_FILE_AT_LINE (771)),  var_cas_max_prio,  var_cas_types COMMA_SOURCE_FILE_AT_LINE (764)) ;
      GGS_eventMaskMap  var_cas_eventMasks ;
      ::routine_computeEvents (inLexique,  var_cas_cpu,  var_cas_eventMasks COMMA_SOURCE_FILE_AT_LINE (776)) ;
      GGS_goilTemplateVariableMap  var_cas_sysCfg = GGS_goilTemplateVariableMap ::constructor_emptyMap (inLexique COMMA_SOURCE_FILE_AT_LINE (778)) ;
      ::routine_setEnvData (inLexique,  var_cas_cpu,  var_cas_sysCfg COMMA_SOURCE_FILE_AT_LINE (780)) ;
      ::routine_setProcessesList (inLexique,  var_cas_cpu,  var_cas_actual_prio,  var_cas_app_for_obj,  var_cas_sysCfg COMMA_SOURCE_FILE_AT_LINE (781)) ;
      ::routine_setBasicTasksList (inLexique,  var_cas_cpu,  var_cas_actual_prio,  var_cas_app_for_obj,  var_cas_sysCfg COMMA_SOURCE_FILE_AT_LINE (782)) ;
      ::routine_setExtendedTasksList (inLexique,  var_cas_cpu,  var_cas_actual_prio,  var_cas_app_for_obj,  var_cas_sysCfg COMMA_SOURCE_FILE_AT_LINE (783)) ;
      ::routine_setTasksList (inLexique,  var_cas_cpu,  var_cas_actual_prio,  var_cas_app_for_obj,  var_cas_sysCfg COMMA_SOURCE_FILE_AT_LINE (784)) ;
      ::routine_setISRs1List (inLexique,  var_cas_cpu,  var_cas_actual_prio,  var_cas_app_for_obj,  var_cas_sysCfg COMMA_SOURCE_FILE_AT_LINE (785)) ;
      ::routine_setISRs2List (inLexique,  var_cas_cpu,  var_cas_actual_prio,  var_cas_app_for_obj,  var_cas_sysCfg COMMA_SOURCE_FILE_AT_LINE (786)) ;
      ::routine_setCountersList (inLexique,  var_cas_cpu,  var_cas_app_for_obj,  var_cas_sysCfg COMMA_SOURCE_FILE_AT_LINE (787)) ;
      ::routine_setEventsList (inLexique,  var_cas_cpu,  var_cas_eventMasks,  var_cas_sysCfg COMMA_SOURCE_FILE_AT_LINE (788)) ;
      ::routine_setAlarmsList (inLexique,  var_cas_cpu,  var_cas_app_for_obj,  var_cas_sysCfg COMMA_SOURCE_FILE_AT_LINE (789)) ;
      ::routine_setResourcesList (inLexique,  var_cas_cpu,  var_cas_rez_actual_prio,  var_cas_app_for_obj,  var_cas_sysCfg COMMA_SOURCE_FILE_AT_LINE (790)) ;
      ::routine_setMessagesList (inLexique,  var_cas_cpu,  var_cas_app_for_obj,  var_cas_sysCfg COMMA_SOURCE_FILE_AT_LINE (791)) ;
      ::routine_setScheduletablesList (inLexique,  var_cas_cpu,  var_cas_app_for_obj,  var_cas_sysCfg COMMA_SOURCE_FILE_AT_LINE (792)) ;
      ::routine_setOsapplicationsList (inLexique,  var_cas_cpu,  var_cas_app_for_obj,  var_cas_sysCfg COMMA_SOURCE_FILE_AT_LINE (793)) ;
      ::routine_setProcessCount (inLexique,  var_cas_cpu,  var_cas_sysCfg COMMA_SOURCE_FILE_AT_LINE (794)) ;
      ::routine_setBuildConfig (inLexique,  var_cas_cpu,  var_cas_sysCfg COMMA_SOURCE_FILE_AT_LINE (795)) ;
      ::routine_setReadyList (inLexique,  var_cas_cpu,  var_cas_ready_list,  var_cas_sysCfg COMMA_SOURCE_FILE_AT_LINE (796)) ;
      ::routine_addBoolValue (inLexique,  var_cas_sysCfg,  GGS_lstring ::constructor_new (inLexique, GGS_string ("AUTOSAR"), GGS_location (inLexique) COMMA_SOURCE_FILE_AT_LINE (797)),  gOption_goil_5F_options_autosar_5F_on.reader_value () COMMA_SOURCE_FILE_AT_LINE (797)) ;
      ::routine_addUnsignedValue (inLexique,  var_cas_sysCfg,  function_lstringWith (inLexique, GGS_string ("MAXTASKPRIORITY") COMMA_SOURCE_FILE_AT_LINE (798)),  var_cas_max_task_prio.reader_uint64 (inLexique COMMA_SOURCE_FILE_AT_LINE (798)) COMMA_SOURCE_FILE_AT_LINE (798)) ;
      ::routine_setOsConfig (inLexique,  var_cas_cpu,  var_cas_sysCfg COMMA_SOURCE_FILE_AT_LINE (799)) ;
      ::routine_setInterruptSources (inLexique,  var_cas_cfg,  var_cas_sysCfg COMMA_SOURCE_FILE_AT_LINE (800)) ;
      GGS_string var_cas_apiDescriptionFile = function_templateFilePath (inLexique, GGS_string ("config"), GGS_string ("api.desc") COMMA_SOURCE_FILE_AT_LINE (807)) ;
      const GGS_bool cond_25809 = (var_cas_apiDescriptionFile).operator_isNotEqual (GGS_string ("")) ;
      if (cond_25809.isBuiltAndTrue ()) {
        const GGS_string _depExtension = GGS_string ("") ;
        const GGS_string _depPath = GGS_string ("") ;
        if (_depExtension.isBuilt () && _depPath.isBuilt ()) {
          C_Grammar_api_5F_grammar::_performSourceFileParsing_ (inLexique,
                                        _depExtension.string (),
                                        _depPath.string (),
                                        NULL,
                                        function_lstringWith (inLexique, var_cas_apiDescriptionFile COMMA_SOURCE_FILE_AT_LINE (809)),
                                        var_cas_sysCfg
                                        COMMA_SOURCE_FILE_AT_LINE (809)) ;
        }
      }else if (cond_25809.isBuiltAndFalse ()) {
        GGS_location (inLexique).reader_location (inLexique COMMA_HERE).signalGGSSemanticError (inLexique, GGS_string ("No api.desc file found in config templates") COMMA_SOURCE_FILE_AT_LINE (812)) ;
      }
      GGS_string var_cas_goilLog = function_computeTemplate (inLexique, GGS_string (""), var_cas_sysCfg, GGS_string ("root") COMMA_SOURCE_FILE_AT_LINE (814)) ;
      const GGS_bool cond_26095 = gOption_goil_5F_options_generate_5F_log.reader_value () ;
      if (cond_26095.isBuiltAndTrue ()) {
        const GGS_string temp_26067 = var_cas_goilLog ;
        if (temp_26067.isBuilt ()) {
          temp_26067 (HERE)->method_writeToFile (inLexique, GGS_string ("goil.log") COMMA_SOURCE_FILE_AT_LINE (816)) ;
        }
      }
      GGS_string var_cas_directory = function_projectName (inLexique COMMA_SOURCE_FILE_AT_LINE (820)) ;
      GGS_string var_cas_types_file = GGS_string ("tpl_app_custom_types.h") ;
      GGS_uint  var_cas_error_count = GGS_uint ::constructor_errorCount (inLexique COMMA_SOURCE_FILE_AT_LINE (824)) ;
      var_cas_types_file = ((var_cas_directory).operator_concat (GGS_string ("/"))).operator_concat (var_cas_types_file) ;
      const GGS_bool cond_26618 = (var_cas_error_count).operator_isEqual (GGS_uint (0U)) ;
      if (cond_26618.isBuiltAndTrue ()) {
        const GGS_bool cond_26536 = gOption_galgas_5F_cli_5F_options_verbose_5F_output.reader_value () ;
        if (cond_26536.isBuiltAndTrue ()) {
          inLexique.printMessage (((GGS_string ("creating ")).operator_concat (var_cas_types_file)).operator_concat (GGS_string ("\n")) COMMA_SOURCE_FILE_AT_LINE (830)) ;
        }
        const GGS_string temp_26589 = var_cas_types ;
        if (temp_26589.isBuilt ()) {
          temp_26589 (HERE)->method_makeDirectoryAndWriteToFile (inLexique, var_cas_types_file COMMA_SOURCE_FILE_AT_LINE (832)) ;
        }
      }
    }else if (cond_26633.isBuiltAndFalse ()) {
      inLexique.printMessage (GGS_string ("No target platform given, compiling aborted\n") COMMA_SOURCE_FILE_AT_LINE (836)) ;
    }
  }else if (cond_26721.isBuiltAndFalse ()) {
    inLexique.printMessage (GGS_string ("No template directory defined, compiling aborted\n") COMMA_SOURCE_FILE_AT_LINE (839)) ;
  }
  #ifdef DEBUG_TRACE_ENABLED
    printf ("LEAVE routine_generate_all\n") ;
  #endif
}

//---------------------------------------------------------------------------*

