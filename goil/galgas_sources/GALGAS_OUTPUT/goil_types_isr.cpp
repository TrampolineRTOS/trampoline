//---------------------------------------------------------------------------*
//                                                                           *
//                        File 'goil_types_isr.cpp'                          *
//             Generated by version version GALGAS_BETA_VERSION              *
//                    november 17th, 2010, at 19h29'53"                      *
//                                                                           *
//---------------------------------------------------------------------------*

//--- START OF USER ZONE 1


//--- END OF USER ZONE 1

#include "version_libpm.h"
#if CURRENT_LIBPM_VERSION != VERSION_OF_LIBPM_USED_BY_GALGAS_COMPILER
  #error "This file has been compiled with a version of GALGAS that uses libpm version VERSION_OF_LIBPM_USED_BY_GALGAS_COMPILER, different than the current version (CURRENT_LIBPM_VERSION) of libpm"
#endif

//---------------------------------------------------------------------------*

#include "goil_types_isr.h"
#include "galgas2/C_Compiler.h"
#include "galgas2/C_galgas_CLI_Options.h"

//---------------------------------------------------------------------------*

#include "goil_options.h"

//---------------------------------------------------------------------------*

#ifndef DO_NOT_GENERATE_CHECKINGS
  #define SOURCE_FILE_AT_LINE(line) "goil_types_isr.gSemantics", line
  #define COMMA_SOURCE_FILE_AT_LINE(line) , SOURCE_FILE_AT_LINE(line)
#else
  #define SOURCE_FILE_AT_LINE(line) 
  #define COMMA_SOURCE_FILE_AT_LINE(line) 
#endif

//---------------------------------------------------------------------------*

cMapElement_isr_5F_map::cMapElement_isr_5F_map (const GALGAS_lstring & inKey,
                                                const GALGAS_isr_5F_obj & in_isr
                                                COMMA_LOCATION_ARGS) :
cMapElement (inKey COMMA_THERE),
mAttribute_isr (in_isr) {
}

//---------------------------------------------------------------------------*

bool cMapElement_isr_5F_map::isValid (void) const {
  return mAttribute_lkey.isValid () && mAttribute_isr.isValid () ;
}

//---------------------------------------------------------------------------*

cMapElement * cMapElement_isr_5F_map::copy (void) {
  cMapElement * result = NULL ;
  macroMyNew (result, cMapElement_isr_5F_map (mAttribute_lkey, mAttribute_isr COMMA_HERE)) ;
  return result ;
}

//---------------------------------------------------------------------------*

void cMapElement_isr_5F_map::description (C_String & /* ioString */, const PMSInt32 /* inIndentation */) const {
// mAttribute_isr.description (ioString, inIndentation) ;
}

//---------------------------------------------------------------------------*

enumComparisonResult cMapElement_isr_5F_map::compare (const cCollectionElement * inOperand) const {
  cMapElement_isr_5F_map * operand = (cMapElement_isr_5F_map *) inOperand ;
  enumComparisonResult result = mAttribute_lkey.objectCompare (operand->mAttribute_lkey) ;
  if (kOperandEqual == result) {
    result = mAttribute_isr.objectCompare (operand->mAttribute_isr) ;
  }
  return result ;
}

//---------------------------------------------------------------------------*

GALGAS_isr_5F_map::GALGAS_isr_5F_map (void) :
AC_GALGAS_map () {
}

//---------------------------------------------------------------------------*

GALGAS_isr_5F_map::GALGAS_isr_5F_map (const GALGAS_isr_5F_map & inSource) :
AC_GALGAS_map (inSource) {
}

//---------------------------------------------------------------------------*

GALGAS_isr_5F_map & GALGAS_isr_5F_map::operator = (const GALGAS_isr_5F_map & inSource) {
  * ((AC_GALGAS_map *) this) = inSource ;
  return * this ;
}

//---------------------------------------------------------------------------*

GALGAS_isr_5F_map GALGAS_isr_5F_map::constructor_emptyMap (LOCATION_ARGS) {
  GALGAS_isr_5F_map result ;
  result.makeNewEmptyMap (THERE) ;
  return result ;
}

//---------------------------------------------------------------------------*

GALGAS_isr_5F_map GALGAS_isr_5F_map::constructor_mapWithMapToOverride (const GALGAS_isr_5F_map & inMapToOverride
                                                                       COMMA_LOCATION_ARGS) {
  GALGAS_isr_5F_map result ;
  result.makeNewEmptyMapWithMapToOverride (inMapToOverride COMMA_THERE) ;
  return result ;
}

//---------------------------------------------------------------------------*

GALGAS_isr_5F_map GALGAS_isr_5F_map::reader_overriddenMap (UNUSED_LOCATION_ARGS) const {
  GALGAS_isr_5F_map result ;
  getOverridenMap (result) ;
  return result ;
}
//---------------------------------------------------------------------------*

void GALGAS_isr_5F_map::modifier_put (GALGAS_lstring inKey,
                                      GALGAS_isr_5F_obj inArgument0,
                                      C_Compiler * inCompiler
                                      COMMA_LOCATION_ARGS) {
  cMapElement_isr_5F_map * p = NULL ;
  macroMyNew (p, cMapElement_isr_5F_map (inKey, inArgument0 COMMA_HERE)) ;
  capCollectionElement attributes ;
  attributes.setPointer (p) ;
  macroDetachSharedObject (p) ;
  const char * kInsertErrorMessage = "ISR %K is duplicated in %L" ;
  const char * kShadowErrorMessage = "" ;
  performInsert (attributes, inCompiler, kInsertErrorMessage, kShadowErrorMessage COMMA_THERE) ;
}

//---------------------------------------------------------------------------*

const char * kSearchErrorMessage_isr_5F_map_get = "IRS %K is not defined" ;

//---------------------------------------------------------------------------*

void GALGAS_isr_5F_map::method_get (GALGAS_lstring inKey,
                                    GALGAS_isr_5F_obj & outArgument0,
                                    C_Compiler * inCompiler
                                    COMMA_LOCATION_ARGS) const {
  const cMapElement_isr_5F_map * p = (const cMapElement_isr_5F_map *) performSearch (inKey,
                                                                                       inCompiler,
                                                                                       kSearchErrorMessage_isr_5F_map_get
                                                                                       COMMA_THERE) ;
  if (NULL == p) {
    outArgument0.drop () ;
  }else{
    macroValidSharedObject (p, const cMapElement_isr_5F_map) ;
    outArgument0 = p->mAttribute_isr ;
  }
}

//---------------------------------------------------------------------------*

void GALGAS_isr_5F_map::modifier_del (GALGAS_lstring inKey,
                                      GALGAS_isr_5F_obj & outArgument0,
                                      C_Compiler * inCompiler
                                      COMMA_LOCATION_ARGS) {
  const char * kRemoveErrorMessage = "ISR %K is not defined" ;
  capCollectionElement attributes ;
  performRemove (inKey, attributes, inCompiler, kRemoveErrorMessage COMMA_THERE) ;
  cMapElement_isr_5F_map * p = (cMapElement_isr_5F_map *) attributes.ptr () ;
  if (NULL != p) {
    macroValidSharedObject (p, cMapElement_isr_5F_map) ;
    outArgument0 = p->mAttribute_isr ;
  }
}

//---------------------------------------------------------------------------*

GALGAS_isr_5F_obj GALGAS_isr_5F_map::reader_isrForKey (const GALGAS_string & inKey,
                                                       C_Compiler * inCompiler
                                                       COMMA_LOCATION_ARGS) const {
  const cCollectionElement * attributes = searchForReadingAttribute (inKey, inCompiler COMMA_THERE) ;
  const cMapElement_isr_5F_map * p = (const cMapElement_isr_5F_map *) attributes ;
  GALGAS_isr_5F_obj result ;
  if (NULL != p) {
    macroValidSharedObject (p, const cMapElement_isr_5F_map) ;
    result = p->mAttribute_isr ;
  }
  return result ;
}

//---------------------------------------------------------------------------*

void GALGAS_isr_5F_map::modifier_setIsrForKey (GALGAS_isr_5F_obj inAttributeValue,
                                               GALGAS_string inKey,
                                               C_Compiler * inCompiler
                                               COMMA_LOCATION_ARGS) {
  cCollectionElement * attributes = searchForReadWriteAttribute (inKey, inCompiler COMMA_THERE) ;
  cMapElement_isr_5F_map * p = (cMapElement_isr_5F_map *) attributes ;
  if (NULL != p) {
    macroValidSharedObject (p, cMapElement_isr_5F_map) ;
    p->mAttribute_isr = inAttributeValue ;
  }
}

//---------------------------------------------------------------------------*

cMapElement_isr_5F_map * GALGAS_isr_5F_map::readWriteAccessForWithInstruction_get (C_Compiler * inCompiler,
                                                                                   const GALGAS_lstring & inKey
                                                                                   COMMA_LOCATION_ARGS) {
  cMapElement * p = searchForReadWriteAttribute (inKey, inCompiler, kSearchErrorMessage_isr_5F_map_get COMMA_THERE) ;
  cMapElement_isr_5F_map * result = (cMapElement_isr_5F_map *) p ;
  macroNullOrValidSharedObject (result, cMapElement_isr_5F_map) ;
  return result ;
}

//---------------------------------------------------------------------------*

cMapElement_isr_5F_map * GALGAS_isr_5F_map::readWriteAccessForWithInstruction_hasKey (C_Compiler * inCompiler,
                                                                                      const GALGAS_string & inKey
                                                                                      COMMA_LOCATION_ARGS) {
  cMapElement * p = searchForReadWriteAttribute (inKey, inCompiler COMMA_THERE) ;
  cMapElement_isr_5F_map * result = (cMapElement_isr_5F_map *) p ;
  macroNullOrValidSharedObject (result, cMapElement_isr_5F_map) ;
  return result ;
}

//---------------------------------------------------------------------------*

cEnumerator_isr_5F_map::cEnumerator_isr_5F_map (const GALGAS_isr_5F_map & inEnumeratedObject,
                                                const bool inAscending) :
cGenericAbstractEnumerator () {
  inEnumeratedObject.populateEnumerationArray (mEnumerationArray, inAscending) ;
}

//---------------------------------------------------------------------------*

GALGAS_lstring cEnumerator_isr_5F_map::current_lkey (LOCATION_ARGS) const {
  const cMapElement * p = (const cMapElement *) currentObjectPtr (THERE) ;
  macroValidSharedObject (p, const cMapElement) ;
  return p->mAttribute_lkey ;
}

//---------------------------------------------------------------------------*

GALGAS_isr_5F_obj cEnumerator_isr_5F_map::current_isr (LOCATION_ARGS) const {
  const cMapElement_isr_5F_map * p = (const cMapElement_isr_5F_map *) currentObjectPtr (THERE) ;
  macroValidSharedObject (p, const cMapElement_isr_5F_map) ;
  return p->mAttribute_isr ;
}



//---------------------------------------------------------------------------*
//                                                                           *
//                               @isr_map type                               *
//                                                                           *
//---------------------------------------------------------------------------*

const C_galgas_type_descriptor
kTypeDescriptor_GALGAS_isr_5F_map ("isr_map",
                                   NULL) ;

//---------------------------------------------------------------------------*

const C_galgas_type_descriptor * GALGAS_isr_5F_map::staticTypeDescriptor (void) const {
  return & kTypeDescriptor_GALGAS_isr_5F_map ;
}

//---------------------------------------------------------------------------*

AC_GALGAS_root * GALGAS_isr_5F_map::clonedObject (void) const {
  AC_GALGAS_root * result = NULL ;
  if (isValid ()) {
    macroMyNew (result, GALGAS_isr_5F_map (*this)) ;
  }
  return result ;
}

//---------------------------------------------------------------------------*

GALGAS_isr_5F_map GALGAS_isr_5F_map::extractObject (const GALGAS_object & inObject,
                                                    C_Compiler * inCompiler,
                                                    const GALGAS_location & inErrorLocation
                                                    COMMA_LOCATION_ARGS) {
  GALGAS_isr_5F_map result ;
  const GALGAS_isr_5F_map * p = (const GALGAS_isr_5F_map *) inObject.embeddedObject () ;
  if (NULL != p) {
    if (NULL != dynamic_cast <const GALGAS_isr_5F_map *> (p)) {
      result = *p ;
    }else{
      inCompiler->extractObjectError (inErrorLocation, "isr_map", p->dynamicTypeDescriptor () COMMA_THERE) ;
    }  
  }
  return result ;
}

//---------------------------------------------------------------------------*
//                                                                           *
//              Class for element of '@isr_5F_list' sorted list              *
//                                                                           *
//---------------------------------------------------------------------------*

class cSortedListElement_isr_5F_list : public cSortedListElement {
//--- List attributes
  public : GALGAS_lstring mAttribute_lkey ;
  public : GALGAS_string mAttribute_sort ;

//--- Constructor
  public : cSortedListElement_isr_5F_list (const GALGAS_lstring & in_lkey,
                                           const GALGAS_string & in_sort
                                           COMMA_LOCATION_ARGS) ;

//--- Virtual method that checks that all attributes are valid
  public : virtual bool isValid (void) const ;

//--- Virtual method that returns a copy of current object
  public : virtual cSortedListElement * copy (void) ;

//--- Virtual method for comparing elements
  public : virtual enumComparisonResult compare (const cCollectionElement * inOperand) const ;

//--- Description
 public : virtual void description (C_String & ioString, const PMSInt32 inIndentation) const ;

//--- Virtual method that comparing element for sorting
  public : virtual enumComparisonResult compareForSorting (const cSortedListElement * inOperand) const ;
} ;

//---------------------------------------------------------------------------*

cSortedListElement_isr_5F_list::cSortedListElement_isr_5F_list (const GALGAS_lstring & in_lkey,
                                                                const GALGAS_string & in_sort
                                                                COMMA_LOCATION_ARGS) :
cSortedListElement (THERE),
mAttribute_lkey (in_lkey),
mAttribute_sort (in_sort) {
}

//---------------------------------------------------------------------------*

bool cSortedListElement_isr_5F_list::isValid (void) const {
  return mAttribute_lkey.isValid () && mAttribute_sort.isValid () ;
}

//---------------------------------------------------------------------------*

cSortedListElement * cSortedListElement_isr_5F_list::copy (void) {
  cSortedListElement * result = NULL ;
  macroMyNew (result, cSortedListElement_isr_5F_list (mAttribute_lkey, mAttribute_sort COMMA_HERE)) ;
  return result ;
}

//---------------------------------------------------------------------------*

void cSortedListElement_isr_5F_list::description (C_String & /* ioString */, const PMSInt32 /* inIndentation */) const {
// mAttribute_lkey.description (ioString, inIndentation) ;
// mAttribute_sort.description (ioString, inIndentation) ;
}

//---------------------------------------------------------------------------*

enumComparisonResult cSortedListElement_isr_5F_list::compare (const cCollectionElement * inOperand) const {
  enumComparisonResult result = kOperandNotValid ;
  if (NULL != inOperand) {
    result = kOperandEqual ;
    cSortedListElement_isr_5F_list * operand = (cSortedListElement_isr_5F_list *) inOperand ;
    macroValidSharedObject (operand, cSortedListElement_isr_5F_list) ;
    if (kOperandEqual == result) {
      result = mAttribute_lkey.objectCompare (operand->mAttribute_lkey) ;
    }
    if (kOperandEqual == result) {
      result = mAttribute_sort.objectCompare (operand->mAttribute_sort) ;
    }
  }
  return result ;
}

//---------------------------------------------------------------------------*

GALGAS_isr_5F_list::GALGAS_isr_5F_list (void) :
AC_GALGAS_sortedlist () {
}

//---------------------------------------------------------------------------*

enumComparisonResult cSortedListElement_isr_5F_list::compareForSorting (const cSortedListElement * inOperand) const {
  enumComparisonResult result = kOperandEqual ;
  const cSortedListElement_isr_5F_list * operand = (const cSortedListElement_isr_5F_list *) inOperand ;
  macroValidSharedObject (operand, const cSortedListElement_isr_5F_list) ;
  if (result == kOperandEqual) {
    result = mAttribute_sort.objectCompare (operand->mAttribute_sort) ;
  }
  return result ;
}

//---------------------------------------------------------------------------*

GALGAS_isr_5F_list GALGAS_isr_5F_list::constructor_emptySortedList (LOCATION_ARGS) {
  GALGAS_isr_5F_list result ;
  result.createNewEmptySortedList (THERE) ;
  return result ;
}

//---------------------------------------------------------------------------*

GALGAS_isr_5F_list GALGAS_isr_5F_list::constructor_sortedListWithValue (const GALGAS_lstring & inOperand0,
                                                                        const GALGAS_string & inOperand1
                                                                        COMMA_LOCATION_ARGS) {
  GALGAS_isr_5F_list result = constructor_emptySortedList (THERE) ;
  cSortedListElement * p = NULL ;
  macroMyNew (p, cSortedListElement_isr_5F_list (inOperand0, inOperand1 COMMA_THERE)) ;
  capSortedListElement attributes ;
  attributes.setPointer (p) ;
  macroDetachSharedObject (p) ;
  result.addObject (attributes) ;
  return result ;
}

//---------------------------------------------------------------------------*

void GALGAS_isr_5F_list::addAssign_operation (const GALGAS_lstring & inOperand0,
                                              const GALGAS_string & inOperand1
                                              COMMA_LOCATION_ARGS) {
  if (isValid ()) {
    cSortedListElement * p = NULL ;
    macroMyNew (p, cSortedListElement_isr_5F_list (inOperand0, inOperand1 COMMA_THERE)) ;
    capSortedListElement attributes ;
    attributes.setPointer (p) ;
    macroDetachSharedObject (p) ;
    addObject (attributes) ;
  }
}

//---------------------------------------------------------------------------*

void GALGAS_isr_5F_list::dotAssign_operation (const GALGAS_isr_5F_list inOperand
                                              COMMA_UNUSED_LOCATION_ARGS) {
  if (isValid ()) {
    appendSortedList (inOperand) ;
  }
}

//---------------------------------------------------------------------------*

GALGAS_isr_5F_list GALGAS_isr_5F_list::operator_concat (const GALGAS_isr_5F_list & inOperand
                                                        COMMA_LOCATION_ARGS) const {
  GALGAS_isr_5F_list result ;
  if (isValid () && inOperand.isValid ()) {
    result = constructor_emptySortedList (THERE) ;
    result = *this ;
    result.appendSortedList (inOperand) ;
  }
  return result ;
}

//---------------------------------------------------------------------------*

void GALGAS_isr_5F_list::modifier_popSmallest (GALGAS_lstring & outOperand0,
                                               GALGAS_string & outOperand1,
                                               C_Compiler * inCompiler
                                               COMMA_LOCATION_ARGS) {
  capSortedListElement attributes ;
  removeSmallestObject (attributes, inCompiler COMMA_THERE) ;
  cSortedListElement_isr_5F_list * p = (cSortedListElement_isr_5F_list *) attributes.ptr () ;
  if (NULL == p) {
    outOperand0.drop () ;
    outOperand1.drop () ;
  }else{
    macroValidSharedObject (p, cSortedListElement_isr_5F_list) ;
    outOperand0 = p->mAttribute_lkey ;
    outOperand1 = p->mAttribute_sort ;
  }
}

//---------------------------------------------------------------------------*

void GALGAS_isr_5F_list::modifier_popGreatest (GALGAS_lstring & outOperand0,
                                               GALGAS_string & outOperand1,
                                               C_Compiler * inCompiler
                                               COMMA_LOCATION_ARGS) {
  capSortedListElement attributes ;
  removeGreatestObject (attributes, inCompiler COMMA_THERE) ;
  cSortedListElement_isr_5F_list * p = (cSortedListElement_isr_5F_list *) attributes.ptr () ;
  if (NULL == p) {
    outOperand0.drop () ;
    outOperand1.drop () ;
  }else{
    macroValidSharedObject (p, cSortedListElement_isr_5F_list) ;
    outOperand0 = p->mAttribute_lkey ;
    outOperand1 = p->mAttribute_sort ;
  }
}

//---------------------------------------------------------------------------*

void GALGAS_isr_5F_list::method_smallest (GALGAS_lstring & outOperand0,
                                          GALGAS_string & outOperand1,
                                          C_Compiler * inCompiler
                                          COMMA_LOCATION_ARGS) const {
  capSortedListElement attributes ;
  smallestObjectAttributeList (attributes, inCompiler COMMA_THERE) ;
  cSortedListElement_isr_5F_list * p = (cSortedListElement_isr_5F_list *) attributes.ptr () ;
  if (NULL == p) {
    outOperand0.drop () ;
    outOperand1.drop () ;
  }else{
    macroValidSharedObject (p, cSortedListElement_isr_5F_list) ;
    outOperand0 = p->mAttribute_lkey ;
    outOperand1 = p->mAttribute_sort ;
  }
}

//---------------------------------------------------------------------------*

void GALGAS_isr_5F_list::method_greatest (GALGAS_lstring & outOperand0,
                                          GALGAS_string & outOperand1,
                                          C_Compiler * inCompiler
                                          COMMA_LOCATION_ARGS) const {
  capSortedListElement attributes ;
  greatestObjectAttributeList (attributes, inCompiler COMMA_THERE) ;
  cSortedListElement_isr_5F_list * p = (cSortedListElement_isr_5F_list *) attributes.ptr () ;
  if (NULL == p) {
    outOperand0.drop () ;
    outOperand1.drop () ;
  }else{
    macroValidSharedObject (p, cSortedListElement_isr_5F_list) ;
    outOperand0 = p->mAttribute_lkey ;
    outOperand1 = p->mAttribute_sort ;
  }
}

//---------------------------------------------------------------------------*

cEnumerator_isr_5F_list::cEnumerator_isr_5F_list (const GALGAS_isr_5F_list & inEnumeratedObject,
                                                  const bool inAscending) :
cGenericAbstractEnumerator () {
  inEnumeratedObject.populateEnumerationArray (mEnumerationArray, inAscending) ;
}

//---------------------------------------------------------------------------*

GALGAS_lstring cEnumerator_isr_5F_list::current_lkey (LOCATION_ARGS) const {
  const cSortedListElement_isr_5F_list * p = (const cSortedListElement_isr_5F_list *) currentObjectPtr (THERE) ;
  macroValidSharedObject (p, const cSortedListElement_isr_5F_list) ;
  return p->mAttribute_lkey ;
}

//---------------------------------------------------------------------------*

GALGAS_string cEnumerator_isr_5F_list::current_sort (LOCATION_ARGS) const {
  const cSortedListElement_isr_5F_list * p = (const cSortedListElement_isr_5F_list *) currentObjectPtr (THERE) ;
  macroValidSharedObject (p, const cSortedListElement_isr_5F_list) ;
  return p->mAttribute_sort ;
}



//---------------------------------------------------------------------------*
//                                                                           *
//                              @isr_list type                               *
//                                                                           *
//---------------------------------------------------------------------------*

const C_galgas_type_descriptor
kTypeDescriptor_GALGAS_isr_5F_list ("isr_list",
                                    NULL) ;

//---------------------------------------------------------------------------*

const C_galgas_type_descriptor * GALGAS_isr_5F_list::staticTypeDescriptor (void) const {
  return & kTypeDescriptor_GALGAS_isr_5F_list ;
}

//---------------------------------------------------------------------------*

AC_GALGAS_root * GALGAS_isr_5F_list::clonedObject (void) const {
  AC_GALGAS_root * result = NULL ;
  if (isValid ()) {
    macroMyNew (result, GALGAS_isr_5F_list (*this)) ;
  }
  return result ;
}

//---------------------------------------------------------------------------*

GALGAS_isr_5F_list GALGAS_isr_5F_list::extractObject (const GALGAS_object & inObject,
                                                      C_Compiler * inCompiler,
                                                      const GALGAS_location & inErrorLocation
                                                      COMMA_LOCATION_ARGS) {
  GALGAS_isr_5F_list result ;
  const GALGAS_isr_5F_list * p = (const GALGAS_isr_5F_list *) inObject.embeddedObject () ;
  if (NULL != p) {
    if (NULL != dynamic_cast <const GALGAS_isr_5F_list *> (p)) {
      result = *p ;
    }else{
      inCompiler->extractObjectError (inErrorLocation, "isr_list", p->dynamicTypeDescriptor () COMMA_THERE) ;
    }  
  }
  return result ;
}

//---------------------------------------------------------------------------*

enumComparisonResult GALGAS_isr_5F_obj::objectCompare (const GALGAS_isr_5F_obj & inOperand) const {
  enumComparisonResult result = GALGAS_oil_5F_obj::objectCompare (inOperand) ;
  const cPtr_isr_5F_obj * p = (const cPtr_isr_5F_obj *) mObjectPtr ;
  macroNullOrValidSharedObject (p, const cPtr_isr_5F_obj) ;
  const cPtr_isr_5F_obj * q = (const cPtr_isr_5F_obj *) inOperand.mObjectPtr ;
  macroNullOrValidSharedObject (q, const cPtr_isr_5F_obj) ;
  if (kOperandEqual == result) {
    result = p->mAttribute_category.objectCompare (q->mAttribute_category) ;
  }
  if (kOperandEqual == result) {
    result = p->mAttribute_priority.objectCompare (q->mAttribute_priority) ;
  }
  if (kOperandEqual == result) {
    result = p->mAttribute_resources.objectCompare (q->mAttribute_resources) ;
  }
  if (kOperandEqual == result) {
    result = p->mAttribute_messages.objectCompare (q->mAttribute_messages) ;
  }
  if (kOperandEqual == result) {
    result = p->mAttribute_acc_5F_apps.objectCompare (q->mAttribute_acc_5F_apps) ;
  }
  if (kOperandEqual == result) {
    result = p->mAttribute_timing_5F_prot.objectCompare (q->mAttribute_timing_5F_prot) ;
  }
  if (kOperandEqual == result) {
    result = p->mAttribute_other_5F_fields.objectCompare (q->mAttribute_other_5F_fields) ;
  }
  return result ;
}


//---------------------------------------------------------------------------*

GALGAS_isr_5F_obj::GALGAS_isr_5F_obj (void) :
GALGAS_oil_5F_obj () {
}

//---------------------------------------------------------------------------*

GALGAS_isr_5F_obj::GALGAS_isr_5F_obj (const cPtr_isr_5F_obj * inSourcePtr) :
GALGAS_oil_5F_obj (inSourcePtr) {
  macroNullOrValidSharedObject (inSourcePtr, const cPtr_isr_5F_obj) ;
}

//---------------------------------------------------------------------------*

GALGAS_isr_5F_obj GALGAS_isr_5F_obj::constructor_new (const GALGAS_lstring & inAttribute_desc,
                                                      const GALGAS_basic_5F_type & inAttribute_category,
                                                      const GALGAS_basic_5F_type & inAttribute_priority,
                                                      const GALGAS_lstringlist & inAttribute_resources,
                                                      const GALGAS_lstringlist & inAttribute_messages,
                                                      const GALGAS_lstringlist & inAttribute_acc_5F_apps,
                                                      const GALGAS_timing_5F_prot & inAttribute_timing_5F_prot,
                                                      const GALGAS_ident_5F_map & inAttribute_other_5F_fields
                                                      COMMA_LOCATION_ARGS) {
  GALGAS_isr_5F_obj result ;
  if (inAttribute_desc.isValid () && inAttribute_category.isValid () && inAttribute_priority.isValid () && inAttribute_resources.isValid () && inAttribute_messages.isValid () && inAttribute_acc_5F_apps.isValid () && inAttribute_timing_5F_prot.isValid () && inAttribute_other_5F_fields.isValid ()) {
    macroMyNew (result.mObjectPtr, cPtr_isr_5F_obj (inAttribute_desc, inAttribute_category, inAttribute_priority, inAttribute_resources, inAttribute_messages, inAttribute_acc_5F_apps, inAttribute_timing_5F_prot, inAttribute_other_5F_fields COMMA_THERE)) ;
  }
  return result ;
}

//---------------------------------------------------------------------------*

void GALGAS_isr_5F_obj::insulate (LOCATION_ARGS) {
  if (isValid () && (mObjectPtr->retainCount () > 1)) {
    cPtr_isr_5F_obj * p = (cPtr_isr_5F_obj *) mObjectPtr ;
    macroValidSharedObject (p, cPtr_isr_5F_obj) ;
    cPtr_isr_5F_obj * r = NULL ;
    macroMyNew (r, cPtr_isr_5F_obj (p->mAttribute_desc, p->mAttribute_category, p->mAttribute_priority, p->mAttribute_resources, p->mAttribute_messages, p->mAttribute_acc_5F_apps, p->mAttribute_timing_5F_prot, p->mAttribute_other_5F_fields COMMA_THERE)) ;
    macroAssignSharedObject (mObjectPtr, r) ;
    macroDetachSharedObject (r) ;
  }
}

//---------------------------------------------------------------------------*

GALGAS_basic_5F_type GALGAS_isr_5F_obj::reader_category (UNUSED_LOCATION_ARGS) const {
  GALGAS_basic_5F_type result ;
  if (NULL != mObjectPtr) {
    const cPtr_isr_5F_obj * p = (const cPtr_isr_5F_obj *) mObjectPtr ;
    macroValidSharedObject (p, const cPtr_isr_5F_obj) ;
    result = p->mAttribute_category ;
  }
  return result ;
}

//---------------------------------------------------------------------------*

GALGAS_basic_5F_type GALGAS_isr_5F_obj::reader_priority (UNUSED_LOCATION_ARGS) const {
  GALGAS_basic_5F_type result ;
  if (NULL != mObjectPtr) {
    const cPtr_isr_5F_obj * p = (const cPtr_isr_5F_obj *) mObjectPtr ;
    macroValidSharedObject (p, const cPtr_isr_5F_obj) ;
    result = p->mAttribute_priority ;
  }
  return result ;
}

//---------------------------------------------------------------------------*

GALGAS_lstringlist GALGAS_isr_5F_obj::reader_resources (UNUSED_LOCATION_ARGS) const {
  GALGAS_lstringlist result ;
  if (NULL != mObjectPtr) {
    const cPtr_isr_5F_obj * p = (const cPtr_isr_5F_obj *) mObjectPtr ;
    macroValidSharedObject (p, const cPtr_isr_5F_obj) ;
    result = p->mAttribute_resources ;
  }
  return result ;
}

//---------------------------------------------------------------------------*

GALGAS_lstringlist GALGAS_isr_5F_obj::reader_messages (UNUSED_LOCATION_ARGS) const {
  GALGAS_lstringlist result ;
  if (NULL != mObjectPtr) {
    const cPtr_isr_5F_obj * p = (const cPtr_isr_5F_obj *) mObjectPtr ;
    macroValidSharedObject (p, const cPtr_isr_5F_obj) ;
    result = p->mAttribute_messages ;
  }
  return result ;
}

//---------------------------------------------------------------------------*

GALGAS_lstringlist GALGAS_isr_5F_obj::reader_acc_5F_apps (UNUSED_LOCATION_ARGS) const {
  GALGAS_lstringlist result ;
  if (NULL != mObjectPtr) {
    const cPtr_isr_5F_obj * p = (const cPtr_isr_5F_obj *) mObjectPtr ;
    macroValidSharedObject (p, const cPtr_isr_5F_obj) ;
    result = p->mAttribute_acc_5F_apps ;
  }
  return result ;
}

//---------------------------------------------------------------------------*

GALGAS_timing_5F_prot GALGAS_isr_5F_obj::reader_timing_5F_prot (UNUSED_LOCATION_ARGS) const {
  GALGAS_timing_5F_prot result ;
  if (NULL != mObjectPtr) {
    const cPtr_isr_5F_obj * p = (const cPtr_isr_5F_obj *) mObjectPtr ;
    macroValidSharedObject (p, const cPtr_isr_5F_obj) ;
    result = p->mAttribute_timing_5F_prot ;
  }
  return result ;
}

//---------------------------------------------------------------------------*

GALGAS_ident_5F_map GALGAS_isr_5F_obj::reader_other_5F_fields (UNUSED_LOCATION_ARGS) const {
  GALGAS_ident_5F_map result ;
  if (NULL != mObjectPtr) {
    const cPtr_isr_5F_obj * p = (const cPtr_isr_5F_obj *) mObjectPtr ;
    macroValidSharedObject (p, const cPtr_isr_5F_obj) ;
    result = p->mAttribute_other_5F_fields ;
  }
  return result ;
}

//---------------------------------------------------------------------------*
//                     Pointer class for @isr_obj class                      *
//---------------------------------------------------------------------------*

cPtr_isr_5F_obj::cPtr_isr_5F_obj (const GALGAS_lstring & in_desc,
                                  const GALGAS_basic_5F_type & in_category,
                                  const GALGAS_basic_5F_type & in_priority,
                                  const GALGAS_lstringlist & in_resources,
                                  const GALGAS_lstringlist & in_messages,
                                  const GALGAS_lstringlist & in_acc_5F_apps,
                                  const GALGAS_timing_5F_prot & in_timing_5F_prot,
                                  const GALGAS_ident_5F_map & in_other_5F_fields
                                  COMMA_LOCATION_ARGS) :
cPtr_oil_5F_obj (in_desc COMMA_THERE),
mAttribute_category (in_category),
mAttribute_priority (in_priority),
mAttribute_resources (in_resources),
mAttribute_messages (in_messages),
mAttribute_acc_5F_apps (in_acc_5F_apps),
mAttribute_timing_5F_prot (in_timing_5F_prot),
mAttribute_other_5F_fields (in_other_5F_fields) {
}

//---------------------------------------------------------------------------*

const C_galgas_type_descriptor * cPtr_isr_5F_obj::classDescriptor (void) const {
  return & kTypeDescriptor_GALGAS_isr_5F_obj ;
}

void cPtr_isr_5F_obj::description (C_String & ioString,
                                   const PMSInt32 inIndentation) const {
  ioString << "[@isr_obj:" ;
  mAttribute_desc.description (ioString, inIndentation+1) ;
  ioString << ", " ;
  mAttribute_category.description (ioString, inIndentation+1) ;
  ioString << ", " ;
  mAttribute_priority.description (ioString, inIndentation+1) ;
  ioString << ", " ;
  mAttribute_resources.description (ioString, inIndentation+1) ;
  ioString << ", " ;
  mAttribute_messages.description (ioString, inIndentation+1) ;
  ioString << ", " ;
  mAttribute_acc_5F_apps.description (ioString, inIndentation+1) ;
  ioString << ", " ;
  mAttribute_timing_5F_prot.description (ioString, inIndentation+1) ;
  ioString << ", " ;
  mAttribute_other_5F_fields.description (ioString, inIndentation+1) ;
  ioString << "]" ;
}



//---------------------------------------------------------------------------*
//                                                                           *
//                               @isr_obj type                               *
//                                                                           *
//---------------------------------------------------------------------------*

const C_galgas_type_descriptor
kTypeDescriptor_GALGAS_isr_5F_obj ("isr_obj",
                                   & kTypeDescriptor_GALGAS_oil_5F_obj) ;

//---------------------------------------------------------------------------*

const C_galgas_type_descriptor * GALGAS_isr_5F_obj::staticTypeDescriptor (void) const {
  return & kTypeDescriptor_GALGAS_isr_5F_obj ;
}

//---------------------------------------------------------------------------*

AC_GALGAS_root * GALGAS_isr_5F_obj::clonedObject (void) const {
  AC_GALGAS_root * result = NULL ;
  if (isValid ()) {
    macroMyNew (result, GALGAS_isr_5F_obj (*this)) ;
  }
  return result ;
}

//---------------------------------------------------------------------------*

GALGAS_isr_5F_obj GALGAS_isr_5F_obj::extractObject (const GALGAS_object & inObject,
                                                    C_Compiler * inCompiler,
                                                    const GALGAS_location & inErrorLocation
                                                    COMMA_LOCATION_ARGS) {
  GALGAS_isr_5F_obj result ;
  const GALGAS_isr_5F_obj * p = (const GALGAS_isr_5F_obj *) inObject.embeddedObject () ;
  if (NULL != p) {
    if (NULL != dynamic_cast <const GALGAS_isr_5F_obj *> (p)) {
      result = *p ;
    }else{
      inCompiler->extractObjectError (inErrorLocation, "isr_obj", p->dynamicTypeDescriptor () COMMA_THERE) ;
    }  
  }
  return result ;
}

//--- START OF USER ZONE 2


//--- END OF USER ZONE 2


