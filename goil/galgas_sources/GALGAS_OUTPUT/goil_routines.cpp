//---------------------------------------------------------------------------*
//                                                                           *
//                         File 'goil_routines.cpp'                          *
//                    Generated by version version 2.1.4                     *
//                     january 27th, 2011, at 10h44'30"                      *
//                                                                           *
//---------------------------------------------------------------------------*

//--- START OF USER ZONE 1


//--- END OF USER ZONE 1

#include "version_libpm.h"
#if CURRENT_LIBPM_VERSION != 926
  #error "This file has been compiled with a version of GALGAS that uses libpm version 926, different than the current version (CURRENT_LIBPM_VERSION) of libpm"
#endif

//---------------------------------------------------------------------------*

#include "goil_routines.h"
#include "galgas2/C_Compiler.h"
#include "galgas2/C_galgas_CLI_Options.h"

//---------------------------------------------------------------------------*

#include "goil_options.h"

//---------------------------------------------------------------------------*

#ifndef DO_NOT_GENERATE_CHECKINGS
  #define SOURCE_FILE_AT_LINE(line) "goil_routines.gSemantics", line
  #define COMMA_SOURCE_FILE_AT_LINE(line) , SOURCE_FILE_AT_LINE(line)
#else
  #define SOURCE_FILE_AT_LINE(line) 
  #define COMMA_SOURCE_FILE_AT_LINE(line) 
#endif

//---------------------------------------------------------------------------*
//                                                                           *
//                          Function 'projectName'                           *
//                                                                           *
//---------------------------------------------------------------------------*

GALGAS_string function_projectName (C_Compiler * inCompiler
                                    COMMA_UNUSED_LOCATION_ARGS) {
  GALGAS_string result_string ; // Returned variable
  //-------- @assignmentInstructionForGeneration
  result_string = GALGAS_string::constructor_stringWithSourceFilePath (inCompiler COMMA_SOURCE_FILE_AT_LINE (8)).reader_stringByDeletingPathExtension (SOURCE_FILE_AT_LINE (8)) ;
  //-------- @ifInstructionForGeneration
  const enumGalgasBool test_0 = GALGAS_bool (kIsNotEqual, GALGAS_string (gOption_goil_5F_options_project_5F_dir.reader_value ()).objectCompare (GALGAS_string::makeEmptyString ())).boolEnum () ;
  if (kBoolTrue == test_0) {
    //-------- @assignmentInstructionForGeneration
    result_string = GALGAS_string (gOption_goil_5F_options_project_5F_dir.reader_value ()) ;
  }
//---
  return result_string ;
}


//---------------------------------------------------------------------------*
//  Function introspection                                                   *
//---------------------------------------------------------------------------*

static const C_galgas_type_descriptor * functionArgs_projectName [1] = {
  NULL
} ;

//---------------------------------------------------------------------------*

static GALGAS_object functionWithGenericHeader_projectName (C_Compiler * inCompiler,
                                                            const cObjectArray & /* inEffectiveParameterArray */,
                                                            const GALGAS_location & /* inErrorLocation */
                                                            COMMA_LOCATION_ARGS) {
  return function_projectName (inCompiler COMMA_THERE).reader_object (THERE) ;
}

//---------------------------------------------------------------------------*

C_galgas_function_descriptor functionDescriptor_projectName ("projectName",
                                                             functionWithGenericHeader_projectName,
                                                             & kTypeDescriptor_GALGAS_string,
                                                             0,
                                                             functionArgs_projectName) ;

//---------------------------------------------------------------------------*
//                                                                           *
//                            Function 'oil_dir'                             *
//                                                                           *
//---------------------------------------------------------------------------*

GALGAS_string function_oil_5F_dir (C_Compiler * inCompiler
                                   COMMA_UNUSED_LOCATION_ARGS) {
  GALGAS_string result_string ; // Returned variable
  //-------- @assignmentInstructionForGeneration
  result_string = GALGAS_string::constructor_stringWithSourceFilePath (inCompiler COMMA_SOURCE_FILE_AT_LINE (15)).reader_stringByDeletingLastPathComponent (SOURCE_FILE_AT_LINE (15)) ;
//---
  return result_string ;
}


//---------------------------------------------------------------------------*
//  Function introspection                                                   *
//---------------------------------------------------------------------------*

static const C_galgas_type_descriptor * functionArgs_oil_5F_dir [1] = {
  NULL
} ;

//---------------------------------------------------------------------------*

static GALGAS_object functionWithGenericHeader_oil_5F_dir (C_Compiler * inCompiler,
                                                           const cObjectArray & /* inEffectiveParameterArray */,
                                                           const GALGAS_location & /* inErrorLocation */
                                                           COMMA_LOCATION_ARGS) {
  return function_oil_5F_dir (inCompiler COMMA_THERE).reader_object (THERE) ;
}

//---------------------------------------------------------------------------*

C_galgas_function_descriptor functionDescriptor_oil_5F_dir ("oil_dir",
                                                            functionWithGenericHeader_oil_5F_dir,
                                                            & kTypeDescriptor_GALGAS_string,
                                                            0,
                                                            functionArgs_oil_5F_dir) ;

//---------------------------------------------------------------------------*
//                                                                           *
//                              Function 'arch'                              *
//                                                                           *
//---------------------------------------------------------------------------*

GALGAS_string function_arch (C_Compiler * inCompiler
                             COMMA_UNUSED_LOCATION_ARGS) {
  GALGAS_string result_string ; // Returned variable
  //-------- @localVariableOrConstantDeclarationWithSourceExpressionForGeneration
  GALGAS_stringlist var_components = GALGAS_string (gOption_goil_5F_options_target_5F_platform.reader_value ()).reader_componentsSeparatedByString (GALGAS_string ("/") COMMA_SOURCE_FILE_AT_LINE (23)) ;
  //-------- @methodCallInstructionForGeneration
  var_components.method_first (result_string, inCompiler COMMA_SOURCE_FILE_AT_LINE (24)) ;
  //-------- END @methodCallInstructionForGeneration
//---
  return result_string ;
}


//---------------------------------------------------------------------------*
//  Function introspection                                                   *
//---------------------------------------------------------------------------*

static const C_galgas_type_descriptor * functionArgs_arch [1] = {
  NULL
} ;

//---------------------------------------------------------------------------*

static GALGAS_object functionWithGenericHeader_arch (C_Compiler * inCompiler,
                                                     const cObjectArray & /* inEffectiveParameterArray */,
                                                     const GALGAS_location & /* inErrorLocation */
                                                     COMMA_LOCATION_ARGS) {
  return function_arch (inCompiler COMMA_THERE).reader_object (THERE) ;
}

//---------------------------------------------------------------------------*

C_galgas_function_descriptor functionDescriptor_arch ("arch",
                                                      functionWithGenericHeader_arch,
                                                      & kTypeDescriptor_GALGAS_string,
                                                      0,
                                                      functionArgs_arch) ;

//---------------------------------------------------------------------------*
//                                                                           *
//                              Function 'chip'                              *
//                                                                           *
//---------------------------------------------------------------------------*

GALGAS_string function_chip (C_Compiler * inCompiler
                             COMMA_UNUSED_LOCATION_ARGS) {
  GALGAS_string result_string ; // Returned variable
  //-------- @localVariableOrConstantDeclarationWithSourceExpressionForGeneration
  GALGAS_stringlist var_components = GALGAS_string (gOption_goil_5F_options_target_5F_platform.reader_value ()).reader_componentsSeparatedByString (GALGAS_string ("/") COMMA_SOURCE_FILE_AT_LINE (32)) ;
  //-------- @ifInstructionForGeneration
  const enumGalgasBool test_0 = GALGAS_bool (kIsStrictSup, var_components.reader_length (SOURCE_FILE_AT_LINE (33)).objectCompare (GALGAS_uint ((PMUInt32) 1U))).boolEnum () ;
  if (kBoolTrue == test_0) {
    //-------- @assignmentInstructionForGeneration
    result_string = var_components.reader_mValueAtIndex (GALGAS_uint ((PMUInt32) 1U), inCompiler COMMA_SOURCE_FILE_AT_LINE (34)) ;
  }else if (kBoolFalse == test_0) {
    //-------- @assignmentInstructionForGeneration
    result_string = GALGAS_string::makeEmptyString () ;
  }
//---
  return result_string ;
}


//---------------------------------------------------------------------------*
//  Function introspection                                                   *
//---------------------------------------------------------------------------*

static const C_galgas_type_descriptor * functionArgs_chip [1] = {
  NULL
} ;

//---------------------------------------------------------------------------*

static GALGAS_object functionWithGenericHeader_chip (C_Compiler * inCompiler,
                                                     const cObjectArray & /* inEffectiveParameterArray */,
                                                     const GALGAS_location & /* inErrorLocation */
                                                     COMMA_LOCATION_ARGS) {
  return function_chip (inCompiler COMMA_THERE).reader_object (THERE) ;
}

//---------------------------------------------------------------------------*

C_galgas_function_descriptor functionDescriptor_chip ("chip",
                                                      functionWithGenericHeader_chip,
                                                      & kTypeDescriptor_GALGAS_string,
                                                      0,
                                                      functionArgs_chip) ;

//---------------------------------------------------------------------------*
//                                                                           *
//                             Function 'board'                              *
//                                                                           *
//---------------------------------------------------------------------------*

GALGAS_string function_board (C_Compiler * inCompiler
                              COMMA_UNUSED_LOCATION_ARGS) {
  GALGAS_string result_string ; // Returned variable
  //-------- @localVariableOrConstantDeclarationWithSourceExpressionForGeneration
  GALGAS_stringlist var_components = GALGAS_string (gOption_goil_5F_options_target_5F_platform.reader_value ()).reader_componentsSeparatedByString (GALGAS_string ("/") COMMA_SOURCE_FILE_AT_LINE (44)) ;
  //-------- @ifInstructionForGeneration
  const enumGalgasBool test_0 = GALGAS_bool (kIsStrictSup, var_components.reader_length (SOURCE_FILE_AT_LINE (45)).objectCompare (GALGAS_uint ((PMUInt32) 2U))).boolEnum () ;
  if (kBoolTrue == test_0) {
    //-------- @assignmentInstructionForGeneration
    result_string = var_components.reader_mValueAtIndex (GALGAS_uint ((PMUInt32) 2U), inCompiler COMMA_SOURCE_FILE_AT_LINE (46)) ;
  }else if (kBoolFalse == test_0) {
    //-------- @assignmentInstructionForGeneration
    result_string = GALGAS_string::makeEmptyString () ;
  }
//---
  return result_string ;
}


//---------------------------------------------------------------------------*
//  Function introspection                                                   *
//---------------------------------------------------------------------------*

static const C_galgas_type_descriptor * functionArgs_board [1] = {
  NULL
} ;

//---------------------------------------------------------------------------*

static GALGAS_object functionWithGenericHeader_board (C_Compiler * inCompiler,
                                                      const cObjectArray & /* inEffectiveParameterArray */,
                                                      const GALGAS_location & /* inErrorLocation */
                                                      COMMA_LOCATION_ARGS) {
  return function_board (inCompiler COMMA_THERE).reader_object (THERE) ;
}

//---------------------------------------------------------------------------*

C_galgas_function_descriptor functionDescriptor_board ("board",
                                                       functionWithGenericHeader_board,
                                                       & kTypeDescriptor_GALGAS_string,
                                                       0,
                                                       functionArgs_board) ;

//---------------------------------------------------------------------------*
//                                                                           *
//                       Function 'add_path_component'                       *
//                                                                           *
//---------------------------------------------------------------------------*

GALGAS_string function_add_5F_path_5F_component (GALGAS_string inArgument_path,
                                                 GALGAS_string inArgument_component,
                                                 C_Compiler * inCompiler
                                                 COMMA_UNUSED_LOCATION_ARGS) {
  GALGAS_string result_string ; // Returned variable
  //-------- @ifInstructionForGeneration
  const enumGalgasBool test_0 = GALGAS_bool (kIsNotEqual, inArgument_path.reader_characterAtIndex (inArgument_path.reader_length (SOURCE_FILE_AT_LINE (60)).substract_operation (GALGAS_uint ((PMUInt32) 1U), inCompiler COMMA_SOURCE_FILE_AT_LINE (60)), inCompiler COMMA_SOURCE_FILE_AT_LINE (60)).objectCompare (GALGAS_char (TO_UNICODE (47)))).boolEnum () ;
  if (kBoolTrue == test_0) {
    //-------- @assignmentInstructionForGeneration
    result_string = inArgument_path.operator_concat (GALGAS_string ("/") COMMA_SOURCE_FILE_AT_LINE (61)).operator_concat (inArgument_component COMMA_SOURCE_FILE_AT_LINE (61)) ;
  }else if (kBoolFalse == test_0) {
    //-------- @assignmentInstructionForGeneration
    result_string = inArgument_path.operator_concat (inArgument_component COMMA_SOURCE_FILE_AT_LINE (63)) ;
  }
//---
  return result_string ;
}


//---------------------------------------------------------------------------*
//  Function introspection                                                   *
//---------------------------------------------------------------------------*

static const C_galgas_type_descriptor * functionArgs_add_5F_path_5F_component [3] = {
  & kTypeDescriptor_GALGAS_string,
  & kTypeDescriptor_GALGAS_string,
  NULL
} ;

//---------------------------------------------------------------------------*

static GALGAS_object functionWithGenericHeader_add_5F_path_5F_component (C_Compiler * inCompiler,
                                                                         const cObjectArray & inEffectiveParameterArray,
                                                                         const GALGAS_location & inErrorLocation
                                                                         COMMA_LOCATION_ARGS) {
  const GALGAS_string operand0 = GALGAS_string::extractObject (inEffectiveParameterArray.objectAtIndex (0 COMMA_HERE), inCompiler, inErrorLocation COMMA_THERE) ;
  const GALGAS_string operand1 = GALGAS_string::extractObject (inEffectiveParameterArray.objectAtIndex (1 COMMA_HERE), inCompiler, inErrorLocation COMMA_THERE) ;
  return function_add_5F_path_5F_component (operand0, operand1, inCompiler COMMA_THERE).reader_object (THERE) ;
}

//---------------------------------------------------------------------------*

C_galgas_function_descriptor functionDescriptor_add_5F_path_5F_component ("add_path_component",
                                                                          functionWithGenericHeader_add_5F_path_5F_component,
                                                                          & kTypeDescriptor_GALGAS_string,
                                                                          2,
                                                                          functionArgs_add_5F_path_5F_component) ;

//---------------------------------------------------------------------------*
//                                                                           *
//                     Function 'rootTemplatesDirectory'                     *
//                                                                           *
//---------------------------------------------------------------------------*

GALGAS_string function_rootTemplatesDirectory (C_Compiler * inCompiler
                                               COMMA_UNUSED_LOCATION_ARGS) {
  GALGAS_string result_string ; // Returned variable
  //-------- @ifInstructionForGeneration
  const enumGalgasBool test_0 = GALGAS_bool (kIsNotEqual, GALGAS_string (gOption_goil_5F_options_template_5F_dir.reader_value ()).objectCompare (GALGAS_string::makeEmptyString ())).boolEnum () ;
  if (kBoolTrue == test_0) {
    //-------- @assignmentInstructionForGeneration
    result_string = GALGAS_string (gOption_goil_5F_options_template_5F_dir.reader_value ()) ;
  }else if (kBoolFalse == test_0) {
    //-------- @assignmentInstructionForGeneration
    result_string = GALGAS_string::constructor_stringWithEnvironmentVariableOrEmpty (GALGAS_string ("GOIL_TEMPLATES") COMMA_SOURCE_FILE_AT_LINE (73)) ;
  }
  //-------- @assignmentInstructionForGeneration
  result_string = result_string.reader_unixPathWithNativePath (SOURCE_FILE_AT_LINE (75)) ;
  //-------- @assignmentInstructionForGeneration
  result_string = result_string.reader_stringByStandardizingPath (SOURCE_FILE_AT_LINE (76)) ;
  //-------- @ifInstructionForGeneration
  const enumGalgasBool test_1 = GALGAS_bool (kIsNotEqual, result_string.reader_characterAtIndex (GALGAS_uint ((PMUInt32) 0U), inCompiler COMMA_SOURCE_FILE_AT_LINE (77)).objectCompare (GALGAS_char (TO_UNICODE (47)))).boolEnum () ;
  if (kBoolTrue == test_1) {
    //-------- @localVariableOrConstantDeclarationWithSourceExpressionForGeneration
    GALGAS_string var_currentDirectory = GALGAS_string::constructor_stringWithCurrentDirectory (SOURCE_FILE_AT_LINE (78)) ;
    //-------- @assignmentInstructionForGeneration
    result_string = var_currentDirectory.operator_concat (GALGAS_string ("/") COMMA_SOURCE_FILE_AT_LINE (79)).operator_concat (result_string COMMA_SOURCE_FILE_AT_LINE (79)) ;
    //-------- @assignmentInstructionForGeneration
    result_string = result_string.reader_stringByStandardizingPath (SOURCE_FILE_AT_LINE (80)) ;
  }
//---
  return result_string ;
}


//---------------------------------------------------------------------------*
//  Function introspection                                                   *
//---------------------------------------------------------------------------*

static const C_galgas_type_descriptor * functionArgs_rootTemplatesDirectory [1] = {
  NULL
} ;

//---------------------------------------------------------------------------*

static GALGAS_object functionWithGenericHeader_rootTemplatesDirectory (C_Compiler * inCompiler,
                                                                       const cObjectArray & /* inEffectiveParameterArray */,
                                                                       const GALGAS_location & /* inErrorLocation */
                                                                       COMMA_LOCATION_ARGS) {
  return function_rootTemplatesDirectory (inCompiler COMMA_THERE).reader_object (THERE) ;
}

//---------------------------------------------------------------------------*

C_galgas_function_descriptor functionDescriptor_rootTemplatesDirectory ("rootTemplatesDirectory",
                                                                        functionWithGenericHeader_rootTemplatesDirectory,
                                                                        & kTypeDescriptor_GALGAS_string,
                                                                        0,
                                                                        functionArgs_rootTemplatesDirectory) ;

//---------------------------------------------------------------------------*
//                                                                           *
//                      Function 'templates_directory'                       *
//                                                                           *
//---------------------------------------------------------------------------*

GALGAS_string function_templates_5F_directory (GALGAS_string inArgument_prefix,
                                               C_Compiler * inCompiler
                                               COMMA_UNUSED_LOCATION_ARGS) {
  GALGAS_string result_string ; // Returned variable
  //-------- @assignmentInstructionForGeneration
  result_string = function_rootTemplatesDirectory (inCompiler COMMA_SOURCE_FILE_AT_LINE (85)) ;
  //-------- @ifInstructionForGeneration
  const enumGalgasBool test_0 = GALGAS_bool (kIsNotEqual, result_string.objectCompare (GALGAS_string::makeEmptyString ())).boolEnum () ;
  if (kBoolTrue == test_0) {
    //-------- @assignmentInstructionForGeneration
    result_string = function_add_5F_path_5F_component (result_string, inArgument_prefix, inCompiler COMMA_SOURCE_FILE_AT_LINE (87)) ;
    //-------- @ifInstructionForGeneration
    const enumGalgasBool test_1 = GALGAS_bool (kIsNotEqual, result_string.reader_characterAtIndex (GALGAS_uint ((PMUInt32) 0U), inCompiler COMMA_SOURCE_FILE_AT_LINE (89)).objectCompare (GALGAS_char (TO_UNICODE (47)))).boolEnum () ;
    if (kBoolTrue == test_1) {
      //-------- @localVariableOrConstantDeclarationWithSourceExpressionForGeneration
      GALGAS_string var_curdir = GALGAS_string::constructor_stringWithCurrentDirectory (SOURCE_FILE_AT_LINE (90)) ;
      //-------- @ifInstructionForGeneration
      const enumGalgasBool test_2 = GALGAS_bool (kIsEqual, result_string.reader_characterAtIndex (GALGAS_uint ((PMUInt32) 0U), inCompiler COMMA_SOURCE_FILE_AT_LINE (91)).objectCompare (GALGAS_char (TO_UNICODE (46)))).operator_and (GALGAS_bool (kIsEqual, result_string.reader_characterAtIndex (GALGAS_uint ((PMUInt32) 1U), inCompiler COMMA_SOURCE_FILE_AT_LINE (91)).objectCompare (GALGAS_char (TO_UNICODE (47)))) COMMA_SOURCE_FILE_AT_LINE (91)).boolEnum () ;
      if (kBoolTrue == test_2) {
        //-------- @assignmentInstructionForGeneration
        result_string = result_string.reader_stringByRemovingCharacterAtIndex (GALGAS_uint ((PMUInt32) 0U), inCompiler COMMA_SOURCE_FILE_AT_LINE (92)).reader_stringByRemovingCharacterAtIndex (GALGAS_uint ((PMUInt32) 0U), inCompiler COMMA_SOURCE_FILE_AT_LINE (92)) ;
      }
      //-------- @assignmentInstructionForGeneration
      result_string = var_curdir.operator_concat (GALGAS_string ("/") COMMA_SOURCE_FILE_AT_LINE (94)).operator_concat (result_string COMMA_SOURCE_FILE_AT_LINE (94)) ;
    }
    //-------- @ifInstructionForGeneration
    const enumGalgasBool test_3 = GALGAS_bool (kIsNotEqual, result_string.reader_characterAtIndex (result_string.reader_length (SOURCE_FILE_AT_LINE (96)).substract_operation (GALGAS_uint ((PMUInt32) 1U), inCompiler COMMA_SOURCE_FILE_AT_LINE (96)), inCompiler COMMA_SOURCE_FILE_AT_LINE (96)).objectCompare (GALGAS_char (TO_UNICODE (47)))).boolEnum () ;
    if (kBoolTrue == test_3) {
      //-------- @appendInstructionForGeneration
      result_string.dotAssign_operation (GALGAS_string ("/") COMMA_SOURCE_FILE_AT_LINE (97)) ;
    }
  }
//---
  return result_string ;
}


//---------------------------------------------------------------------------*
//  Function introspection                                                   *
//---------------------------------------------------------------------------*

static const C_galgas_type_descriptor * functionArgs_templates_5F_directory [2] = {
  & kTypeDescriptor_GALGAS_string,
  NULL
} ;

//---------------------------------------------------------------------------*

static GALGAS_object functionWithGenericHeader_templates_5F_directory (C_Compiler * inCompiler,
                                                                       const cObjectArray & inEffectiveParameterArray,
                                                                       const GALGAS_location & inErrorLocation
                                                                       COMMA_LOCATION_ARGS) {
  const GALGAS_string operand0 = GALGAS_string::extractObject (inEffectiveParameterArray.objectAtIndex (0 COMMA_HERE), inCompiler, inErrorLocation COMMA_THERE) ;
  return function_templates_5F_directory (operand0, inCompiler COMMA_THERE).reader_object (THERE) ;
}

//---------------------------------------------------------------------------*

C_galgas_function_descriptor functionDescriptor_templates_5F_directory ("templates_directory",
                                                                        functionWithGenericHeader_templates_5F_directory,
                                                                        & kTypeDescriptor_GALGAS_string,
                                                                        1,
                                                                        functionArgs_templates_5F_directory) ;

//---------------------------------------------------------------------------*
//                                                                           *
//                    Function 'template_string_if_exist'                    *
//                                                                           *
//---------------------------------------------------------------------------*

GALGAS_string function_template_5F_string_5F_if_5F_exist (GALGAS_string inArgument_prefix,
                                                          GALGAS_string inArgument_obj,
                                                          C_Compiler * inCompiler
                                                          COMMA_UNUSED_LOCATION_ARGS) {
  GALGAS_string result_string ; // Returned variable
  //-------- @localVariableOrConstantDeclarationWithSourceExpressionForGeneration
  GALGAS_string var_targ_5F_tpl = GALGAS_string::makeEmptyString () ;
  //-------- @localVariableDeclarationForGeneration
  GALGAS_string var_temp_5F_dir ;
  //-------- @assignmentInstructionForGeneration
  var_temp_5F_dir = function_templates_5F_directory (inArgument_prefix, inCompiler COMMA_SOURCE_FILE_AT_LINE (114)) ;
  //-------- @localVariableOrConstantDeclarationWithSourceExpressionForGeneration
  GALGAS_string var_temp_5F_name = inArgument_obj.operator_concat (GALGAS_string (".tpl") COMMA_SOURCE_FILE_AT_LINE (117)) ;
  //-------- @assignmentInstructionForGeneration
  var_targ_5F_tpl = var_temp_5F_dir.operator_concat (function_arch (inCompiler COMMA_SOURCE_FILE_AT_LINE (119)) COMMA_SOURCE_FILE_AT_LINE (119)).operator_concat (GALGAS_string ("/") COMMA_SOURCE_FILE_AT_LINE (119)).operator_concat (function_chip (inCompiler COMMA_SOURCE_FILE_AT_LINE (119)) COMMA_SOURCE_FILE_AT_LINE (119)).operator_concat (GALGAS_string ("/") COMMA_SOURCE_FILE_AT_LINE (119)).operator_concat (function_board (inCompiler COMMA_SOURCE_FILE_AT_LINE (119)) COMMA_SOURCE_FILE_AT_LINE (119)).operator_concat (GALGAS_string ("/") COMMA_SOURCE_FILE_AT_LINE (119)).operator_concat (var_temp_5F_name COMMA_SOURCE_FILE_AT_LINE (119)) ;
  //-------- @ifInstructionForGeneration
  const enumGalgasBool test_0 = var_targ_5F_tpl.reader_fileExists (SOURCE_FILE_AT_LINE (120)).boolEnum () ;
  if (kBoolTrue == test_0) {
    //-------- @assignmentInstructionForGeneration
    result_string = GALGAS_string::constructor_stringWithContentsOfFile (var_targ_5F_tpl, inCompiler COMMA_SOURCE_FILE_AT_LINE (121)) ;
  }else if (kBoolFalse == test_0) {
    //-------- @assignmentInstructionForGeneration
    var_targ_5F_tpl = var_temp_5F_dir.operator_concat (function_arch (inCompiler COMMA_SOURCE_FILE_AT_LINE (123)) COMMA_SOURCE_FILE_AT_LINE (123)).operator_concat (GALGAS_string ("/") COMMA_SOURCE_FILE_AT_LINE (123)).operator_concat (function_chip (inCompiler COMMA_SOURCE_FILE_AT_LINE (123)) COMMA_SOURCE_FILE_AT_LINE (123)).operator_concat (GALGAS_string ("/") COMMA_SOURCE_FILE_AT_LINE (123)).operator_concat (var_temp_5F_name COMMA_SOURCE_FILE_AT_LINE (123)) ;
    //-------- @ifInstructionForGeneration
    const enumGalgasBool test_1 = var_targ_5F_tpl.reader_fileExists (SOURCE_FILE_AT_LINE (124)).boolEnum () ;
    if (kBoolTrue == test_1) {
      //-------- @assignmentInstructionForGeneration
      result_string = GALGAS_string::constructor_stringWithContentsOfFile (var_targ_5F_tpl, inCompiler COMMA_SOURCE_FILE_AT_LINE (125)) ;
    }else if (kBoolFalse == test_1) {
      //-------- @assignmentInstructionForGeneration
      var_targ_5F_tpl = var_temp_5F_dir.operator_concat (function_arch (inCompiler COMMA_SOURCE_FILE_AT_LINE (127)) COMMA_SOURCE_FILE_AT_LINE (127)).operator_concat (GALGAS_string ("/") COMMA_SOURCE_FILE_AT_LINE (127)).operator_concat (var_temp_5F_name COMMA_SOURCE_FILE_AT_LINE (127)) ;
      //-------- @ifInstructionForGeneration
      const enumGalgasBool test_2 = var_targ_5F_tpl.reader_fileExists (SOURCE_FILE_AT_LINE (128)).boolEnum () ;
      if (kBoolTrue == test_2) {
        //-------- @assignmentInstructionForGeneration
        result_string = GALGAS_string::constructor_stringWithContentsOfFile (var_targ_5F_tpl, inCompiler COMMA_SOURCE_FILE_AT_LINE (129)) ;
      }else if (kBoolFalse == test_2) {
        //-------- @assignmentInstructionForGeneration
        var_targ_5F_tpl = var_temp_5F_dir.operator_concat (GALGAS_string ("all_targets/") COMMA_SOURCE_FILE_AT_LINE (132)).operator_concat (var_temp_5F_name COMMA_SOURCE_FILE_AT_LINE (132)) ;
        //-------- @ifInstructionForGeneration
        const enumGalgasBool test_3 = var_targ_5F_tpl.reader_fileExists (SOURCE_FILE_AT_LINE (133)).boolEnum () ;
        if (kBoolTrue == test_3) {
          //-------- @assignmentInstructionForGeneration
          result_string = GALGAS_string::constructor_stringWithContentsOfFile (var_targ_5F_tpl, inCompiler COMMA_SOURCE_FILE_AT_LINE (134)) ;
        }else if (kBoolFalse == test_3) {
          //-------- @assignmentInstructionForGeneration
          var_targ_5F_tpl = var_temp_5F_dir.operator_concat (var_temp_5F_name COMMA_SOURCE_FILE_AT_LINE (136)) ;
          //-------- @ifInstructionForGeneration
          const enumGalgasBool test_4 = var_targ_5F_tpl.reader_fileExists (SOURCE_FILE_AT_LINE (137)).boolEnum () ;
          if (kBoolTrue == test_4) {
            //-------- @assignmentInstructionForGeneration
            result_string = GALGAS_string::constructor_stringWithContentsOfFile (var_targ_5F_tpl, inCompiler COMMA_SOURCE_FILE_AT_LINE (138)) ;
          }else if (kBoolFalse == test_4) {
            //-------- @assignmentInstructionForGeneration
            result_string = GALGAS_string::makeEmptyString () ;
          }
        }
      }
    }
  }
//---
  return result_string ;
}


//---------------------------------------------------------------------------*
//  Function introspection                                                   *
//---------------------------------------------------------------------------*

static const C_galgas_type_descriptor * functionArgs_template_5F_string_5F_if_5F_exist [3] = {
  & kTypeDescriptor_GALGAS_string,
  & kTypeDescriptor_GALGAS_string,
  NULL
} ;

//---------------------------------------------------------------------------*

static GALGAS_object functionWithGenericHeader_template_5F_string_5F_if_5F_exist (C_Compiler * inCompiler,
                                                                                  const cObjectArray & inEffectiveParameterArray,
                                                                                  const GALGAS_location & inErrorLocation
                                                                                  COMMA_LOCATION_ARGS) {
  const GALGAS_string operand0 = GALGAS_string::extractObject (inEffectiveParameterArray.objectAtIndex (0 COMMA_HERE), inCompiler, inErrorLocation COMMA_THERE) ;
  const GALGAS_string operand1 = GALGAS_string::extractObject (inEffectiveParameterArray.objectAtIndex (1 COMMA_HERE), inCompiler, inErrorLocation COMMA_THERE) ;
  return function_template_5F_string_5F_if_5F_exist (operand0, operand1, inCompiler COMMA_THERE).reader_object (THERE) ;
}

//---------------------------------------------------------------------------*

C_galgas_function_descriptor functionDescriptor_template_5F_string_5F_if_5F_exist ("template_string_if_exist",
                                                                                   functionWithGenericHeader_template_5F_string_5F_if_5F_exist,
                                                                                   & kTypeDescriptor_GALGAS_string,
                                                                                   2,
                                                                                   functionArgs_template_5F_string_5F_if_5F_exist) ;

//---------------------------------------------------------------------------*
//                                                                           *
//                        Function 'template_string'                         *
//                                                                           *
//---------------------------------------------------------------------------*

GALGAS_string function_template_5F_string (GALGAS_string inArgument_prefix,
                                           GALGAS_string inArgument_obj,
                                           C_Compiler * inCompiler
                                           COMMA_UNUSED_LOCATION_ARGS) {
  GALGAS_string result_string ; // Returned variable
  //-------- @assignmentInstructionForGeneration
  result_string = function_template_5F_string_5F_if_5F_exist (inArgument_prefix, inArgument_obj, inCompiler COMMA_SOURCE_FILE_AT_LINE (152)) ;
  //-------- @ifInstructionForGeneration
  const enumGalgasBool test_0 = GALGAS_bool (kIsEqual, result_string.objectCompare (GALGAS_string::makeEmptyString ())).boolEnum () ;
  if (kBoolTrue == test_0) {
    //-------- @localVariableOrConstantDeclarationWithSourceExpressionForGeneration
    GALGAS_string var_target_5F_platform = function_arch (inCompiler COMMA_SOURCE_FILE_AT_LINE (154)) ;
    //-------- @localVariableDeclarationForGeneration
    GALGAS_string var_temp_5F_dir ;
    //-------- @assignmentInstructionForGeneration
    var_temp_5F_dir = function_templates_5F_directory (inArgument_prefix, inCompiler COMMA_SOURCE_FILE_AT_LINE (156)) ;
    //-------- @errorInstructionForGeneration
    inCompiler->emitSemanticError (inCompiler->here (), GALGAS_string ("No template found for ").operator_concat (inArgument_obj COMMA_SOURCE_FILE_AT_LINE (157)).operator_concat (GALGAS_string (" (searched in ") COMMA_SOURCE_FILE_AT_LINE (157)).operator_concat (var_temp_5F_dir COMMA_SOURCE_FILE_AT_LINE (157)).operator_concat (var_target_5F_platform COMMA_SOURCE_FILE_AT_LINE (157)).operator_concat (GALGAS_string (" and in ") COMMA_SOURCE_FILE_AT_LINE (158)).operator_concat (var_temp_5F_dir COMMA_SOURCE_FILE_AT_LINE (158)).operator_concat (GALGAS_string ("all_targets)") COMMA_SOURCE_FILE_AT_LINE (158)) COMMA_SOURCE_FILE_AT_LINE (157)) ;
  }
//---
  return result_string ;
}


//---------------------------------------------------------------------------*
//  Function introspection                                                   *
//---------------------------------------------------------------------------*

static const C_galgas_type_descriptor * functionArgs_template_5F_string [3] = {
  & kTypeDescriptor_GALGAS_string,
  & kTypeDescriptor_GALGAS_string,
  NULL
} ;

//---------------------------------------------------------------------------*

static GALGAS_object functionWithGenericHeader_template_5F_string (C_Compiler * inCompiler,
                                                                   const cObjectArray & inEffectiveParameterArray,
                                                                   const GALGAS_location & inErrorLocation
                                                                   COMMA_LOCATION_ARGS) {
  const GALGAS_string operand0 = GALGAS_string::extractObject (inEffectiveParameterArray.objectAtIndex (0 COMMA_HERE), inCompiler, inErrorLocation COMMA_THERE) ;
  const GALGAS_string operand1 = GALGAS_string::extractObject (inEffectiveParameterArray.objectAtIndex (1 COMMA_HERE), inCompiler, inErrorLocation COMMA_THERE) ;
  return function_template_5F_string (operand0, operand1, inCompiler COMMA_THERE).reader_object (THERE) ;
}

//---------------------------------------------------------------------------*

C_galgas_function_descriptor functionDescriptor_template_5F_string ("template_string",
                                                                    functionWithGenericHeader_template_5F_string,
                                                                    & kTypeDescriptor_GALGAS_string,
                                                                    2,
                                                                    functionArgs_template_5F_string) ;

//---------------------------------------------------------------------------*
//                                                                           *
//                        Function 'templateFilePath'                        *
//                                                                           *
//---------------------------------------------------------------------------*

GALGAS_string function_templateFilePath (const GALGAS_string & constinArgument_prefix,
                                         const GALGAS_string & constinArgument_file,
                                         C_Compiler * inCompiler
                                         COMMA_UNUSED_LOCATION_ARGS) {
  GALGAS_string result_string ; // Returned variable
  //-------- @localVariableOrConstantDeclarationWithSourceExpressionForGeneration
  GALGAS_stringlist var_components = GALGAS_string (gOption_goil_5F_options_target_5F_platform.reader_value ()).reader_componentsSeparatedByString (GALGAS_string ("/") COMMA_SOURCE_FILE_AT_LINE (167)) ;
  //-------- @localVariableOrConstantDeclarationWithSourceExpressionForGeneration
  GALGAS_string var_templateDir = function_templates_5F_directory (constinArgument_prefix, inCompiler COMMA_SOURCE_FILE_AT_LINE (168)) ;
  //-------- @localVariableOrConstantDeclarationWithSourceExpressionForGeneration
  GALGAS_bool var_notFound = GALGAS_bool (true) ;
  //-------- @localVariableOrConstantDeclarationWithSourceExpressionForGeneration
  GALGAS_bool var_notOver = GALGAS_bool (true) ;
  //-------- @assignmentInstructionForGeneration
  result_string = GALGAS_string::makeEmptyString () ;
  //-------- @loopInstructionForGeneration
  if (var_components.reader_length (SOURCE_FILE_AT_LINE (173)).add_operation (GALGAS_uint ((PMUInt32) 1U), inCompiler COMMA_SOURCE_FILE_AT_LINE (173)).isValid ()) {
    PMUInt32 variant_5590 = var_components.reader_length (SOURCE_FILE_AT_LINE (173)).add_operation (GALGAS_uint ((PMUInt32) 1U), inCompiler COMMA_SOURCE_FILE_AT_LINE (173)).uintValue () ;
    bool loop_5590 = true ;
    while (loop_5590) {
      loop_5590 = var_notFound.operator_and (var_notOver COMMA_SOURCE_FILE_AT_LINE (174)).isValid () ;
      if (loop_5590) {
        loop_5590 = var_notFound.operator_and (var_notOver COMMA_SOURCE_FILE_AT_LINE (174)).boolValue () ;
      }
      if (loop_5590 && (0 == variant_5590)) {
        loop_5590 = false ;
        inCompiler->loopRunTimeVariantError (SOURCE_FILE_AT_LINE (173)) ;
      }
      if (loop_5590) {
        variant_5590 -- ;
        //-------- @localVariableOrConstantDeclarationWithSourceExpressionForGeneration
        GALGAS_string var_intermediatePath = GALGAS_string::constructor_componentsJoinedByString (var_components, GALGAS_string ("/") COMMA_SOURCE_FILE_AT_LINE (175)) ;
        //-------- @ifInstructionForGeneration
        const enumGalgasBool test_0 = GALGAS_bool (kIsNotEqual, var_intermediatePath.objectCompare (GALGAS_string::makeEmptyString ())).boolEnum () ;
        if (kBoolTrue == test_0) {
          //-------- @appendInstructionForGeneration
          var_intermediatePath.dotAssign_operation (GALGAS_string ("/") COMMA_SOURCE_FILE_AT_LINE (176)) ;
        }
        //-------- @localVariableOrConstantDeclarationWithSourceExpressionForGeneration
        GALGAS_string var_targetPath = var_templateDir.operator_concat (var_intermediatePath COMMA_SOURCE_FILE_AT_LINE (177)).operator_concat (constinArgument_file COMMA_SOURCE_FILE_AT_LINE (177)) ;
        //-------- @ifInstructionForGeneration
        const enumGalgasBool test_1 = var_targetPath.reader_fileExists (SOURCE_FILE_AT_LINE (179)).boolEnum () ;
        if (kBoolTrue == test_1) {
          //-------- @assignmentInstructionForGeneration
          var_notFound = GALGAS_bool (false) ;
          //-------- @assignmentInstructionForGeneration
          result_string = var_targetPath ;
        }
        //-------- @ifInstructionForGeneration
        const enumGalgasBool test_2 = GALGAS_bool (kIsStrictSup, var_components.reader_length (SOURCE_FILE_AT_LINE (183)).objectCompare (GALGAS_uint ((PMUInt32) 0U))).boolEnum () ;
        if (kBoolTrue == test_2) {
          { //-------- @modifierCallInstructionForGeneration
          GALGAS_string joker_6063_0 ; // Joker input parameter
          var_components.modifier_popLast (joker_6063_0, inCompiler COMMA_SOURCE_FILE_AT_LINE (184)) ;
          } //-------- END @typeMethodInstructionForGeneration
        }else if (kBoolFalse == test_2) {
          //-------- @assignmentInstructionForGeneration
          var_notOver = GALGAS_bool (false) ;
        }
      }
    }
  }
//---
  return result_string ;
}


//---------------------------------------------------------------------------*
//  Function introspection                                                   *
//---------------------------------------------------------------------------*

static const C_galgas_type_descriptor * functionArgs_templateFilePath [3] = {
  & kTypeDescriptor_GALGAS_string,
  & kTypeDescriptor_GALGAS_string,
  NULL
} ;

//---------------------------------------------------------------------------*

static GALGAS_object functionWithGenericHeader_templateFilePath (C_Compiler * inCompiler,
                                                                 const cObjectArray & inEffectiveParameterArray,
                                                                 const GALGAS_location & inErrorLocation
                                                                 COMMA_LOCATION_ARGS) {
  const GALGAS_string operand0 = GALGAS_string::extractObject (inEffectiveParameterArray.objectAtIndex (0 COMMA_HERE), inCompiler, inErrorLocation COMMA_THERE) ;
  const GALGAS_string operand1 = GALGAS_string::extractObject (inEffectiveParameterArray.objectAtIndex (1 COMMA_HERE), inCompiler, inErrorLocation COMMA_THERE) ;
  return function_templateFilePath (operand0, operand1, inCompiler COMMA_THERE).reader_object (THERE) ;
}

//---------------------------------------------------------------------------*

C_galgas_function_descriptor functionDescriptor_templateFilePath ("templateFilePath",
                                                                  functionWithGenericHeader_templateFilePath,
                                                                  & kTypeDescriptor_GALGAS_string,
                                                                  2,
                                                                  functionArgs_templateFilePath) ;

//---------------------------------------------------------------------------*
//                                                                           *
//                      Function 'allTemplateFilePaths'                      *
//                                                                           *
//---------------------------------------------------------------------------*

GALGAS_stringlist function_allTemplateFilePaths (const GALGAS_string & constinArgument_prefix,
                                                 const GALGAS_string & constinArgument_file,
                                                 C_Compiler * inCompiler
                                                 COMMA_UNUSED_LOCATION_ARGS) {
  GALGAS_stringlist result_stringlist ; // Returned variable
  //-------- @localVariableOrConstantDeclarationWithSourceExpressionForGeneration
  GALGAS_stringlist var_components = GALGAS_string (gOption_goil_5F_options_target_5F_platform.reader_value ()).reader_componentsSeparatedByString (GALGAS_string ("/") COMMA_SOURCE_FILE_AT_LINE (196)) ;
  //-------- @localVariableOrConstantDeclarationWithSourceExpressionForGeneration
  GALGAS_string var_templateDir = function_templates_5F_directory (constinArgument_prefix, inCompiler COMMA_SOURCE_FILE_AT_LINE (197)) ;
  //-------- @localVariableOrConstantDeclarationWithSourceExpressionForGeneration
  GALGAS_bool var_notOver = GALGAS_bool (true) ;
  //-------- @assignmentInstructionForGeneration
  result_stringlist = GALGAS_stringlist::constructor_emptyList (SOURCE_FILE_AT_LINE (199)) ;
  //-------- @loopInstructionForGeneration
  if (var_components.reader_length (SOURCE_FILE_AT_LINE (201)).add_operation (GALGAS_uint ((PMUInt32) 1U), inCompiler COMMA_SOURCE_FILE_AT_LINE (201)).isValid ()) {
    PMUInt32 variant_6463 = var_components.reader_length (SOURCE_FILE_AT_LINE (201)).add_operation (GALGAS_uint ((PMUInt32) 1U), inCompiler COMMA_SOURCE_FILE_AT_LINE (201)).uintValue () ;
    bool loop_6463 = true ;
    while (loop_6463) {
      loop_6463 = var_notOver.isValid () ;
      if (loop_6463) {
        loop_6463 = var_notOver.boolValue () ;
      }
      if (loop_6463 && (0 == variant_6463)) {
        loop_6463 = false ;
        inCompiler->loopRunTimeVariantError (SOURCE_FILE_AT_LINE (201)) ;
      }
      if (loop_6463) {
        variant_6463 -- ;
        //-------- @localVariableOrConstantDeclarationWithSourceExpressionForGeneration
        GALGAS_string var_intermediatePath = GALGAS_string::constructor_componentsJoinedByString (var_components, GALGAS_string ("/") COMMA_SOURCE_FILE_AT_LINE (203)) ;
        //-------- @ifInstructionForGeneration
        const enumGalgasBool test_0 = GALGAS_bool (kIsNotEqual, var_intermediatePath.objectCompare (GALGAS_string::makeEmptyString ())).boolEnum () ;
        if (kBoolTrue == test_0) {
          //-------- @appendInstructionForGeneration
          var_intermediatePath.dotAssign_operation (GALGAS_string ("/") COMMA_SOURCE_FILE_AT_LINE (204)) ;
        }
        //-------- @localVariableOrConstantDeclarationWithSourceExpressionForGeneration
        GALGAS_string var_targetPath = var_templateDir.operator_concat (var_intermediatePath COMMA_SOURCE_FILE_AT_LINE (205)).operator_concat (constinArgument_file COMMA_SOURCE_FILE_AT_LINE (205)) ;
        //-------- @messageInstructionForGeneration
        inCompiler->printMessage (GALGAS_string ("Checking ").operator_concat (var_targetPath COMMA_SOURCE_FILE_AT_LINE (206)).operator_concat (GALGAS_string ("\n") COMMA_SOURCE_FILE_AT_LINE (206)) COMMA_SOURCE_FILE_AT_LINE (206)) ;
        //-------- @ifInstructionForGeneration
        const enumGalgasBool test_1 = var_targetPath.reader_fileExists (SOURCE_FILE_AT_LINE (207)).boolEnum () ;
        if (kBoolTrue == test_1) {
          //-------- @addAssignInstructionForGeneration
          result_stringlist.addAssign_operation (var_targetPath COMMA_SOURCE_FILE_AT_LINE (208)) ;
        }
        //-------- @ifInstructionForGeneration
        const enumGalgasBool test_2 = GALGAS_bool (kIsStrictSup, var_components.reader_length (SOURCE_FILE_AT_LINE (210)).objectCompare (GALGAS_uint ((PMUInt32) 0U))).boolEnum () ;
        if (kBoolTrue == test_2) {
          { //-------- @modifierCallInstructionForGeneration
          GALGAS_string joker_6901_0 ; // Joker input parameter
          var_components.modifier_popLast (joker_6901_0, inCompiler COMMA_SOURCE_FILE_AT_LINE (211)) ;
          } //-------- END @typeMethodInstructionForGeneration
        }else if (kBoolFalse == test_2) {
          //-------- @assignmentInstructionForGeneration
          var_notOver = GALGAS_bool (false) ;
        }
      }
    }
  }
//---
  return result_stringlist ;
}


//---------------------------------------------------------------------------*
//  Function introspection                                                   *
//---------------------------------------------------------------------------*

static const C_galgas_type_descriptor * functionArgs_allTemplateFilePaths [3] = {
  & kTypeDescriptor_GALGAS_string,
  & kTypeDescriptor_GALGAS_string,
  NULL
} ;

//---------------------------------------------------------------------------*

static GALGAS_object functionWithGenericHeader_allTemplateFilePaths (C_Compiler * inCompiler,
                                                                     const cObjectArray & inEffectiveParameterArray,
                                                                     const GALGAS_location & inErrorLocation
                                                                     COMMA_LOCATION_ARGS) {
  const GALGAS_string operand0 = GALGAS_string::extractObject (inEffectiveParameterArray.objectAtIndex (0 COMMA_HERE), inCompiler, inErrorLocation COMMA_THERE) ;
  const GALGAS_string operand1 = GALGAS_string::extractObject (inEffectiveParameterArray.objectAtIndex (1 COMMA_HERE), inCompiler, inErrorLocation COMMA_THERE) ;
  return function_allTemplateFilePaths (operand0, operand1, inCompiler COMMA_THERE).reader_object (THERE) ;
}

//---------------------------------------------------------------------------*

C_galgas_function_descriptor functionDescriptor_allTemplateFilePaths ("allTemplateFilePaths",
                                                                      functionWithGenericHeader_allTemplateFilePaths,
                                                                      & kTypeDescriptor_GALGAS_stringlist,
                                                                      2,
                                                                      functionArgs_allTemplateFilePaths) ;

//---------------------------------------------------------------------------*
//                                                                           *
//                          Function 'config_file'                           *
//                                                                           *
//---------------------------------------------------------------------------*

GALGAS_lstring function_config_5F_file (C_Compiler * inCompiler
                                        COMMA_UNUSED_LOCATION_ARGS) {
  GALGAS_lstring result_lstring ; // Returned variable
  //-------- @localVariableOrConstantDeclarationWithSourceExpressionForGeneration
  GALGAS_string var_cfg = function_templateFilePath (GALGAS_string ("config"), GALGAS_string ("target.cfg"), inCompiler COMMA_SOURCE_FILE_AT_LINE (220)) ;
  //-------- @assignmentInstructionForGeneration
  result_lstring = GALGAS_lstring::constructor_new (var_cfg, inCompiler->here () COMMA_SOURCE_FILE_AT_LINE (222)) ;
//---
  return result_lstring ;
}


//---------------------------------------------------------------------------*
//  Function introspection                                                   *
//---------------------------------------------------------------------------*

static const C_galgas_type_descriptor * functionArgs_config_5F_file [1] = {
  NULL
} ;

//---------------------------------------------------------------------------*

static GALGAS_object functionWithGenericHeader_config_5F_file (C_Compiler * inCompiler,
                                                               const cObjectArray & /* inEffectiveParameterArray */,
                                                               const GALGAS_location & /* inErrorLocation */
                                                               COMMA_LOCATION_ARGS) {
  return function_config_5F_file (inCompiler COMMA_THERE).reader_object (THERE) ;
}

//---------------------------------------------------------------------------*

C_galgas_function_descriptor functionDescriptor_config_5F_file ("config_file",
                                                                functionWithGenericHeader_config_5F_file,
                                                                & kTypeDescriptor_GALGAS_lstring,
                                                                0,
                                                                functionArgs_config_5F_file) ;

//---------------------------------------------------------------------------*
//                                                                           *
//                       Function 'extra_config_file'                        *
//                                                                           *
//---------------------------------------------------------------------------*

GALGAS_lstring function_extra_5F_config_5F_file (C_Compiler * inCompiler
                                                 COMMA_UNUSED_LOCATION_ARGS) {
  GALGAS_lstring result_lstring ; // Returned variable
  //-------- @localVariableOrConstantDeclarationWithSourceExpressionForGeneration
  GALGAS_string var_cfg = function_oil_5F_dir (inCompiler COMMA_SOURCE_FILE_AT_LINE (227)).operator_concat (GALGAS_string ("/target.cfg") COMMA_SOURCE_FILE_AT_LINE (227)) ;
  //-------- @ifInstructionForGeneration
  const enumGalgasBool test_0 = var_cfg.reader_fileExists (SOURCE_FILE_AT_LINE (228)).operator_not (SOURCE_FILE_AT_LINE (228)).boolEnum () ;
  if (kBoolTrue == test_0) {
    //-------- @assignmentInstructionForGeneration
    var_cfg = GALGAS_string::makeEmptyString () ;
  }
  //-------- @assignmentInstructionForGeneration
  result_lstring = GALGAS_lstring::constructor_new (var_cfg, inCompiler->here () COMMA_SOURCE_FILE_AT_LINE (231)) ;
//---
  return result_lstring ;
}


//---------------------------------------------------------------------------*
//  Function introspection                                                   *
//---------------------------------------------------------------------------*

static const C_galgas_type_descriptor * functionArgs_extra_5F_config_5F_file [1] = {
  NULL
} ;

//---------------------------------------------------------------------------*

static GALGAS_object functionWithGenericHeader_extra_5F_config_5F_file (C_Compiler * inCompiler,
                                                                        const cObjectArray & /* inEffectiveParameterArray */,
                                                                        const GALGAS_location & /* inErrorLocation */
                                                                        COMMA_LOCATION_ARGS) {
  return function_extra_5F_config_5F_file (inCompiler COMMA_THERE).reader_object (THERE) ;
}

//---------------------------------------------------------------------------*

C_galgas_function_descriptor functionDescriptor_extra_5F_config_5F_file ("extra_config_file",
                                                                         functionWithGenericHeader_extra_5F_config_5F_file,
                                                                         & kTypeDescriptor_GALGAS_lstring,
                                                                         0,
                                                                         functionArgs_extra_5F_config_5F_file) ;

//---------------------------------------------------------------------------*
//                                                                           *
//                            Routine 'doReplace'                            *
//                                                                           *
//---------------------------------------------------------------------------*

void routine_doReplace (GALGAS_string & ioArgument_s,
                        GALGAS_string inArgument_o,
                        GALGAS_string inArgument_n,
                        C_Compiler * inCompiler
                        COMMA_UNUSED_LOCATION_ARGS) {
  //-------- @assignmentInstructionForGeneration
  ioArgument_s = ioArgument_s.reader_stringByReplacingStringByString (inArgument_o, inArgument_n, inCompiler COMMA_SOURCE_FILE_AT_LINE (248)) ;
}


//---------------------------------------------------------------------------*
//                                                                           *
//                       Routine 'do_replace_default'                        *
//                                                                           *
//---------------------------------------------------------------------------*

void routine_do_5F_replace_5F_default (GALGAS_string & ioArgument_s,
                                       GALGAS_string inArgument_o,
                                       GALGAS_string inArgument_n,
                                       GALGAS_string inArgument_d,
                                       C_Compiler * inCompiler
                                       COMMA_UNUSED_LOCATION_ARGS) {
  //-------- @ifInstructionForGeneration
  const enumGalgasBool test_0 = GALGAS_bool (kIsNotEqual, inArgument_n.objectCompare (GALGAS_string::makeEmptyString ())).boolEnum () ;
  if (kBoolTrue == test_0) {
    //-------- @assignmentInstructionForGeneration
    ioArgument_s = ioArgument_s.reader_stringByReplacingStringByString (inArgument_o, inArgument_n, inCompiler COMMA_SOURCE_FILE_AT_LINE (253)) ;
  }else if (kBoolFalse == test_0) {
    //-------- @assignmentInstructionForGeneration
    ioArgument_s = ioArgument_s.reader_stringByReplacingStringByString (inArgument_o, inArgument_d, inCompiler COMMA_SOURCE_FILE_AT_LINE (255)) ;
  }
}


//---------------------------------------------------------------------------*
//                                                                           *
//                           Routine 'table_core'                            *
//                                                                           *
//---------------------------------------------------------------------------*

void routine_table_5F_core (GALGAS_string inArgument_typename,
                            GALGAS_string inArgument_varname,
                            GALGAS_string inArgument_obj_5F_prefix,
                            GALGAS_stringset inArgument_names,
                            GALGAS_string & ioArgument_header,
                            GALGAS_string & ioArgument_implementation,
                            C_Compiler * inCompiler
                            COMMA_UNUSED_LOCATION_ARGS) {
  //-------- @localVariableOrConstantDeclarationWithSourceExpressionForGeneration
  GALGAS_uint var_n = GALGAS_uint ((PMUInt32) 0U) ;
  //-------- @foreachInstructionForGeneration
  cEnumerator_stringset enumerator_8884 (inArgument_names, true) ;
  //--- simple foreach instruction
  while (enumerator_8884.hasCurrentObject ()) {
    //-------- @assignmentInstructionForGeneration
    ioArgument_header = ioArgument_header.operator_concat (GALGAS_string ("#define ") COMMA_SOURCE_FILE_AT_LINE (284)).operator_concat (inArgument_varname COMMA_SOURCE_FILE_AT_LINE (284)).operator_concat (GALGAS_string ("_id_of_") COMMA_SOURCE_FILE_AT_LINE (284)).operator_concat (enumerator_8884.current_key (HERE) COMMA_SOURCE_FILE_AT_LINE (284)).operator_concat (GALGAS_string ("  ") COMMA_SOURCE_FILE_AT_LINE (284)).operator_concat (var_n.reader_string (SOURCE_FILE_AT_LINE (284)) COMMA_SOURCE_FILE_AT_LINE (284)).operator_concat (GALGAS_string ("\n") COMMA_SOURCE_FILE_AT_LINE (284)) ;
    //-------- @assignmentInstructionForGeneration
    ioArgument_header = ioArgument_header.operator_concat (GALGAS_string ("#define ") COMMA_SOURCE_FILE_AT_LINE (292)).operator_concat (enumerator_8884.current_key (HERE) COMMA_SOURCE_FILE_AT_LINE (292)).operator_concat (GALGAS_string ("  ") COMMA_SOURCE_FILE_AT_LINE (292)).operator_concat (inArgument_varname COMMA_SOURCE_FILE_AT_LINE (292)).operator_concat (GALGAS_string ("_id_of_") COMMA_SOURCE_FILE_AT_LINE (292)).operator_concat (enumerator_8884.current_key (HERE) COMMA_SOURCE_FILE_AT_LINE (292)).operator_concat (GALGAS_string ("\n") COMMA_SOURCE_FILE_AT_LINE (292)) ;
    //-------- @assignmentInstructionForGeneration
    ioArgument_implementation = ioArgument_implementation.operator_concat (GALGAS_string ("    (tpl_") COMMA_SOURCE_FILE_AT_LINE (293)).operator_concat (inArgument_typename COMMA_SOURCE_FILE_AT_LINE (293)).operator_concat (GALGAS_string (" *)&") COMMA_SOURCE_FILE_AT_LINE (293)).operator_concat (inArgument_obj_5F_prefix COMMA_SOURCE_FILE_AT_LINE (293)).operator_concat (enumerator_8884.current_key (HERE) COMMA_SOURCE_FILE_AT_LINE (293)) ;
    //-------- @incrementInstructionForGeneration
    var_n.increment_operation (inCompiler COMMA_SOURCE_FILE_AT_LINE (294)) ;
    //-------- @ifInstructionForGeneration
    const enumGalgasBool test_0 = GALGAS_bool (kIsNotEqual, var_n.objectCompare (inArgument_names.reader_count (SOURCE_FILE_AT_LINE (295)))).boolEnum () ;
    if (kBoolTrue == test_0) {
      //-------- @assignmentInstructionForGeneration
      ioArgument_implementation = ioArgument_implementation.operator_concat (GALGAS_string (",\n") COMMA_SOURCE_FILE_AT_LINE (296)) ;
    }else if (kBoolFalse == test_0) {
      //-------- @assignmentInstructionForGeneration
      ioArgument_implementation = ioArgument_implementation.operator_concat (GALGAS_string ("\n") COMMA_SOURCE_FILE_AT_LINE (297)) ;
    }
    enumerator_8884.gotoNextObject () ;
  }
}


//---------------------------------------------------------------------------*
//                                                                           *
//                        Routine 'add_to_stringset'                         *
//                                                                           *
//---------------------------------------------------------------------------*

void routine_add_5F_to_5F_stringset (GALGAS_stringset & ioArgument_ss,
                                     GALGAS_string inArgument_new,
                                     C_Compiler * inCompiler
                                     COMMA_UNUSED_LOCATION_ARGS) {
  //-------- @ifInstructionForGeneration
  const enumGalgasBool test_0 = ioArgument_ss.reader_hasKey (inArgument_new COMMA_SOURCE_FILE_AT_LINE (403)).boolEnum () ;
  if (kBoolTrue == test_0) {
    //-------- @errorInstructionForGeneration
    inCompiler->emitSemanticError (inCompiler->here (), GALGAS_string ("'").operator_concat (inArgument_new COMMA_SOURCE_FILE_AT_LINE (404)).operator_concat (GALGAS_string ("' is already declared before") COMMA_SOURCE_FILE_AT_LINE (404)) COMMA_SOURCE_FILE_AT_LINE (404)) ;
  }else if (kBoolFalse == test_0) {
    //-------- @addAssignInstructionForGeneration
    ioArgument_ss.addAssign_operation (inArgument_new COMMA_SOURCE_FILE_AT_LINE (406)) ;
  }
}


//---------------------------------------------------------------------------*
//                                                                           *
//                          Routine 'file_in_path'                           *
//                                                                           *
//---------------------------------------------------------------------------*

void routine_file_5F_in_5F_path (GALGAS_lstring & ioArgument_file_5F_name,
                                 C_Compiler * inCompiler
                                 COMMA_UNUSED_LOCATION_ARGS) {
  //-------- @localVariableOrConstantDeclarationWithSourceExpressionForGeneration
  GALGAS_string var_include_5F_path = GALGAS_string::constructor_stringWithEnvironmentVariable (GALGAS_string ("GOIL_INCLUDE_PATH"), inCompiler COMMA_SOURCE_FILE_AT_LINE (413)) ;
  //-------- @localVariableOrConstantDeclarationWithSourceExpressionForGeneration
  GALGAS_stringlist var_path_5F_list = var_include_5F_path.reader_componentsSeparatedByString (GALGAS_string (":") COMMA_SOURCE_FILE_AT_LINE (414)) ;
  //-------- @localVariableOrConstantDeclarationWithSourceExpressionForGeneration
  GALGAS_bool var_not_5F_found = GALGAS_bool (true) ;
  //-------- @foreachInstructionForGeneration
  cEnumerator_stringlist enumerator_12994 (var_path_5F_list, true) ;
  //--- simple foreach instruction
  while (enumerator_12994.hasCurrentObject ()) {
    //-------- @localVariableOrConstantDeclarationWithSourceExpressionForGeneration
    GALGAS_string var_full_5F_file_5F_path = enumerator_12994.current_mValue (HERE) ;
    //-------- @ifInstructionForGeneration
    const enumGalgasBool test_0 = GALGAS_bool (kIsNotEqual, var_full_5F_file_5F_path.objectCompare (GALGAS_string::makeEmptyString ())).boolEnum () ;
    if (kBoolTrue == test_0) {
      //-------- @ifInstructionForGeneration
      const enumGalgasBool test_1 = GALGAS_bool (kIsNotEqual, var_full_5F_file_5F_path.reader_characterAtIndex (var_full_5F_file_5F_path.reader_length (SOURCE_FILE_AT_LINE (419)).substract_operation (GALGAS_uint ((PMUInt32) 1U), inCompiler COMMA_SOURCE_FILE_AT_LINE (419)), inCompiler COMMA_SOURCE_FILE_AT_LINE (419)).objectCompare (GALGAS_char (TO_UNICODE (47)))).boolEnum () ;
      if (kBoolTrue == test_1) {
        //-------- @appendInstructionForGeneration
        var_full_5F_file_5F_path.dotAssign_operation (GALGAS_string ("/") COMMA_SOURCE_FILE_AT_LINE (420)) ;
      }
    }
    //-------- @appendInstructionForGeneration
    var_full_5F_file_5F_path.dotAssign_operation (ioArgument_file_5F_name.reader_string (SOURCE_FILE_AT_LINE (423)) COMMA_SOURCE_FILE_AT_LINE (423)) ;
    //-------- @messageInstructionForGeneration
    inCompiler->printMessage (GALGAS_string ("searching '").operator_concat (ioArgument_file_5F_name.reader_string (SOURCE_FILE_AT_LINE (424)) COMMA_SOURCE_FILE_AT_LINE (424)).operator_concat (GALGAS_string ("' in ") COMMA_SOURCE_FILE_AT_LINE (424)).operator_concat (var_full_5F_file_5F_path COMMA_SOURCE_FILE_AT_LINE (424)).operator_concat (GALGAS_string ("... ") COMMA_SOURCE_FILE_AT_LINE (424)) COMMA_SOURCE_FILE_AT_LINE (424)) ;
    //-------- @ifInstructionForGeneration
    const enumGalgasBool test_2 = var_full_5F_file_5F_path.reader_fileExists (SOURCE_FILE_AT_LINE (425)).operator_and (var_not_5F_found COMMA_SOURCE_FILE_AT_LINE (425)).boolEnum () ;
    if (kBoolTrue == test_2) {
      //-------- @assignmentInstructionForGeneration
      ioArgument_file_5F_name = GALGAS_lstring::constructor_new (var_full_5F_file_5F_path, inCompiler->here () COMMA_SOURCE_FILE_AT_LINE (426)) ;
      //-------- @assignmentInstructionForGeneration
      var_not_5F_found = GALGAS_bool (false) ;
      //-------- @messageInstructionForGeneration
      inCompiler->printMessage (GALGAS_string ("found\n") COMMA_SOURCE_FILE_AT_LINE (428)) ;
    }else if (kBoolFalse == test_2) {
      //-------- @messageInstructionForGeneration
      inCompiler->printMessage (GALGAS_string ("not found\n") COMMA_SOURCE_FILE_AT_LINE (430)) ;
    }
    enumerator_12994.gotoNextObject () ;
  }
}


//---------------------------------------------------------------------------*
//                                                                           *
//                        Routine 'is_in_lstringlist'                        *
//                                                                           *
//---------------------------------------------------------------------------*

void routine_is_5F_in_5F_lstringlist (GALGAS_lstringlist inArgument_l,
                                      GALGAS_lstring inArgument_e,
                                      GALGAS_lstring & outArgument_f,
                                      GALGAS_bool & outArgument_p,
                                      C_Compiler * inCompiler
                                      COMMA_UNUSED_LOCATION_ARGS) {
  outArgument_f.drop () ; // Release 'out' argument
  outArgument_p.drop () ; // Release 'out' argument
  //-------- @assignmentInstructionForGeneration
  outArgument_p = GALGAS_bool (false) ;
  //-------- @assignmentInstructionForGeneration
  outArgument_f = GALGAS_lstring::constructor_new (GALGAS_string::makeEmptyString (), inCompiler->here () COMMA_SOURCE_FILE_AT_LINE (442)) ;
  //-------- @foreachInstructionForGeneration
  cEnumerator_lstringlist enumerator_13832 (inArgument_l, true) ;
  //--- simple foreach instruction
  while (enumerator_13832.hasCurrentObject ()) {
    //-------- @ifInstructionForGeneration
    const enumGalgasBool test_0 = GALGAS_bool (kIsEqual, enumerator_13832.current_mValue (HERE).reader_string (SOURCE_FILE_AT_LINE (444)).objectCompare (inArgument_e.reader_string (SOURCE_FILE_AT_LINE (444)))).boolEnum () ;
    if (kBoolTrue == test_0) {
      //-------- @assignmentInstructionForGeneration
      outArgument_p = GALGAS_bool (true) ;
      //-------- @assignmentInstructionForGeneration
      outArgument_f = enumerator_13832.current_mValue (HERE) ;
    }
    enumerator_13832.gotoNextObject () ;
  }
}


//---------------------------------------------------------------------------*
//                                                                           *
//                        Function 'isInLstringlist'                         *
//                                                                           *
//---------------------------------------------------------------------------*

GALGAS_bool function_isInLstringlist (GALGAS_lstringlist inArgument_l,
                                      GALGAS_lstring inArgument_e,
                                      C_Compiler * /* inCompiler */
                                      COMMA_UNUSED_LOCATION_ARGS) {
  GALGAS_bool result_bool ; // Returned variable
  //-------- @assignmentInstructionForGeneration
  result_bool = GALGAS_bool (false) ;
  //-------- @foreachInstructionForGeneration
  cEnumerator_lstringlist enumerator_14070 (inArgument_l, true) ;
  //--- simple foreach instruction
  while (enumerator_14070.hasCurrentObject ()) {
    //-------- @ifInstructionForGeneration
    const enumGalgasBool test_0 = GALGAS_bool (kIsEqual, enumerator_14070.current_mValue (HERE).reader_string (SOURCE_FILE_AT_LINE (458)).objectCompare (inArgument_e.reader_string (SOURCE_FILE_AT_LINE (458)))).boolEnum () ;
    if (kBoolTrue == test_0) {
      //-------- @assignmentInstructionForGeneration
      result_bool = GALGAS_bool (true) ;
    }
    enumerator_14070.gotoNextObject () ;
  }
//---
  return result_bool ;
}


//---------------------------------------------------------------------------*
//  Function introspection                                                   *
//---------------------------------------------------------------------------*

static const C_galgas_type_descriptor * functionArgs_isInLstringlist [3] = {
  & kTypeDescriptor_GALGAS_lstringlist,
  & kTypeDescriptor_GALGAS_lstring,
  NULL
} ;

//---------------------------------------------------------------------------*

static GALGAS_object functionWithGenericHeader_isInLstringlist (C_Compiler * inCompiler,
                                                                const cObjectArray & inEffectiveParameterArray,
                                                                const GALGAS_location & inErrorLocation
                                                                COMMA_LOCATION_ARGS) {
  const GALGAS_lstringlist operand0 = GALGAS_lstringlist::extractObject (inEffectiveParameterArray.objectAtIndex (0 COMMA_HERE), inCompiler, inErrorLocation COMMA_THERE) ;
  const GALGAS_lstring operand1 = GALGAS_lstring::extractObject (inEffectiveParameterArray.objectAtIndex (1 COMMA_HERE), inCompiler, inErrorLocation COMMA_THERE) ;
  return function_isInLstringlist (operand0, operand1, inCompiler COMMA_THERE).reader_object (THERE) ;
}

//---------------------------------------------------------------------------*

C_galgas_function_descriptor functionDescriptor_isInLstringlist ("isInLstringlist",
                                                                 functionWithGenericHeader_isInLstringlist,
                                                                 & kTypeDescriptor_GALGAS_bool,
                                                                 2,
                                                                 functionArgs_isInLstringlist) ;

//---------------------------------------------------------------------------*
//                                                                           *
//                       Routine 'add_lstring_unique'                        *
//                                                                           *
//---------------------------------------------------------------------------*

void routine_add_5F_lstring_5F_unique (GALGAS_lstringlist & ioArgument_l,
                                       GALGAS_lstring inArgument_e,
                                       GALGAS_string inArgument_att,
                                       C_Compiler * inCompiler
                                       COMMA_UNUSED_LOCATION_ARGS) {
  //-------- @localVariableDeclarationForGeneration
  GALGAS_bool var_found ;
  //-------- @localVariableDeclarationForGeneration
  GALGAS_lstring var_res ;
  { //-------- @routineCallInstructionForGeneration
  routine_is_5F_in_5F_lstringlist (ioArgument_l, inArgument_e, var_res, var_found, inCompiler COMMA_SOURCE_FILE_AT_LINE (471)) ;
  } //-------- @routineCallInstructionForGeneration
  //-------- @ifInstructionForGeneration
  const enumGalgasBool test_0 = var_found.boolEnum () ;
  if (kBoolTrue == test_0) {
    //-------- @errorInstructionForGeneration
    GALGAS_location location_1 (inArgument_e.reader_location (HERE)) ; // Implicit use of 'location' reader
    inCompiler->emitSemanticError (location_1, inArgument_att.operator_concat (GALGAS_string (" ") COMMA_SOURCE_FILE_AT_LINE (473)).operator_concat (inArgument_e.reader_string (SOURCE_FILE_AT_LINE (473)) COMMA_SOURCE_FILE_AT_LINE (473)).operator_concat (GALGAS_string (" has already be listed") COMMA_SOURCE_FILE_AT_LINE (473)) COMMA_SOURCE_FILE_AT_LINE (473)) ;
    //-------- @errorInstructionForGeneration
    GALGAS_location location_2 (var_res.reader_location (HERE)) ; // Implicit use of 'location' reader
    inCompiler->emitSemanticError (location_2, GALGAS_string ("was listed here") COMMA_SOURCE_FILE_AT_LINE (474)) ;
  }else if (kBoolFalse == test_0) {
    //-------- @addAssignInstructionForGeneration
    ioArgument_l.addAssign_operation (inArgument_e COMMA_SOURCE_FILE_AT_LINE (476)) ;
  }
}


//---------------------------------------------------------------------------*
//                                                                           *
//                      Routine 'set_lstring_if_empty'                       *
//                                                                           *
//---------------------------------------------------------------------------*

void routine_set_5F_lstring_5F_if_5F_empty (GALGAS_lstring & ioArgument_s,
                                            GALGAS_lstring inArgument_ns,
                                            GALGAS_string inArgument_att,
                                            C_Compiler * inCompiler
                                            COMMA_UNUSED_LOCATION_ARGS) {
  //-------- @ifInstructionForGeneration
  const enumGalgasBool test_0 = GALGAS_bool (kIsEqual, ioArgument_s.reader_string (SOURCE_FILE_AT_LINE (485)).objectCompare (GALGAS_string::makeEmptyString ())).boolEnum () ;
  if (kBoolTrue == test_0) {
    //-------- @assignmentInstructionForGeneration
    ioArgument_s = inArgument_ns ;
  }else if (kBoolFalse == test_0) {
    //-------- @errorInstructionForGeneration
    GALGAS_location location_1 (inArgument_ns.reader_location (HERE)) ; // Implicit use of 'location' reader
    inCompiler->emitSemanticError (location_1, inArgument_att.operator_concat (GALGAS_string (" Redefinition") COMMA_SOURCE_FILE_AT_LINE (488)) COMMA_SOURCE_FILE_AT_LINE (488)) ;
    //-------- @errorInstructionForGeneration
    GALGAS_location location_2 (ioArgument_s.reader_location (HERE)) ; // Implicit use of 'location' reader
    inCompiler->emitSemanticError (location_2, GALGAS_string ("was defined here") COMMA_SOURCE_FILE_AT_LINE (489)) ;
  }
}


//---------------------------------------------------------------------------*
//                                                                           *
//                 Routine 'add_makefile_flag_if_not_empty'                  *
//                                                                           *
//---------------------------------------------------------------------------*

void routine_add_5F_makefile_5F_flag_5F_if_5F_not_5F_empty (GALGAS_string & ioArgument_receiver,
                                                            GALGAS_string inArgument_flag_5F_name,
                                                            GALGAS_string inArgument_flag_5F_value,
                                                            C_Compiler * /* inCompiler */
                                                            COMMA_UNUSED_LOCATION_ARGS) {
  //-------- @ifInstructionForGeneration
  const enumGalgasBool test_0 = GALGAS_bool (kIsNotEqual, inArgument_flag_5F_value.objectCompare (GALGAS_string::makeEmptyString ())).boolEnum () ;
  if (kBoolTrue == test_0) {
    //-------- @appendInstructionForGeneration
    ioArgument_receiver.dotAssign_operation (inArgument_flag_5F_name.operator_concat (GALGAS_string ("=") COMMA_SOURCE_FILE_AT_LINE (499)).operator_concat (inArgument_flag_5F_value COMMA_SOURCE_FILE_AT_LINE (499)).operator_concat (GALGAS_string ("\n") COMMA_SOURCE_FILE_AT_LINE (499)) COMMA_SOURCE_FILE_AT_LINE (499)) ;
  }
}


//---------------------------------------------------------------------------*
//                                                                           *
//                          Function 'lstringWith'                           *
//                                                                           *
//---------------------------------------------------------------------------*

GALGAS_lstring function_lstringWith (GALGAS_string inArgument_s,
                                     C_Compiler * inCompiler
                                     COMMA_UNUSED_LOCATION_ARGS) {
  GALGAS_lstring result_lstring ; // Returned variable
  //-------- @assignmentInstructionForGeneration
  result_lstring = GALGAS_lstring::constructor_new (inArgument_s, inCompiler->here () COMMA_SOURCE_FILE_AT_LINE (504)) ;
//---
  return result_lstring ;
}


//---------------------------------------------------------------------------*
//  Function introspection                                                   *
//---------------------------------------------------------------------------*

static const C_galgas_type_descriptor * functionArgs_lstringWith [2] = {
  & kTypeDescriptor_GALGAS_string,
  NULL
} ;

//---------------------------------------------------------------------------*

static GALGAS_object functionWithGenericHeader_lstringWith (C_Compiler * inCompiler,
                                                            const cObjectArray & inEffectiveParameterArray,
                                                            const GALGAS_location & inErrorLocation
                                                            COMMA_LOCATION_ARGS) {
  const GALGAS_string operand0 = GALGAS_string::extractObject (inEffectiveParameterArray.objectAtIndex (0 COMMA_HERE), inCompiler, inErrorLocation COMMA_THERE) ;
  return function_lstringWith (operand0, inCompiler COMMA_THERE).reader_object (THERE) ;
}

//---------------------------------------------------------------------------*

C_galgas_function_descriptor functionDescriptor_lstringWith ("lstringWith",
                                                             functionWithGenericHeader_lstringWith,
                                                             & kTypeDescriptor_GALGAS_lstring,
                                                             1,
                                                             functionArgs_lstringWith) ;

//---------------------------------------------------------------------------*
//                                                                           *
//                          Function 'stripString'                           *
//                                                                           *
//---------------------------------------------------------------------------*

GALGAS_string function_stripString (GALGAS_string inArgument_s,
                                    C_Compiler * inCompiler
                                    COMMA_UNUSED_LOCATION_ARGS) {
  GALGAS_string result_string ; // Returned variable
  //-------- @ifInstructionForGeneration
  const enumGalgasBool test_0 = GALGAS_bool (kIsStrictSup, inArgument_s.reader_length (SOURCE_FILE_AT_LINE (508)).objectCompare (GALGAS_uint ((PMUInt32) 0U))).boolEnum () ;
  if (kBoolTrue == test_0) {
    //-------- @localVariableOrConstantDeclarationWithSourceExpressionForGeneration
    GALGAS_uint var_first = GALGAS_uint ((PMUInt32) 0U) ;
    //-------- @localVariableOrConstantDeclarationWithSourceExpressionForGeneration
    GALGAS_uint var_last = inArgument_s.reader_length (SOURCE_FILE_AT_LINE (510)) ;
    //-------- @localVariableOrConstantDeclarationWithSourceExpressionForGeneration
    GALGAS_bool var_finished = GALGAS_bool (false) ;
    //-------- @loopInstructionForGeneration
    if (inArgument_s.reader_length (SOURCE_FILE_AT_LINE (513)).isValid ()) {
      PMUInt32 variant_15236 = inArgument_s.reader_length (SOURCE_FILE_AT_LINE (513)).uintValue () ;
      bool loop_15236 = true ;
      while (loop_15236) {
        loop_15236 = var_finished.operator_not (SOURCE_FILE_AT_LINE (514)).isValid () ;
        if (loop_15236) {
          loop_15236 = var_finished.operator_not (SOURCE_FILE_AT_LINE (514)).boolValue () ;
        }
        if (loop_15236 && (0 == variant_15236)) {
          loop_15236 = false ;
          inCompiler->loopRunTimeVariantError (SOURCE_FILE_AT_LINE (513)) ;
        }
        if (loop_15236) {
          variant_15236 -- ;
          //-------- @ifInstructionForGeneration
          const enumGalgasBool test_1 = GALGAS_bool (kIsEqual, inArgument_s.reader_characterAtIndex (var_first, inCompiler COMMA_SOURCE_FILE_AT_LINE (515)).objectCompare (GALGAS_char (TO_UNICODE (32)))).boolEnum () ;
          if (kBoolTrue == test_1) {
            //-------- @incrementInstructionForGeneration
            var_first.increment_operation (inCompiler COMMA_SOURCE_FILE_AT_LINE (516)) ;
            //-------- @ifInstructionForGeneration
            const enumGalgasBool test_2 = GALGAS_bool (kIsEqual, var_first.objectCompare (inArgument_s.reader_length (SOURCE_FILE_AT_LINE (517)))).boolEnum () ;
            if (kBoolTrue == test_2) {
              //-------- @assignmentInstructionForGeneration
              var_finished = GALGAS_bool (true) ;
            }
          }else if (kBoolFalse == test_1) {
            //-------- @assignmentInstructionForGeneration
            var_finished = GALGAS_bool (true) ;
          }
        }
      }
    }
    //-------- @assignmentInstructionForGeneration
    var_finished = GALGAS_bool (false) ;
    //-------- @loopInstructionForGeneration
    if (inArgument_s.reader_length (SOURCE_FILE_AT_LINE (522)).isValid ()) {
      PMUInt32 variant_15541 = inArgument_s.reader_length (SOURCE_FILE_AT_LINE (522)).uintValue () ;
      bool loop_15541 = true ;
      while (loop_15541) {
        loop_15541 = var_finished.operator_not (SOURCE_FILE_AT_LINE (523)).isValid () ;
        if (loop_15541) {
          loop_15541 = var_finished.operator_not (SOURCE_FILE_AT_LINE (523)).boolValue () ;
        }
        if (loop_15541 && (0 == variant_15541)) {
          loop_15541 = false ;
          inCompiler->loopRunTimeVariantError (SOURCE_FILE_AT_LINE (522)) ;
        }
        if (loop_15541) {
          variant_15541 -- ;
          //-------- @ifInstructionForGeneration
          const enumGalgasBool test_3 = GALGAS_bool (kIsEqual, inArgument_s.reader_characterAtIndex (var_last.substract_operation (GALGAS_uint ((PMUInt32) 1U), inCompiler COMMA_SOURCE_FILE_AT_LINE (524)), inCompiler COMMA_SOURCE_FILE_AT_LINE (524)).objectCompare (GALGAS_char (TO_UNICODE (32)))).boolEnum () ;
          if (kBoolTrue == test_3) {
            //-------- @decrementInstructionForGeneration
            var_last.decrement_operation (inCompiler COMMA_SOURCE_FILE_AT_LINE (525)) ;
            //-------- @ifInstructionForGeneration
            const enumGalgasBool test_4 = GALGAS_bool (kIsEqual, var_last.objectCompare (GALGAS_uint ((PMUInt32) 0U))).boolEnum () ;
            if (kBoolTrue == test_4) {
              //-------- @assignmentInstructionForGeneration
              var_finished = GALGAS_bool (true) ;
            }
          }else if (kBoolFalse == test_3) {
            //-------- @assignmentInstructionForGeneration
            var_finished = GALGAS_bool (true) ;
          }
        }
      }
    }
    //-------- @ifInstructionForGeneration
    const enumGalgasBool test_5 = GALGAS_bool (kIsStrictInf, var_first.objectCompare (var_last)).boolEnum () ;
    if (kBoolTrue == test_5) {
      //-------- @assignmentInstructionForGeneration
      result_string = inArgument_s.reader_subString (var_first, var_last.substract_operation (var_first, inCompiler COMMA_SOURCE_FILE_AT_LINE (531)) COMMA_SOURCE_FILE_AT_LINE (531)) ;
    }else if (kBoolFalse == test_5) {
      //-------- @assignmentInstructionForGeneration
      result_string = GALGAS_string::makeEmptyString () ;
    }
  }else if (kBoolFalse == test_0) {
    //-------- @assignmentInstructionForGeneration
    result_string = GALGAS_string::makeEmptyString () ;
  }
//---
  return result_string ;
}


//---------------------------------------------------------------------------*
//  Function introspection                                                   *
//---------------------------------------------------------------------------*

static const C_galgas_type_descriptor * functionArgs_stripString [2] = {
  & kTypeDescriptor_GALGAS_string,
  NULL
} ;

//---------------------------------------------------------------------------*

static GALGAS_object functionWithGenericHeader_stripString (C_Compiler * inCompiler,
                                                            const cObjectArray & inEffectiveParameterArray,
                                                            const GALGAS_location & inErrorLocation
                                                            COMMA_LOCATION_ARGS) {
  const GALGAS_string operand0 = GALGAS_string::extractObject (inEffectiveParameterArray.objectAtIndex (0 COMMA_HERE), inCompiler, inErrorLocation COMMA_THERE) ;
  return function_stripString (operand0, inCompiler COMMA_THERE).reader_object (THERE) ;
}

//---------------------------------------------------------------------------*

C_galgas_function_descriptor functionDescriptor_stripString ("stripString",
                                                             functionWithGenericHeader_stripString,
                                                             & kTypeDescriptor_GALGAS_string,
                                                             1,
                                                             functionArgs_stripString) ;

//---------------------------------------------------------------------------*
//                                                                           *
//                        Routine 'errorNoFileFound'                         *
//                                                                           *
//---------------------------------------------------------------------------*

void routine_errorNoFileFound (const GALGAS_stringlist constinArgument_searchedPaths,
                               const GALGAS_string constinArgument_kind,
                               const GALGAS_lstring constinArgument_file,
                               C_Compiler * inCompiler
                               COMMA_UNUSED_LOCATION_ARGS) {
  //-------- @localVariableOrConstantDeclarationWithSourceExpressionForGeneration
  GALGAS_string var_m = GALGAS_string ("cannot find a valid path for the '").operator_concat (constinArgument_file.reader_string (SOURCE_FILE_AT_LINE (545)) COMMA_SOURCE_FILE_AT_LINE (545)).operator_concat (GALGAS_string ("' ") COMMA_SOURCE_FILE_AT_LINE (545)).operator_concat (constinArgument_kind COMMA_SOURCE_FILE_AT_LINE (545)).operator_concat (GALGAS_string (" file. I have tried:") COMMA_SOURCE_FILE_AT_LINE (545)) ;
  //-------- @foreachInstructionForGeneration
  cEnumerator_stringlist enumerator_16157 (constinArgument_searchedPaths, true) ;
  //--- simple foreach instruction
  while (enumerator_16157.hasCurrentObject ()) {
    //-------- @appendInstructionForGeneration
    var_m.dotAssign_operation (GALGAS_string ("\n"
      "  - '").operator_concat (enumerator_16157.current_mValue (HERE) COMMA_SOURCE_FILE_AT_LINE (547)).operator_concat (GALGAS_string ("'") COMMA_SOURCE_FILE_AT_LINE (547)) COMMA_SOURCE_FILE_AT_LINE (547)) ;
    enumerator_16157.gotoNextObject () ;
  }
  //-------- @errorInstructionForGeneration
  GALGAS_location location_0 (constinArgument_file.reader_location (HERE)) ; // Implicit use of 'location' reader
  inCompiler->emitSemanticError (location_0, var_m COMMA_SOURCE_FILE_AT_LINE (549)) ;
}


//--- START OF USER ZONE 2


//--- END OF USER ZONE 2


