//---------------------------------------------------------------------------*
//                                                                           *
//                           File 'defaults.cpp'                             *
//                    Generated by version version 2.1.4                     *
//                     january 10th, 2011, at 14h31'40"                      *
//                                                                           *
//---------------------------------------------------------------------------*

//--- START OF USER ZONE 1


//--- END OF USER ZONE 1

#include "version_libpm.h"
#if CURRENT_LIBPM_VERSION != 926
  #error "This file has been compiled with a version of GALGAS that uses libpm version 926, different than the current version (CURRENT_LIBPM_VERSION) of libpm"
#endif

//---------------------------------------------------------------------------*

#include "defaults.h"
#include "galgas2/C_Compiler.h"
#include "galgas2/C_galgas_CLI_Options.h"

//---------------------------------------------------------------------------*

#include "goil_options.h"

//---------------------------------------------------------------------------*

#ifndef DO_NOT_GENERATE_CHECKINGS
  #define SOURCE_FILE_AT_LINE(line) "defaults.gSemantics", line
  #define COMMA_SOURCE_FILE_AT_LINE(line) , SOURCE_FILE_AT_LINE(line)
#else
  #define SOURCE_FILE_AT_LINE(line) 
  #define COMMA_SOURCE_FILE_AT_LINE(line) 
#endif

//---------------------------------------------------------------------------*
//                                                                           *
//                       Routine 'check_custom_field'                        *
//                                                                           *
//---------------------------------------------------------------------------*

void routine_check_5F_custom_5F_field (GALGAS_ident_5F_map & ioArgument_others,
                                       GALGAS_lstring inArgument_field,
                                       GALGAS_imp_5F_type inArgument_f_5F_def,
                                       C_Compiler * inCompiler
                                       COMMA_UNUSED_LOCATION_ARGS) {
  //-------- @ifInstructionForGeneration
  const enumGalgasBool test_0 = ioArgument_others.reader_hasKey (inArgument_field.reader_string (SOURCE_FILE_AT_LINE (38)) COMMA_SOURCE_FILE_AT_LINE (38)).operator_not (SOURCE_FILE_AT_LINE (38)).boolEnum () ;
  if (kBoolTrue == test_0) {
    //-------- @structuredCastInstructionForGeneration
    if (inArgument_f_5F_def.isValid ()) {
      if (inArgument_f_5F_def.dynamicTypeDescriptor () == & kTypeDescriptor_GALGAS_uint_33__32__5F_type) {
        GALGAS_uint_33__32__5F_type cast_916_f ((cPtr_uint_33__32__5F_type *) inArgument_f_5F_def.ptr ()) ;
        //-------- @localVariableOrConstantDeclarationWithSourceExpressionForGeneration
        GALGAS_uint_36__34__5F_class var_val = GALGAS_uint_36__34__5F_class::constructor_new (cast_916_f.reader_loc (SOURCE_FILE_AT_LINE (42)), cast_916_f.reader_def_5F_val (SOURCE_FILE_AT_LINE (42)).reader_value (SOURCE_FILE_AT_LINE (42)).reader_uint_36__34_ (SOURCE_FILE_AT_LINE (42)) COMMA_SOURCE_FILE_AT_LINE (42)) ;
        { //-------- @modifierCallInstructionForGeneration
        ioArgument_others.modifier_put (inArgument_field, var_val, inCompiler COMMA_SOURCE_FILE_AT_LINE (43)) ;
        } //-------- END @typeMethodInstructionForGeneration
      }else if (inArgument_f_5F_def.dynamicTypeDescriptor () == & kTypeDescriptor_GALGAS_sint_33__32__5F_type) {
        GALGAS_sint_33__32__5F_type cast_1080_f ((cPtr_sint_33__32__5F_type *) inArgument_f_5F_def.ptr ()) ;
        { //-------- @modifierCallInstructionForGeneration
        ioArgument_others.modifier_put (inArgument_field, cast_1080_f.reader_def_5F_val (SOURCE_FILE_AT_LINE (44)), inCompiler COMMA_SOURCE_FILE_AT_LINE (44)) ;
        } //-------- END @typeMethodInstructionForGeneration
      }else if (inArgument_f_5F_def.dynamicTypeDescriptor () == & kTypeDescriptor_GALGAS_uint_36__34__5F_type) {
        GALGAS_uint_36__34__5F_type cast_1151_f ((cPtr_uint_36__34__5F_type *) inArgument_f_5F_def.ptr ()) ;
        { //-------- @modifierCallInstructionForGeneration
        ioArgument_others.modifier_put (inArgument_field, cast_1151_f.reader_def_5F_val (SOURCE_FILE_AT_LINE (45)), inCompiler COMMA_SOURCE_FILE_AT_LINE (45)) ;
        } //-------- END @typeMethodInstructionForGeneration
      }else if (inArgument_f_5F_def.dynamicTypeDescriptor () == & kTypeDescriptor_GALGAS_sint_36__34__5F_type) {
        GALGAS_sint_36__34__5F_type cast_1222_f ((cPtr_sint_36__34__5F_type *) inArgument_f_5F_def.ptr ()) ;
        { //-------- @modifierCallInstructionForGeneration
        ioArgument_others.modifier_put (inArgument_field, cast_1222_f.reader_def_5F_val (SOURCE_FILE_AT_LINE (46)), inCompiler COMMA_SOURCE_FILE_AT_LINE (46)) ;
        } //-------- END @typeMethodInstructionForGeneration
      }
    }
  }
}


//---------------------------------------------------------------------------*
//                                                                           *
//                           Routine 'check_range'                           *
//                                                                           *
//---------------------------------------------------------------------------*

void routine_check_5F_range (GALGAS_basic_5F_type inArgument_var,
                             GALGAS_imp_5F_type inArgument_def,
                             C_Compiler * inCompiler
                             COMMA_UNUSED_LOCATION_ARGS) {
  //-------- @structuredCastInstructionForGeneration
  if (inArgument_var.isValid ()) {
    if (inArgument_var.dynamicTypeDescriptor () == & kTypeDescriptor_GALGAS_uint_33__32__5F_class) {
      GALGAS_uint_33__32__5F_class cast_1507_ui ((cPtr_uint_33__32__5F_class *) inArgument_var.ptr ()) ;
      //-------- @structuredCastInstructionForGeneration
      if (inArgument_def.isValid ()) {
        if (inArgument_def.dynamicTypeDescriptor () == & kTypeDescriptor_GALGAS_uint_33__32__5F_type) {
          GALGAS_uint_33__32__5F_type cast_1560_d ((cPtr_uint_33__32__5F_type *) inArgument_def.ptr ()) ;
          { //-------- @routineCallInstructionForGeneration
          routine_check_5F_uint_33__32__5F_range (cast_1560_d.reader_set (SOURCE_FILE_AT_LINE (63)), cast_1507_ui.reader_location (SOURCE_FILE_AT_LINE (63)), cast_1507_ui.reader_value (SOURCE_FILE_AT_LINE (63)), inCompiler COMMA_SOURCE_FILE_AT_LINE (63)) ;
          } //-------- @routineCallInstructionForGeneration
        }else{
          //-------- @errorInstructionForGeneration
          inCompiler->emitSemanticError (inArgument_def.reader_loc (SOURCE_FILE_AT_LINE (65)), GALGAS_string ("Internal error") COMMA_SOURCE_FILE_AT_LINE (65)) ;
        }
      }
    }else{
      //-------- @errorInstructionForGeneration
      inCompiler->emitSemanticError (inArgument_var.reader_location (SOURCE_FILE_AT_LINE (68)), GALGAS_string ("Internal error") COMMA_SOURCE_FILE_AT_LINE (68)) ;
    }
  }
}


//---------------------------------------------------------------------------*
//                                                                           *
//                  Routine 'verify_and_set_tasks_defaults'                  *
//                                                                           *
//---------------------------------------------------------------------------*

void routine_verify_5F_and_5F_set_5F_tasks_5F_defaults (GALGAS_task_5F_map & ioArgument_tasks,
                                                        GALGAS_implementation_5F_spec inArgument_spec,
                                                        C_Compiler * inCompiler
                                                        COMMA_UNUSED_LOCATION_ARGS) {
  //-------- @localVariableOrConstantDeclarationWithSourceExpressionForGeneration
  GALGAS_task_5F_map var_tp = ioArgument_tasks ;
  //-------- @foreachInstructionForGeneration
  cEnumerator_task_5F_map enumerator_2053 (var_tp, true) ;
  //--- simple foreach instruction
  while (enumerator_2053.hasCurrentObject ()) {
    { //-------- @modifierCallInstructionForGeneration
    GALGAS_task_5F_obj joker_2115_0 ; // Joker input parameter
    ioArgument_tasks.modifier_del (enumerator_2053.current_lkey (HERE), joker_2115_0, inCompiler COMMA_SOURCE_FILE_AT_LINE (83)) ;
    } //-------- END @typeMethodInstructionForGeneration
    //-------- @localVariableOrConstantDeclarationWithSourceExpressionForGeneration
    GALGAS_ident_5F_map var_others = enumerator_2053.current_task (HERE).reader_others (SOURCE_FILE_AT_LINE (84)) ;
    //-------- @foreachInstructionForGeneration
    cEnumerator_implementation_5F_spec enumerator_2186 (inArgument_spec, true) ;
    //--- simple foreach instruction
    while (enumerator_2186.hasCurrentObject ()) {
      //-------- @ifInstructionForGeneration
      const enumGalgasBool test_0 = GALGAS_bool (kIsEqual, enumerator_2186.current_lkey (HERE).reader_string (SOURCE_FILE_AT_LINE (86)).objectCompare (GALGAS_string ("PRIORITY"))).boolEnum () ;
      if (kBoolTrue == test_0) {
        { //-------- @routineCallInstructionForGeneration
        routine_check_5F_range (enumerator_2053.current_task (HERE).reader_priority (SOURCE_FILE_AT_LINE (87)), enumerator_2186.current_type (HERE), inCompiler COMMA_SOURCE_FILE_AT_LINE (87)) ;
        } //-------- @routineCallInstructionForGeneration
      }else if (kBoolFalse == test_0) {
        //-------- @ifInstructionForGeneration
        const enumGalgasBool test_1 = GALGAS_bool (kIsEqual, enumerator_2186.current_lkey (HERE).reader_string (SOURCE_FILE_AT_LINE (88)).objectCompare (GALGAS_string::makeEmptyString ())).boolEnum () ;
        if (kBoolTrue == test_1) {
        }else if (kBoolFalse == test_1) {
          //-------- @ifInstructionForGeneration
          const enumGalgasBool test_2 = GALGAS_bool (kIsEqual, enumerator_2186.current_lkey (HERE).reader_string (SOURCE_FILE_AT_LINE (89)).objectCompare (GALGAS_string::makeEmptyString ())).boolEnum () ;
          if (kBoolTrue == test_2) {
          }else if (kBoolFalse == test_2) {
            //-------- @ifInstructionForGeneration
            const enumGalgasBool test_3 = GALGAS_bool (kIsEqual, enumerator_2186.current_lkey (HERE).reader_string (SOURCE_FILE_AT_LINE (90)).objectCompare (GALGAS_string::makeEmptyString ())).boolEnum () ;
            if (kBoolTrue == test_3) {
            }else if (kBoolFalse == test_3) {
              //-------- @ifInstructionForGeneration
              const enumGalgasBool test_4 = GALGAS_bool (kIsEqual, enumerator_2186.current_lkey (HERE).reader_string (SOURCE_FILE_AT_LINE (91)).objectCompare (GALGAS_string::makeEmptyString ())).boolEnum () ;
              if (kBoolTrue == test_4) {
              }else if (kBoolFalse == test_4) {
                //-------- @ifInstructionForGeneration
                const enumGalgasBool test_5 = GALGAS_bool (kIsEqual, enumerator_2186.current_lkey (HERE).reader_string (SOURCE_FILE_AT_LINE (92)).objectCompare (GALGAS_string::makeEmptyString ())).boolEnum () ;
                if (kBoolTrue == test_5) {
                }else if (kBoolFalse == test_5) {
                  //-------- @ifInstructionForGeneration
                  const enumGalgasBool test_6 = GALGAS_bool (kIsEqual, enumerator_2186.current_lkey (HERE).reader_string (SOURCE_FILE_AT_LINE (93)).objectCompare (GALGAS_string::makeEmptyString ())).boolEnum () ;
                  if (kBoolTrue == test_6) {
                  }else if (kBoolFalse == test_6) {
                    { //-------- @routineCallInstructionForGeneration
                    routine_check_5F_custom_5F_field (var_others, enumerator_2186.current_lkey (HERE), enumerator_2186.current_type (HERE), inCompiler COMMA_SOURCE_FILE_AT_LINE (95)) ;
                    } //-------- @routineCallInstructionForGeneration
                  }
                }
              }
            }
          }
        }
      }
      enumerator_2186.gotoNextObject () ;
    }
    //-------- @localVariableOrConstantDeclarationWithSourceExpressionForGeneration
    GALGAS_task_5F_obj var_updated_5F_task = GALGAS_task_5F_obj::constructor_new (enumerator_2053.current_task (HERE).reader_desc (SOURCE_FILE_AT_LINE (99)), enumerator_2053.current_task (HERE).reader_priority (SOURCE_FILE_AT_LINE (100)), enumerator_2053.current_task (HERE).reader_schedule (SOURCE_FILE_AT_LINE (101)), enumerator_2053.current_task (HERE).reader_activation (SOURCE_FILE_AT_LINE (102)), enumerator_2053.current_task (HERE).reader_autostart (SOURCE_FILE_AT_LINE (103)), enumerator_2053.current_task (HERE).reader_resources (SOURCE_FILE_AT_LINE (104)), enumerator_2053.current_task (HERE).reader_events (SOURCE_FILE_AT_LINE (105)), enumerator_2053.current_task (HERE).reader_messages (SOURCE_FILE_AT_LINE (106)), enumerator_2053.current_task (HERE).reader_acc_5F_apps (SOURCE_FILE_AT_LINE (107)), enumerator_2053.current_task (HERE).reader_timing_5F_prot (SOURCE_FILE_AT_LINE (108)), var_others COMMA_SOURCE_FILE_AT_LINE (98)) ;
    { //-------- @modifierCallInstructionForGeneration
    ioArgument_tasks.modifier_put (enumerator_2053.current_lkey (HERE), var_updated_5F_task, inCompiler COMMA_SOURCE_FILE_AT_LINE (111)) ;
    } //-------- END @typeMethodInstructionForGeneration
    enumerator_2053.gotoNextObject () ;
  }
}


//---------------------------------------------------------------------------*
//                                                                           *
//                  Routine 'verify_and_set_isrs_defaults'                   *
//                                                                           *
//---------------------------------------------------------------------------*

void routine_verify_5F_and_5F_set_5F_isrs_5F_defaults (GALGAS_isr_5F_map & ioArgument_isrs,
                                                       GALGAS_implementation_5F_spec inArgument_spec,
                                                       C_Compiler * inCompiler
                                                       COMMA_UNUSED_LOCATION_ARGS) {
  //-------- @localVariableOrConstantDeclarationWithSourceExpressionForGeneration
  GALGAS_isr_5F_map var_ip = ioArgument_isrs ;
  //-------- @foreachInstructionForGeneration
  cEnumerator_isr_5F_map enumerator_3402 (var_ip, true) ;
  //--- simple foreach instruction
  while (enumerator_3402.hasCurrentObject ()) {
    { //-------- @modifierCallInstructionForGeneration
    GALGAS_isr_5F_obj joker_3461_0 ; // Joker input parameter
    ioArgument_isrs.modifier_del (enumerator_3402.current_lkey (HERE), joker_3461_0, inCompiler COMMA_SOURCE_FILE_AT_LINE (126)) ;
    } //-------- END @typeMethodInstructionForGeneration
    //-------- @localVariableOrConstantDeclarationWithSourceExpressionForGeneration
    GALGAS_ident_5F_map var_others = enumerator_3402.current_isr (HERE).reader_other_5F_fields (SOURCE_FILE_AT_LINE (127)) ;
    //-------- @foreachInstructionForGeneration
    cEnumerator_implementation_5F_spec enumerator_3537 (inArgument_spec, true) ;
    //--- simple foreach instruction
    while (enumerator_3537.hasCurrentObject ()) {
      //-------- @ifInstructionForGeneration
      const enumGalgasBool test_0 = GALGAS_bool (kIsEqual, enumerator_3537.current_lkey (HERE).reader_string (SOURCE_FILE_AT_LINE (129)).objectCompare (GALGAS_string ("PRIORITY"))).boolEnum () ;
      if (kBoolTrue == test_0) {
        //-------- @messageInstructionForGeneration
        inCompiler->printMessage (GALGAS_string ("PRIORITY!\n") COMMA_SOURCE_FILE_AT_LINE (130)) ;
      }else if (kBoolFalse == test_0) {
        //-------- @ifInstructionForGeneration
        const enumGalgasBool test_1 = GALGAS_bool (kIsEqual, enumerator_3537.current_lkey (HERE).reader_string (SOURCE_FILE_AT_LINE (131)).objectCompare (GALGAS_string::makeEmptyString ())).boolEnum () ;
        if (kBoolTrue == test_1) {
        }else if (kBoolFalse == test_1) {
          //-------- @ifInstructionForGeneration
          const enumGalgasBool test_2 = GALGAS_bool (kIsEqual, enumerator_3537.current_lkey (HERE).reader_string (SOURCE_FILE_AT_LINE (132)).objectCompare (GALGAS_string::makeEmptyString ())).boolEnum () ;
          if (kBoolTrue == test_2) {
          }else if (kBoolFalse == test_2) {
            //-------- @ifInstructionForGeneration
            const enumGalgasBool test_3 = GALGAS_bool (kIsEqual, enumerator_3537.current_lkey (HERE).reader_string (SOURCE_FILE_AT_LINE (133)).objectCompare (GALGAS_string::makeEmptyString ())).boolEnum () ;
            if (kBoolTrue == test_3) {
            }else if (kBoolFalse == test_3) {
              //-------- @ifInstructionForGeneration
              const enumGalgasBool test_4 = GALGAS_bool (kIsEqual, enumerator_3537.current_lkey (HERE).reader_string (SOURCE_FILE_AT_LINE (134)).objectCompare (GALGAS_string::makeEmptyString ())).boolEnum () ;
              if (kBoolTrue == test_4) {
              }else if (kBoolFalse == test_4) {
                //-------- @ifInstructionForGeneration
                const enumGalgasBool test_5 = GALGAS_bool (kIsEqual, enumerator_3537.current_lkey (HERE).reader_string (SOURCE_FILE_AT_LINE (135)).objectCompare (GALGAS_string::makeEmptyString ())).boolEnum () ;
                if (kBoolTrue == test_5) {
                }else if (kBoolFalse == test_5) {
                  //-------- @ifInstructionForGeneration
                  const enumGalgasBool test_6 = GALGAS_bool (kIsEqual, enumerator_3537.current_lkey (HERE).reader_string (SOURCE_FILE_AT_LINE (136)).objectCompare (GALGAS_string::makeEmptyString ())).boolEnum () ;
                  if (kBoolTrue == test_6) {
                  }else if (kBoolFalse == test_6) {
                    { //-------- @routineCallInstructionForGeneration
                    routine_check_5F_custom_5F_field (var_others, enumerator_3537.current_lkey (HERE), enumerator_3537.current_type (HERE), inCompiler COMMA_SOURCE_FILE_AT_LINE (138)) ;
                    } //-------- @routineCallInstructionForGeneration
                  }
                }
              }
            }
          }
        }
      }
      enumerator_3537.gotoNextObject () ;
    }
    //-------- @localVariableOrConstantDeclarationWithSourceExpressionForGeneration
    GALGAS_isr_5F_obj var_updated_5F_isr = GALGAS_isr_5F_obj::constructor_new (enumerator_3402.current_isr (HERE).reader_desc (SOURCE_FILE_AT_LINE (142)), enumerator_3402.current_isr (HERE).reader_category (SOURCE_FILE_AT_LINE (143)), enumerator_3402.current_isr (HERE).reader_priority (SOURCE_FILE_AT_LINE (144)), enumerator_3402.current_isr (HERE).reader_resources (SOURCE_FILE_AT_LINE (145)), enumerator_3402.current_isr (HERE).reader_messages (SOURCE_FILE_AT_LINE (146)), enumerator_3402.current_isr (HERE).reader_acc_5F_apps (SOURCE_FILE_AT_LINE (147)), enumerator_3402.current_isr (HERE).reader_timing_5F_prot (SOURCE_FILE_AT_LINE (148)), var_others COMMA_SOURCE_FILE_AT_LINE (141)) ;
    { //-------- @modifierCallInstructionForGeneration
    ioArgument_isrs.modifier_put (enumerator_3402.current_lkey (HERE), var_updated_5F_isr, inCompiler COMMA_SOURCE_FILE_AT_LINE (151)) ;
    } //-------- END @typeMethodInstructionForGeneration
    enumerator_3402.gotoNextObject () ;
  }
}


//---------------------------------------------------------------------------*
//                                                                           *
//                       Routine 'add_system_counter'                        *
//                                                                           *
//---------------------------------------------------------------------------*

void routine_add_5F_system_5F_counter (GALGAS_root_5F_obj & ioArgument_cpu,
                                       C_Compiler * inCompiler
                                       COMMA_UNUSED_LOCATION_ARGS) {
  //-------- @localVariableOrConstantDeclarationWithSourceExpressionForGeneration
  GALGAS_counter_5F_map var_counters = ioArgument_cpu.reader_counters (SOURCE_FILE_AT_LINE (165)) ;
  //-------- @localVariableDeclarationForGeneration
  GALGAS_counter_5F_obj var_sys_5F_cnt ;
  //-------- @localVariableOrConstantDeclarationWithSourceExpressionForGeneration
  GALGAS_lstringlist var_all_5F_apps = ioArgument_cpu.reader_applis (SOURCE_FILE_AT_LINE (167)).reader_allKeyList (SOURCE_FILE_AT_LINE (167)) ;
  //-------- @foreachInstructionForGeneration
  cEnumerator_app_5F_map enumerator_4703 (ioArgument_cpu.reader_applis (SOURCE_FILE_AT_LINE (168)), true) ;
  //--- simple foreach instruction
  while (enumerator_4703.hasCurrentObject ()) {
    //-------- @addAssignInstructionForGeneration
    var_all_5F_apps.addAssign_operation (enumerator_4703.current_lkey (HERE) COMMA_SOURCE_FILE_AT_LINE (169)) ;
    enumerator_4703.gotoNextObject () ;
  }
  //-------- @ifInstructionForGeneration
  const enumGalgasBool test_0 = var_counters.reader_hasKey (GALGAS_string ("SystemCounter") COMMA_SOURCE_FILE_AT_LINE (172)).boolEnum () ;
  if (kBoolTrue == test_0) {
    { //-------- @modifierCallInstructionForGeneration
    var_counters.modifier_del (GALGAS_lstring::constructor_new (GALGAS_string ("SystemCounter"), inCompiler->here () COMMA_SOURCE_FILE_AT_LINE (173)), var_sys_5F_cnt, inCompiler COMMA_SOURCE_FILE_AT_LINE (173)) ;
    } //-------- END @typeMethodInstructionForGeneration
    //-------- @structuredCastInstructionForGeneration
    if (var_sys_5F_cnt.reader_max_5F_allowed_5F_value (SOURCE_FILE_AT_LINE (174)).isValid ()) {
      if (var_sys_5F_cnt.reader_max_5F_allowed_5F_value (SOURCE_FILE_AT_LINE (174)).dynamicTypeDescriptor () == & kTypeDescriptor_GALGAS_void) {
        { //-------- @modifierCallInstructionForGeneration
        var_sys_5F_cnt.modifier_setMax_5F_allowed_5F_value (GALGAS_uint_33__32__5F_class::constructor_new (inCompiler->here (), GALGAS_uint ((PMUInt32) 32767U) COMMA_SOURCE_FILE_AT_LINE (176)) COMMA_SOURCE_FILE_AT_LINE (176)) ;
        } //-------- END @typeMethodInstructionForGeneration
      }
    }
    //-------- @structuredCastInstructionForGeneration
    if (var_sys_5F_cnt.reader_ticks_5F_per_5F_base (SOURCE_FILE_AT_LINE (179)).isValid ()) {
      if (var_sys_5F_cnt.reader_ticks_5F_per_5F_base (SOURCE_FILE_AT_LINE (179)).dynamicTypeDescriptor () == & kTypeDescriptor_GALGAS_void) {
        { //-------- @modifierCallInstructionForGeneration
        var_sys_5F_cnt.modifier_setTicks_5F_per_5F_base (GALGAS_uint_33__32__5F_class::constructor_new (inCompiler->here (), GALGAS_uint ((PMUInt32) 1U) COMMA_SOURCE_FILE_AT_LINE (181)) COMMA_SOURCE_FILE_AT_LINE (181)) ;
        } //-------- END @typeMethodInstructionForGeneration
      }
    }
    //-------- @structuredCastInstructionForGeneration
    if (var_sys_5F_cnt.reader_min_5F_cycle (SOURCE_FILE_AT_LINE (184)).isValid ()) {
      if (var_sys_5F_cnt.reader_min_5F_cycle (SOURCE_FILE_AT_LINE (184)).dynamicTypeDescriptor () == & kTypeDescriptor_GALGAS_void) {
        { //-------- @modifierCallInstructionForGeneration
        var_sys_5F_cnt.modifier_setMin_5F_cycle (GALGAS_uint_33__32__5F_class::constructor_new (inCompiler->here (), GALGAS_uint ((PMUInt32) 1U) COMMA_SOURCE_FILE_AT_LINE (186)) COMMA_SOURCE_FILE_AT_LINE (186)) ;
        } //-------- END @typeMethodInstructionForGeneration
      }
    }
    //-------- @ifInstructionForGeneration
    const enumGalgasBool test_1 = GALGAS_bool (kIsEqual, var_sys_5F_cnt.reader_source (SOURCE_FILE_AT_LINE (189)).reader_string (SOURCE_FILE_AT_LINE (189)).objectCompare (GALGAS_string::makeEmptyString ())).boolEnum () ;
    if (kBoolTrue == test_1) {
      //-------- @errorInstructionForGeneration
      GALGAS_location location_2 (var_sys_5F_cnt.reader_source (SOURCE_FILE_AT_LINE (190)).reader_location (HERE)) ; // Implicit use of 'location' reader
      inCompiler->emitSemanticError (location_2, GALGAS_string ("SystemCounter has no SOURCE") COMMA_SOURCE_FILE_AT_LINE (190)) ;
    }
    //-------- @ifInstructionForGeneration
    const enumGalgasBool test_3 = GALGAS_bool (gOption_goil_5F_options_autosar_5F_on.reader_value ()).boolEnum () ;
    if (kBoolTrue == test_3) {
      //-------- @ifInstructionForGeneration
      const enumGalgasBool test_4 = GALGAS_bool (kIsEqual, var_sys_5F_cnt.reader_acc_5F_apps (SOURCE_FILE_AT_LINE (194)).reader_length (SOURCE_FILE_AT_LINE (194)).objectCompare (GALGAS_uint ((PMUInt32) 0U))).boolEnum () ;
      if (kBoolTrue == test_4) {
        { //-------- @modifierCallInstructionForGeneration
        var_sys_5F_cnt.modifier_setAcc_5F_apps (var_all_5F_apps COMMA_SOURCE_FILE_AT_LINE (195)) ;
        } //-------- END @typeMethodInstructionForGeneration
      }
      //-------- @structuredCastInstructionForGeneration
      if (var_sys_5F_cnt.reader_type (SOURCE_FILE_AT_LINE (197)).isValid ()) {
        if (var_sys_5F_cnt.reader_type (SOURCE_FILE_AT_LINE (197)).dynamicTypeDescriptor () == & kTypeDescriptor_GALGAS_software_5F_counter) {
          GALGAS_software_5F_counter cast_5716_sc ((cPtr_software_5F_counter *) var_sys_5F_cnt.reader_type (SOURCE_FILE_AT_LINE (197)).ptr ()) ;
          //-------- @errorInstructionForGeneration
          inCompiler->emitSemanticError (cast_5716_sc.reader_location (SOURCE_FILE_AT_LINE (199)), GALGAS_string ("Incompatible TYPE for SystemCounter") COMMA_SOURCE_FILE_AT_LINE (199)) ;
        }
      }
    }
  }else if (kBoolFalse == test_0) {
    //-------- @localVariableOrConstantDeclarationWithSourceExpressionForGeneration
    GALGAS_hardware_5F_counter var_type = GALGAS_hardware_5F_counter::constructor_new (inCompiler->here (), GALGAS_void_5F_driver::constructor_new (inCompiler->here () COMMA_SOURCE_FILE_AT_LINE (204)), GALGAS_time_5F_constants::constructor_emptyList (SOURCE_FILE_AT_LINE (204)) COMMA_SOURCE_FILE_AT_LINE (204)) ;
    //-------- @assignmentInstructionForGeneration
    var_sys_5F_cnt = GALGAS_counter_5F_obj::constructor_new (GALGAS_lstring::constructor_new (GALGAS_string ("Predefined SystemCounter"), inCompiler->here () COMMA_SOURCE_FILE_AT_LINE (206)), GALGAS_uint_33__32__5F_class::constructor_new (inCompiler->here (), GALGAS_uint ((PMUInt32) 32767U) COMMA_SOURCE_FILE_AT_LINE (207)), GALGAS_uint_33__32__5F_class::constructor_new (inCompiler->here (), GALGAS_uint ((PMUInt32) 1U) COMMA_SOURCE_FILE_AT_LINE (208)), GALGAS_uint_33__32__5F_class::constructor_new (inCompiler->here (), GALGAS_uint ((PMUInt32) 1U) COMMA_SOURCE_FILE_AT_LINE (209)), GALGAS_lstring::constructor_new (GALGAS_string::makeEmptyString (), inCompiler->here () COMMA_SOURCE_FILE_AT_LINE (210)), var_all_5F_apps, var_type, GALGAS_lstring::constructor_new (GALGAS_string::makeEmptyString (), inCompiler->here () COMMA_SOURCE_FILE_AT_LINE (213)) COMMA_SOURCE_FILE_AT_LINE (205)) ;
  }
  { //-------- @modifierCallInstructionForGeneration
  var_counters.modifier_put (GALGAS_lstring::constructor_new (GALGAS_string ("SystemCounter"), inCompiler->here () COMMA_SOURCE_FILE_AT_LINE (217)), var_sys_5F_cnt, inCompiler COMMA_SOURCE_FILE_AT_LINE (217)) ;
  } //-------- END @typeMethodInstructionForGeneration
  { //-------- @modifierCallInstructionForGeneration
  ioArgument_cpu.modifier_setCounters (var_counters COMMA_SOURCE_FILE_AT_LINE (219)) ;
  } //-------- END @typeMethodInstructionForGeneration
}


//---------------------------------------------------------------------------*
//                                                                           *
//                          Routine 'set_defaults'                           *
//                                                                           *
//---------------------------------------------------------------------------*

void routine_set_5F_defaults (const GALGAS_implementation constinArgument_imp,
                              GALGAS_root_5F_obj & ioArgument_cpu,
                              C_Compiler * inCompiler
                              COMMA_UNUSED_LOCATION_ARGS) {
  //-------- @ifInstructionForGeneration
  const enumGalgasBool test_0 = constinArgument_imp.reader_hasKey (GALGAS_string ("task") COMMA_SOURCE_FILE_AT_LINE (227)).boolEnum () ;
  if (kBoolTrue == test_0) {
    //-------- @localVariableOrConstantDeclarationWithSourceExpressionForGeneration
    GALGAS_task_5F_map var_tasks = ioArgument_cpu.reader_tasks (SOURCE_FILE_AT_LINE (228)) ;
    //-------- @localVariableDeclarationForGeneration
    GALGAS_implementation_5F_spec var_spec ;
    //-------- @methodCallInstructionForGeneration
    constinArgument_imp.method_get (GALGAS_lstring::constructor_new (GALGAS_string ("task"), inCompiler->here () COMMA_SOURCE_FILE_AT_LINE (230)), var_spec, inCompiler COMMA_SOURCE_FILE_AT_LINE (230)) ;
    //-------- END @methodCallInstructionForGeneration
    { //-------- @routineCallInstructionForGeneration
    routine_verify_5F_and_5F_set_5F_tasks_5F_defaults (var_tasks, var_spec, inCompiler COMMA_SOURCE_FILE_AT_LINE (231)) ;
    } //-------- @routineCallInstructionForGeneration
    { //-------- @modifierCallInstructionForGeneration
    ioArgument_cpu.modifier_setTasks (var_tasks COMMA_SOURCE_FILE_AT_LINE (232)) ;
    } //-------- END @typeMethodInstructionForGeneration
    //-------- @assignmentInstructionForGeneration
    var_tasks = ioArgument_cpu.reader_tasks (SOURCE_FILE_AT_LINE (233)) ;
  }
  //-------- @ifInstructionForGeneration
  const enumGalgasBool test_1 = constinArgument_imp.reader_hasKey (GALGAS_string ("isr") COMMA_SOURCE_FILE_AT_LINE (237)).boolEnum () ;
  if (kBoolTrue == test_1) {
    //-------- @localVariableOrConstantDeclarationWithSourceExpressionForGeneration
    GALGAS_isr_5F_map var_isrs = ioArgument_cpu.reader_isrs (SOURCE_FILE_AT_LINE (238)) ;
    //-------- @localVariableDeclarationForGeneration
    GALGAS_implementation_5F_spec var_spec ;
    //-------- @methodCallInstructionForGeneration
    constinArgument_imp.method_get (GALGAS_lstring::constructor_new (GALGAS_string ("isr"), inCompiler->here () COMMA_SOURCE_FILE_AT_LINE (240)), var_spec, inCompiler COMMA_SOURCE_FILE_AT_LINE (240)) ;
    //-------- END @methodCallInstructionForGeneration
    { //-------- @routineCallInstructionForGeneration
    routine_verify_5F_and_5F_set_5F_isrs_5F_defaults (var_isrs, var_spec, inCompiler COMMA_SOURCE_FILE_AT_LINE (241)) ;
    } //-------- @routineCallInstructionForGeneration
    { //-------- @modifierCallInstructionForGeneration
    ioArgument_cpu.modifier_setIsrs (var_isrs COMMA_SOURCE_FILE_AT_LINE (242)) ;
    } //-------- END @typeMethodInstructionForGeneration
  }
  { //-------- @routineCallInstructionForGeneration
  routine_add_5F_system_5F_counter (ioArgument_cpu, inCompiler COMMA_SOURCE_FILE_AT_LINE (245)) ;
  } //-------- @routineCallInstructionForGeneration
}


//--- START OF USER ZONE 2


//--- END OF USER ZONE 2


