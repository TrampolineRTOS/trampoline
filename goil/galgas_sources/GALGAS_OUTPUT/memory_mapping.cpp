//---------------------------------------------------------------------------*
//                                                                           *
//                        File 'memory_mapping.cpp'                          *
//                        Generated by version 1.9.5                         *
//                     november 26th, 2009, at 14h9'58"                      *
//                                                                           *
//---------------------------------------------------------------------------*

//--- START OF USER ZONE 1


//--- END OF USER ZONE 1

//---------------------------------------------------------------------------*

#include "version_libpm.h"
#if LIBPM_VERSION != 614
  #error "This file has been compiled with a version of GALGAS different than the version of libpm"
#endif

//---------------------------------------------------------------------------*

#include <typeinfo>
#include "utilities/MF_MemoryControl.h"
#include "files/C_TextFileWrite.h"
#include "galgas/C_galgas_CLI_Options.h"
#include "memory_mapping.h"

//---------------------------------------------------------------------------*

#ifndef DO_NOT_GENERATE_CHECKINGS
  #define SOURCE_FILE_AT_LINE(line) "memory_mapping.ggs", line
  #define COMMA_SOURCE_FILE_AT_LINE(line) , SOURCE_FILE_AT_LINE(line)
#else
  #define SOURCE_FILE_AT_LINE(line) 
  #define COMMA_SOURCE_FILE_AT_LINE(line) 
#endif


//--- START OF USER ZONE 2


//--- END OF USER ZONE 2

//---------------------------------------------------------------------------*
//                                                                           *
//                 Implementation of routine "generate_mp"                   *
//                                                                           *
//---------------------------------------------------------------------------*

void routine_generate_mp (C_Compiler & inLexique,
                                const GGS_root_obj   var_cas_cpu,
                                const GGS_string_map   var_cas_app_for_obj,
                                GGS_string & /* var_cas_header */,
                                GGS_string & var_cas_implementation,
                                GGS_string & /* var_cas_obj_header */ COMMA_UNUSED_LOCATION_ARGS) {
  #ifdef DEBUG_TRACE_ENABLED
    printf ("ENTER routine_generate_mp at %s:%d\n", __FILE__, __LINE__) ;
  #endif
  const GGS_bool cond_4294 = function_memory_protection_on (inLexique, var_cas_cpu.reader_os (inLexique COMMA_SOURCE_FILE_AT_LINE (47)) COMMA_SOURCE_FILE_AT_LINE (47)) ;
  if (cond_4294.isBuiltAndTrue ()) {
    GGS_string var_cas_tpl_mp = function_template_string_if_exist (inLexique, GGS_string ("code"), GGS_string ("mp") COMMA_SOURCE_FILE_AT_LINE (48)) ;
    GGS_string var_cas_tpl_mp_desc = function_template_string_if_exist (inLexique, GGS_string ("code"), GGS_string ("mp_desc") COMMA_SOURCE_FILE_AT_LINE (49)) ;
    GGS_string var_cas_dec = GGS_string ("") ;
    GGS_string var_cas_ext = GGS_string ("") ;
    ::routine_doReplace (inLexique,  var_cas_tpl_mp,  GGS_string ("$TIMESTAMP$"),  GGS_string::constructor_stringWithCurrentDateTime (inLexique COMMA_HERE) COMMA_SOURCE_FILE_AT_LINE (53)) ;
    GGS_stringset  var_cas_known_osapp = GGS_stringset ::constructor_emptySet () ;
    {
      GGS_task_map::cEnumerator enumerator_1470 (var_cas_cpu.reader_tasks (inLexique COMMA_SOURCE_FILE_AT_LINE (57)), true) ;
      const GGS_task_map::cElement * operand_1470 = NULL ;
      while (((operand_1470 = enumerator_1470.nextObject ()))) {
        macroValidPointer (operand_1470) ;
        GGS_string var_cas_desc = var_cas_tpl_mp_desc.reader_stringByReplacingStringByString (inLexique, GGS_string ("$NAME$"), operand_1470->mKey.reader_string (inLexique COMMA_SOURCE_FILE_AT_LINE (58)) COMMA_SOURCE_FILE_AT_LINE (58)) ;
        const GGS_bool cond_2077 = gOption_goil_5F_options_autosar_5F_on.value () ;
        if (cond_2077.isBuiltAndTrue ()) {
          const GGS_bool cond_2062 = (var_cas_app_for_obj.reader_count ()).operator_strictSup (GGS_uint (0U)) ;
          if (cond_2062.isBuiltAndTrue ()) {
            GGS_string var_cas_app_name ;
            const GGS_string_map  temp_1719 = var_cas_app_for_obj ;
            if (temp_1719.isBuilt ()) {
              temp_1719 (HERE)->method_get (inLexique, operand_1470->mKey, var_cas_app_name COMMA_SOURCE_FILE_AT_LINE (62)) ;
            }
            const GGS_bool cond_2045 = (var_cas_known_osapp.reader_hasKey (var_cas_app_name)).operator_not () ;
            if (cond_2045.isBuiltAndTrue ()) {
              var_cas_ext.appendCString ("extern void __SEG_START_APP_") ;
              var_cas_ext.dotAssign_operation (var_cas_app_name) ;
              var_cas_ext.appendCString ("_VAR_RGN;\n") ;
              var_cas_ext.appendCString ("extern void __SEG_END_APP_") ;
              var_cas_ext.dotAssign_operation (var_cas_app_name) ;
              var_cas_ext.appendCString ("_VAR_RGN;\n") ;
              ::routine_doReplace (inLexique,  var_cas_desc,  GGS_string ("$APP_NAME$"),  var_cas_app_name COMMA_SOURCE_FILE_AT_LINE (66)) ;
              var_cas_known_osapp.addAssign_operation (var_cas_app_name) ;
            }
          }
        }
        var_cas_dec.dotAssign_operation (var_cas_desc) ;
      }
    }
    {
      GGS_isr_map::cEnumerator enumerator_2134 (var_cas_cpu.reader_isrs (inLexique COMMA_SOURCE_FILE_AT_LINE (74)), true) ;
      const GGS_isr_map::cElement * operand_2134 = NULL ;
      while (((operand_2134 = enumerator_2134.nextObject ()))) {
        macroValidPointer (operand_2134) ;
        GGS_string var_cas_desc = var_cas_tpl_mp_desc.reader_stringByReplacingStringByString (inLexique, GGS_string ("$NAME$"), operand_2134->mKey.reader_string (inLexique COMMA_SOURCE_FILE_AT_LINE (75)) COMMA_SOURCE_FILE_AT_LINE (75)) ;
        const GGS_bool cond_2686 = gOption_goil_5F_options_autosar_5F_on.value () ;
        if (cond_2686.isBuiltAndTrue ()) {
          const GGS_bool cond_2671 = (var_cas_app_for_obj.reader_count ()).operator_strictSup (GGS_uint (0U)) ;
          if (cond_2671.isBuiltAndTrue ()) {
            GGS_string var_cas_app_name ;
            const GGS_string_map  temp_2382 = var_cas_app_for_obj ;
            if (temp_2382.isBuilt ()) {
              temp_2382 (HERE)->method_get (inLexique, operand_2134->mKey, var_cas_app_name COMMA_SOURCE_FILE_AT_LINE (79)) ;
            }
            const GGS_bool cond_2654 = (var_cas_known_osapp.reader_hasKey (var_cas_app_name)).operator_not () ;
            if (cond_2654.isBuiltAndTrue ()) {
              var_cas_ext.appendCString ("extern void __SEG_START_APP_") ;
              var_cas_ext.dotAssign_operation (var_cas_app_name) ;
              var_cas_ext.appendCString ("_VAR_RGN;\n") ;
              var_cas_ext.appendCString ("extern void __SEG_END_APP_") ;
              var_cas_ext.dotAssign_operation (var_cas_app_name) ;
              var_cas_ext.appendCString ("_VAR_RGN;\n") ;
              var_cas_known_osapp.addAssign_operation (var_cas_app_name) ;
            }
          }
        }
        var_cas_dec.dotAssign_operation (var_cas_desc) ;
      }
    }
    GGS_tasks_by_type  var_cas_stasks = GGS_tasks_by_type ::constructor_emptySortedList () ;
    {
      GGS_task_map::cEnumerator enumerator_2843 (var_cas_cpu.reader_tasks (inLexique COMMA_SOURCE_FILE_AT_LINE (92)), true) ;
      const GGS_task_map::cElement * operand_2843 = NULL ;
      while (((operand_2843 = enumerator_2843.nextObject ()))) {
        macroValidPointer (operand_2843) ;
        const GGS_bool cond_2945 = (operand_2843->mInfo.task.reader_events (inLexique COMMA_SOURCE_FILE_AT_LINE (93)).reader_length ()).operator_strictSup (GGS_uint (0U)) ;
        if (cond_2945.isBuiltAndTrue ()) {
          var_cas_stasks.addAssign_operation (GGS_uint (0U), operand_2843->mKey.reader_string (inLexique COMMA_SOURCE_FILE_AT_LINE (94))) ;
        }else if (cond_2945.isBuiltAndFalse ()) {
          var_cas_stasks.addAssign_operation (GGS_uint (1U), operand_2843->mKey.reader_string (inLexique COMMA_SOURCE_FILE_AT_LINE (96))) ;
        }
      }
    }
    GGS_string var_cas_mp_table = GGS_string ("CONSTP2CONST(tpl_mem_prot_desc, AUTOMATIC, OS_VAR) tpl_mp_table[TASK_COUNT + ISR_COUNT + 1] = {\n") ;
    {
      GGS_tasks_by_type::cEnumerator enumerator_3161 (var_cas_stasks, true) ;
      const GGS_tasks_by_type::cElement * operand_3161 = NULL ;
      while (((operand_3161 = enumerator_3161.nextObject ()))) {
        macroValidPointer (operand_3161) ;
        const GGS_bool cond_3775 = gOption_goil_5F_options_autosar_5F_on.value () ;
        if (cond_3775.isBuiltAndTrue ()) {
          const GGS_bool cond_3759 = (var_cas_app_for_obj.reader_count ()).operator_strictSup (GGS_uint (0U)) ;
          if (cond_3759.isBuiltAndTrue ()) {
            GGS_string var_cas_app_name ;
            const GGS_string_map  temp_3417 = var_cas_app_for_obj ;
            if (temp_3417.isBuilt ()) {
              temp_3417 (HERE)->method_get (inLexique, GGS_lstring ::constructor_new (inLexique, operand_3161->name, GGS_location (inLexique) COMMA_HERE), var_cas_app_name COMMA_SOURCE_FILE_AT_LINE (107)) ;
            }
            GGS_app_obj  var_cas_app ;
            const GGS_app_map  temp_3511 = var_cas_cpu.reader_applis (inLexique COMMA_SOURCE_FILE_AT_LINE (109)) ;
            if (temp_3511.isBuilt ()) {
              temp_3511 (HERE)->method_get (inLexique, GGS_lstring ::constructor_new (inLexique, var_cas_app_name, GGS_location (inLexique) COMMA_HERE), var_cas_app COMMA_SOURCE_FILE_AT_LINE (109)) ;
            }
            { const GGS_app_trusted_obj _var_3739 = var_cas_app.reader_trusted (inLexique COMMA_SOURCE_FILE_AT_LINE (110)) ; // CAST instruction
              if (_var_3739.getPtr () != NULL) {
                macroValidPointer (_var_3739.getPtr ()) ;
                if (typeid (cPtr_app_trusted_true) == typeid (* (_var_3739.getPtr ()))) {
                  var_cas_mp_table.appendCString ("  NULL,\n") ;
                }else{
                  var_cas_mp_table.appendCString ("  &") ;
                  var_cas_mp_table.dotAssign_operation (operand_3161->name) ;
                  var_cas_mp_table.appendCString ("_mp_desc,\n") ;
                }
              }
            }
          }
        }else if (cond_3775.isBuiltAndFalse ()) {
          var_cas_mp_table.appendCString ("  &") ;
          var_cas_mp_table.dotAssign_operation (operand_3161->name) ;
          var_cas_mp_table.appendCString ("_mp_desc,\n") ;
        }
      }
    }
    {
      GGS_isr_map::cEnumerator enumerator_3869 (var_cas_cpu.reader_isrs (inLexique COMMA_SOURCE_FILE_AT_LINE (122)), true) ;
      const GGS_isr_map::cElement * operand_3869 = NULL ;
      while (((operand_3869 = enumerator_3869.nextObject ()))) {
        macroValidPointer (operand_3869) ;
        var_cas_mp_table.appendCString ("  &") ;
        var_cas_mp_table.dotAssign_operation (operand_3869->mKey.reader_string (inLexique COMMA_SOURCE_FILE_AT_LINE (123))) ;
        var_cas_mp_table.appendCString ("_mp_desc,\n") ;
      }
    }
    var_cas_mp_table.appendCString ("  NULL\n"
      "};") ;
    GGS_string var_cas_directory = function_project_name (inLexique COMMA_SOURCE_FILE_AT_LINE (127)) ;
    ::routine_doReplace (inLexique,  var_cas_tpl_mp,  GGS_string ("$APPLICATION$"),  var_cas_directory COMMA_SOURCE_FILE_AT_LINE (129)) ;
    ::routine_doReplace (inLexique,  var_cas_tpl_mp,  GGS_string ("$LINKER_SYM$"),  var_cas_ext COMMA_SOURCE_FILE_AT_LINE (130)) ;
    ::routine_doReplace (inLexique,  var_cas_tpl_mp,  GGS_string ("$REGION_DESC$"),  var_cas_dec COMMA_SOURCE_FILE_AT_LINE (131)) ;
    ::routine_doReplace (inLexique,  var_cas_tpl_mp,  GGS_string ("$DESC_TABLE$"),  var_cas_mp_table COMMA_SOURCE_FILE_AT_LINE (132)) ;
    ::routine_doReplace (inLexique,  var_cas_implementation,  GGS_string ("$MEMORY_PROTECTION$"),  var_cas_tpl_mp COMMA_SOURCE_FILE_AT_LINE (134)) ;
  }
  #ifdef DEBUG_TRACE_ENABLED
    printf ("LEAVE routine_generate_mp\n") ;
  #endif
}

//---------------------------------------------------------------------------*
//                                                                           *
//             Implementation of routine "generate_link_script"              *
//                                                                           *
//---------------------------------------------------------------------------*

void routine_generate_link_script (C_Compiler & inLexique,
                                const GGS_root_obj   var_cas_cpu COMMA_UNUSED_LOCATION_ARGS) {
  #ifdef DEBUG_TRACE_ENABLED
    printf ("ENTER routine_generate_link_script at %s:%d\n", __FILE__, __LINE__) ;
  #endif
  GGS_string var_cas_linker = function_linker (inLexique, var_cas_cpu.reader_os (inLexique COMMA_SOURCE_FILE_AT_LINE (141)).reader_memmap (inLexique COMMA_SOURCE_FILE_AT_LINE (141)) COMMA_SOURCE_FILE_AT_LINE (141)) ;
  const GGS_bool cond_7230 = (var_cas_linker).operator_isNotEqual (GGS_string ("")) ;
  if (cond_7230.isBuiltAndTrue ()) {
    GGS_string var_cas_task_vars = GGS_string ("") ;
    GGS_string var_cas_isr_vars = GGS_string ("") ;
    GGS_string var_cas_task_stack = GGS_string ("") ;
    GGS_string var_cas_isr_stack = GGS_string ("") ;
    GGS_string var_cas_app_vars = GGS_string ("") ;
    GGS_string var_cas_user_consts = GGS_string ("") ;
    GGS_string var_cas_user_code = GGS_string ("") ;
    GGS_string var_cas_var_tpl = function_template_string_if_exist (inLexique, var_cas_linker, GGS_string ("task_var") COMMA_SOURCE_FILE_AT_LINE (152)) ;
    GGS_string var_cas_stack_tpl = function_template_string_if_exist (inLexique, var_cas_linker, GGS_string ("task_stack") COMMA_SOURCE_FILE_AT_LINE (153)) ;
    GGS_string var_cas_const_tpl = function_template_string_if_exist (inLexique, var_cas_linker, GGS_string ("task_const") COMMA_SOURCE_FILE_AT_LINE (154)) ;
    GGS_string var_cas_code_tpl = function_template_string_if_exist (inLexique, var_cas_linker, GGS_string ("task_code") COMMA_SOURCE_FILE_AT_LINE (155)) ;
    {
      GGS_task_map::cEnumerator enumerator_4981 (var_cas_cpu.reader_tasks (inLexique COMMA_SOURCE_FILE_AT_LINE (156)), true) ;
      const GGS_task_map::cElement * operand_4981 = NULL ;
      while (((operand_4981 = enumerator_4981.nextObject ()))) {
        macroValidPointer (operand_4981) ;
        var_cas_task_vars.dotAssign_operation (var_cas_var_tpl.reader_stringByReplacingStringByString (inLexique, GGS_string ("$TASK_NAME$"), operand_4981->mKey.reader_string (inLexique COMMA_SOURCE_FILE_AT_LINE (157)) COMMA_SOURCE_FILE_AT_LINE (157))) ;
        var_cas_task_stack.dotAssign_operation (var_cas_stack_tpl.reader_stringByReplacingStringByString (inLexique, GGS_string ("$TASK_NAME$"), operand_4981->mKey.reader_string (inLexique COMMA_SOURCE_FILE_AT_LINE (158)) COMMA_SOURCE_FILE_AT_LINE (158))) ;
        var_cas_user_consts.dotAssign_operation (var_cas_const_tpl.reader_stringByReplacingStringByString (inLexique, GGS_string ("$TASK_NAME$"), operand_4981->mKey.reader_string (inLexique COMMA_SOURCE_FILE_AT_LINE (159)) COMMA_SOURCE_FILE_AT_LINE (159))) ;
        var_cas_user_code.dotAssign_operation (var_cas_code_tpl.reader_stringByReplacingStringByString (inLexique, GGS_string ("$TASK_NAME$"), operand_4981->mKey.reader_string (inLexique COMMA_SOURCE_FILE_AT_LINE (160)) COMMA_SOURCE_FILE_AT_LINE (160))) ;
      }
    }
    var_cas_var_tpl = function_template_string_if_exist (inLexique, var_cas_linker, GGS_string ("isr_var") COMMA_SOURCE_FILE_AT_LINE (164)) ;
    var_cas_stack_tpl = function_template_string_if_exist (inLexique, var_cas_linker, GGS_string ("isr_stack") COMMA_SOURCE_FILE_AT_LINE (165)) ;
    var_cas_const_tpl = function_template_string_if_exist (inLexique, var_cas_linker, GGS_string ("isr_const") COMMA_SOURCE_FILE_AT_LINE (166)) ;
    var_cas_code_tpl = function_template_string_if_exist (inLexique, var_cas_linker, GGS_string ("isr_code") COMMA_SOURCE_FILE_AT_LINE (167)) ;
    {
      GGS_isr_map::cEnumerator enumerator_5694 (var_cas_cpu.reader_isrs (inLexique COMMA_SOURCE_FILE_AT_LINE (168)), true) ;
      const GGS_isr_map::cElement * operand_5694 = NULL ;
      while (((operand_5694 = enumerator_5694.nextObject ()))) {
        macroValidPointer (operand_5694) ;
        var_cas_isr_vars.dotAssign_operation (var_cas_var_tpl.reader_stringByReplacingStringByString (inLexique, GGS_string ("$ISR_NAME$"), operand_5694->mKey.reader_string (inLexique COMMA_SOURCE_FILE_AT_LINE (169)) COMMA_SOURCE_FILE_AT_LINE (169))) ;
        var_cas_isr_stack.dotAssign_operation (var_cas_stack_tpl.reader_stringByReplacingStringByString (inLexique, GGS_string ("$TASK_NAME$"), operand_5694->mKey.reader_string (inLexique COMMA_SOURCE_FILE_AT_LINE (170)) COMMA_SOURCE_FILE_AT_LINE (170))) ;
        var_cas_user_consts.dotAssign_operation (var_cas_const_tpl.reader_stringByReplacingStringByString (inLexique, GGS_string ("$ISR_NAME$"), operand_5694->mKey.reader_string (inLexique COMMA_SOURCE_FILE_AT_LINE (171)) COMMA_SOURCE_FILE_AT_LINE (171))) ;
        var_cas_user_code.dotAssign_operation (var_cas_code_tpl.reader_stringByReplacingStringByString (inLexique, GGS_string ("$ISR_NAME$"), operand_5694->mKey.reader_string (inLexique COMMA_SOURCE_FILE_AT_LINE (172)) COMMA_SOURCE_FILE_AT_LINE (172))) ;
      }
    }
    var_cas_var_tpl = function_template_string_if_exist (inLexique, var_cas_linker, GGS_string ("app_var") COMMA_SOURCE_FILE_AT_LINE (176)) ;
    var_cas_const_tpl = function_template_string_if_exist (inLexique, var_cas_linker, GGS_string ("app_const") COMMA_SOURCE_FILE_AT_LINE (177)) ;
    {
      GGS_app_map::cEnumerator enumerator_6287 (var_cas_cpu.reader_applis (inLexique COMMA_SOURCE_FILE_AT_LINE (178)), true) ;
      const GGS_app_map::cElement * operand_6287 = NULL ;
      while (((operand_6287 = enumerator_6287.nextObject ()))) {
        macroValidPointer (operand_6287) ;
        var_cas_app_vars.dotAssign_operation (var_cas_var_tpl.reader_stringByReplacingStringByString (inLexique, GGS_string ("$APP_NAME$"), operand_6287->mKey.reader_string (inLexique COMMA_SOURCE_FILE_AT_LINE (179)) COMMA_SOURCE_FILE_AT_LINE (179))) ;
        var_cas_user_consts.dotAssign_operation (var_cas_const_tpl.reader_stringByReplacingStringByString (inLexique, GGS_string ("$APP_NAME$"), operand_6287->mKey.reader_string (inLexique COMMA_SOURCE_FILE_AT_LINE (180)) COMMA_SOURCE_FILE_AT_LINE (180))) ;
      }
    }
    GGS_string var_cas_script = function_template_string_if_exist (inLexique, var_cas_linker, GGS_string ("script") COMMA_SOURCE_FILE_AT_LINE (184)) ;
    ::routine_doReplace (inLexique,  var_cas_script,  GGS_string ("$USER_CODE$"),  var_cas_user_code COMMA_SOURCE_FILE_AT_LINE (185)) ;
    ::routine_doReplace (inLexique,  var_cas_script,  GGS_string ("$USER_CONST$"),  var_cas_user_consts COMMA_SOURCE_FILE_AT_LINE (186)) ;
    ::routine_doReplace (inLexique,  var_cas_script,  GGS_string ("$PROC_VAR$"),  (var_cas_task_vars).operator_concat (var_cas_isr_vars) COMMA_SOURCE_FILE_AT_LINE (187)) ;
    ::routine_doReplace (inLexique,  var_cas_script,  GGS_string ("$PROC_STACK$"),  (var_cas_task_stack).operator_concat (var_cas_isr_stack) COMMA_SOURCE_FILE_AT_LINE (188)) ;
    ::routine_doReplace (inLexique,  var_cas_script,  GGS_string ("$APP_VAR$"),  var_cas_app_vars COMMA_SOURCE_FILE_AT_LINE (189)) ;
    GGS_string var_cas_script_file = ((function_project_name (inLexique COMMA_SOURCE_FILE_AT_LINE (192))).operator_concat (GGS_string ("/"))).operator_concat (function_link_script_name (inLexique, var_cas_cpu.reader_os (inLexique COMMA_SOURCE_FILE_AT_LINE (192)).reader_memmap (inLexique COMMA_SOURCE_FILE_AT_LINE (192)) COMMA_SOURCE_FILE_AT_LINE (192))) ;
    GGS_uint  var_cas_error_count = GGS_uint ::constructor_errorCount (inLexique COMMA_HERE) ;
    const GGS_bool cond_7220 = (var_cas_error_count).operator_isEqual (GGS_uint (0U)) ;
    if (cond_7220.isBuiltAndTrue ()) {
      const GGS_bool cond_7151 = gOption_galgas_5F_cli_5F_options_verbose_5F_output.value () ;
      if (cond_7151.isBuiltAndTrue ()) {
        inLexique.printMessage (((GGS_string ("creating ")).operator_concat (var_cas_script_file)).operator_concat (GGS_string ("\n")) COMMA_SOURCE_FILE_AT_LINE (196)) ;
      }
      const GGS_string temp_7197 = var_cas_script ;
      if (temp_7197.isBuilt ()) {
        temp_7197 (HERE)->method_makeDirectoryAndWriteToFile (inLexique, var_cas_script_file COMMA_SOURCE_FILE_AT_LINE (198)) ;
      }
    }
  }
  #ifdef DEBUG_TRACE_ENABLED
    printf ("LEAVE routine_generate_link_script\n") ;
  #endif
}

//---------------------------------------------------------------------------*
//                                                                           *
//               Implementation of routine "generate_memmap"                 *
//                                                                           *
//---------------------------------------------------------------------------*

void routine_generate_memmap (C_Compiler & inLexique,
                                const GGS_root_obj   var_cas_cpu COMMA_UNUSED_LOCATION_ARGS) {
  #ifdef DEBUG_TRACE_ENABLED
    printf ("ENTER routine_generate_memmap at %s:%d\n", __FILE__, __LINE__) ;
  #endif
  GGS_string var_cas_cc = function_compiler (inLexique, var_cas_cpu.reader_os (inLexique COMMA_SOURCE_FILE_AT_LINE (206)).reader_memmap (inLexique COMMA_SOURCE_FILE_AT_LINE (206)) COMMA_SOURCE_FILE_AT_LINE (206)) ;
  const GGS_bool cond_17543 = (var_cas_cc).operator_isNotEqual (GGS_string ("")) ;
  if (cond_17543.isBuiltAndTrue ()) {
    GGS_string var_cas_mm = function_template_string_if_exist (inLexique, var_cas_cc, GGS_string ("MemMap.h") COMMA_SOURCE_FILE_AT_LINE (208)) ;
    GGS_string var_cas_result = GGS_string ("") ;
    GGS_string var_cas_gen_tpl = function_template_string_if_exist (inLexique, var_cas_cc, GGS_string ("generic_section") COMMA_SOURCE_FILE_AT_LINE (210)) ;
    GGS_string var_cas_section_tpl = var_cas_gen_tpl.reader_stringByReplacingStringByString (inLexique, GGS_string ("$CONT$"), GGS_string ("SEC") COMMA_SOURCE_FILE_AT_LINE (211)) ;
    GGS_string var_cas_config_tpl = var_cas_gen_tpl.reader_stringByReplacingStringByString (inLexique, GGS_string ("$CONT$"), GGS_string ("CONFIG") COMMA_SOURCE_FILE_AT_LINE (212)) ;
    GGS_stringlist  var_cas_data_size = GGS_stringlist ::constructor_emptyList () ;
    var_cas_data_size.addAssign_operation (GGS_string ("_32BIT")) ;
    var_cas_data_size.addAssign_operation (GGS_string ("_16BIT")) ;
    var_cas_data_size.addAssign_operation (GGS_string ("_8BIT")) ;
    var_cas_data_size.addAssign_operation (GGS_string ("_BOOLEAN")) ;
    var_cas_data_size.addAssign_operation (GGS_string ("_UNSPECIFIED")) ;
    GGS_stringlist  var_cas_sub_kind = GGS_stringlist ::constructor_emptyList () ;
    var_cas_sub_kind.addAssign_operation (GGS_string ("_NOINIT")) ;
    var_cas_sub_kind.addAssign_operation (GGS_string ("_POWER_ON_INIT")) ;
    var_cas_sub_kind.addAssign_operation (GGS_string ("_FAST")) ;
    var_cas_sub_kind.addAssign_operation (GGS_string ("")) ;
    GGS_string var_cas_obj_tpl = var_cas_section_tpl.reader_stringByReplacingStringByString (inLexique, GGS_string ("$OBJ$"), GGS_string ("Task") COMMA_SOURCE_FILE_AT_LINE (225)) ;
    {
      GGS_task_map::cEnumerator enumerator_8131 (var_cas_cpu.reader_tasks (inLexique COMMA_SOURCE_FILE_AT_LINE (226)), true) ;
      const GGS_task_map::cElement * operand_8131 = NULL ;
      while (((operand_8131 = enumerator_8131.nextObject ()))) {
        macroValidPointer (operand_8131) ;
        GGS_string var_cas_named_sec = var_cas_obj_tpl.reader_stringByReplacingStringByString (inLexique, GGS_string ("$NAME$"), operand_8131->mKey.reader_string (inLexique COMMA_SOURCE_FILE_AT_LINE (227)) COMMA_SOURCE_FILE_AT_LINE (227)) ;
        GGS_string var_cas_code_sec_tpl = var_cas_named_sec.reader_stringByReplacingStringByString (inLexique, GGS_string ("$KIND$"), GGS_string ("CODE") COMMA_SOURCE_FILE_AT_LINE (229)) ;
        ::routine_doReplace (inLexique,  var_cas_code_sec_tpl,  GGS_string ("$SUBKIND$"),  GGS_string ("") COMMA_SOURCE_FILE_AT_LINE (230)) ;
        ::routine_doReplace (inLexique,  var_cas_code_sec_tpl,  GGS_string ("$SIZE$"),  GGS_string ("") COMMA_SOURCE_FILE_AT_LINE (231)) ;
        ::routine_doReplace (inLexique,  var_cas_code_sec_tpl,  GGS_string ("$TYPE$"),  GGS_string ("CODE") COMMA_SOURCE_FILE_AT_LINE (232)) ;
        ::routine_doReplace (inLexique,  var_cas_code_sec_tpl,  GGS_string ("$SECTION_KIND$"),  GGS_string ("text") COMMA_SOURCE_FILE_AT_LINE (233)) ;
        var_cas_result.dotAssign_operation (var_cas_code_sec_tpl) ;
        GGS_string var_cas_var_sec_tpl = var_cas_named_sec.reader_stringByReplacingStringByString (inLexique, GGS_string ("$KIND$"), GGS_string ("VAR") COMMA_SOURCE_FILE_AT_LINE (236)) ;
        ::routine_doReplace (inLexique,  var_cas_var_sec_tpl,  GGS_string ("$TYPE$"),  GGS_string ("DATA") COMMA_SOURCE_FILE_AT_LINE (237)) ;
        ::routine_doReplace (inLexique,  var_cas_var_sec_tpl,  GGS_string ("$SECTION_KIND$"),  GGS_string ("data") COMMA_SOURCE_FILE_AT_LINE (238)) ;
        {
          GGS_stringlist::cEnumerator enumerator_8858 (var_cas_sub_kind, true) ;
          const GGS_stringlist::cElement * operand_8858 = NULL ;
          while (((operand_8858 = enumerator_8858.nextObject ()))) {
            macroValidPointer (operand_8858) ;
            GGS_string var_cas_var_sec_sk_tpl = var_cas_var_sec_tpl.reader_stringByReplacingStringByString (inLexique, GGS_string ("$SUBKIND$"), operand_8858->mValue COMMA_SOURCE_FILE_AT_LINE (240)) ;
            {
              GGS_stringlist::cEnumerator enumerator_8998 (var_cas_data_size, true) ;
              const GGS_stringlist::cElement * operand_8998 = NULL ;
              while (((operand_8998 = enumerator_8998.nextObject ()))) {
                macroValidPointer (operand_8998) ;
                GGS_string var_cas_partial_result = var_cas_var_sec_sk_tpl.reader_stringByReplacingStringByString (inLexique, GGS_string ("$SIZE$"), operand_8998->mValue COMMA_SOURCE_FILE_AT_LINE (242)) ;
                var_cas_result.dotAssign_operation (var_cas_partial_result) ;
              }
            }
          }
        }
        GGS_string var_cas_const_sec_tpl = var_cas_named_sec.reader_stringByReplacingStringByString (inLexique, GGS_string ("$KIND$"), GGS_string ("CONST") COMMA_SOURCE_FILE_AT_LINE (247)) ;
        ::routine_doReplace (inLexique,  var_cas_const_sec_tpl,  GGS_string ("$TYPE$"),  GGS_string ("DATA") COMMA_SOURCE_FILE_AT_LINE (248)) ;
        ::routine_doReplace (inLexique,  var_cas_const_sec_tpl,  GGS_string ("$SECTION_KIND$"),  GGS_string ("rodata") COMMA_SOURCE_FILE_AT_LINE (249)) ;
        var_cas_const_sec_tpl = var_cas_const_sec_tpl.reader_stringByReplacingStringByString (inLexique, GGS_string ("$SUBKIND$"), GGS_string ("") COMMA_SOURCE_FILE_AT_LINE (250)) ;
        {
          GGS_stringlist::cEnumerator enumerator_9554 (var_cas_data_size, true) ;
          const GGS_stringlist::cElement * operand_9554 = NULL ;
          while (((operand_9554 = enumerator_9554.nextObject ()))) {
            macroValidPointer (operand_9554) ;
            GGS_string var_cas_partial_result = var_cas_const_sec_tpl.reader_stringByReplacingStringByString (inLexique, GGS_string ("$SIZE$"), operand_9554->mValue COMMA_SOURCE_FILE_AT_LINE (252)) ;
            var_cas_result.dotAssign_operation (var_cas_partial_result) ;
          }
        }
        var_cas_const_sec_tpl = var_cas_named_sec.reader_stringByReplacingStringByString (inLexique, GGS_string ("$KIND$"), GGS_string ("CALIB") COMMA_SOURCE_FILE_AT_LINE (255)) ;
        ::routine_doReplace (inLexique,  var_cas_const_sec_tpl,  GGS_string ("$TYPE$"),  GGS_string ("DATA") COMMA_SOURCE_FILE_AT_LINE (256)) ;
        var_cas_const_sec_tpl = var_cas_const_sec_tpl.reader_stringByReplacingStringByString (inLexique, GGS_string ("$SUBKIND$"), GGS_string ("") COMMA_SOURCE_FILE_AT_LINE (257)) ;
        {
          GGS_stringlist::cEnumerator enumerator_9975 (var_cas_data_size, true) ;
          const GGS_stringlist::cElement * operand_9975 = NULL ;
          while (((operand_9975 = enumerator_9975.nextObject ()))) {
            macroValidPointer (operand_9975) ;
            GGS_string var_cas_partial_result = var_cas_const_sec_tpl.reader_stringByReplacingStringByString (inLexique, GGS_string ("$SIZE$"), operand_9975->mValue COMMA_SOURCE_FILE_AT_LINE (259)) ;
            var_cas_result.dotAssign_operation (var_cas_partial_result) ;
          }
        }
        var_cas_const_sec_tpl = var_cas_named_sec.reader_stringByReplacingStringByString (inLexique, GGS_string ("$KIND$"), GGS_string ("CARTO") COMMA_SOURCE_FILE_AT_LINE (262)) ;
        ::routine_doReplace (inLexique,  var_cas_const_sec_tpl,  GGS_string ("$TYPE$"),  GGS_string ("DATA") COMMA_SOURCE_FILE_AT_LINE (263)) ;
        var_cas_const_sec_tpl = var_cas_const_sec_tpl.reader_stringByReplacingStringByString (inLexique, GGS_string ("$SUBKIND$"), GGS_string ("") COMMA_SOURCE_FILE_AT_LINE (264)) ;
        {
          GGS_stringlist::cEnumerator enumerator_10396 (var_cas_data_size, true) ;
          const GGS_stringlist::cElement * operand_10396 = NULL ;
          while (((operand_10396 = enumerator_10396.nextObject ()))) {
            macroValidPointer (operand_10396) ;
            GGS_string var_cas_partial_result = var_cas_const_sec_tpl.reader_stringByReplacingStringByString (inLexique, GGS_string ("$SIZE$"), operand_10396->mValue COMMA_SOURCE_FILE_AT_LINE (266)) ;
            var_cas_result.dotAssign_operation (var_cas_partial_result) ;
          }
        }
        GGS_string var_cas_cfg_data = var_cas_config_tpl.reader_stringByReplacingStringByString (inLexique, GGS_string ("$KIND$"), GGS_string ("DATA") COMMA_SOURCE_FILE_AT_LINE (270)) ;
        ::routine_doReplace (inLexique,  var_cas_cfg_data,  GGS_string ("$TYPE$"),  GGS_string ("DATA") COMMA_SOURCE_FILE_AT_LINE (271)) ;
        ::routine_doReplace (inLexique,  var_cas_cfg_data,  GGS_string ("$SECTION_KIND$"),  GGS_string ("data") COMMA_SOURCE_FILE_AT_LINE (272)) ;
        var_cas_cfg_data = var_cas_cfg_data.reader_stringByReplacingStringByString (inLexique, GGS_string ("$SUBKIND$"), GGS_string ("") COMMA_SOURCE_FILE_AT_LINE (273)) ;
        var_cas_cfg_data = var_cas_cfg_data.reader_stringByReplacingStringByString (inLexique, GGS_string ("$OBJ$"), GGS_string ("Task") COMMA_SOURCE_FILE_AT_LINE (274)) ;
        var_cas_cfg_data = var_cas_cfg_data.reader_stringByReplacingStringByString (inLexique, GGS_string ("$NAME$"), operand_8131->mKey.reader_string (inLexique COMMA_SOURCE_FILE_AT_LINE (275)) COMMA_SOURCE_FILE_AT_LINE (275)) ;
        {
          GGS_stringlist::cEnumerator enumerator_11068 (var_cas_data_size, true) ;
          const GGS_stringlist::cElement * operand_11068 = NULL ;
          while (((operand_11068 = enumerator_11068.nextObject ()))) {
            macroValidPointer (operand_11068) ;
            GGS_string var_cas_partial_result = var_cas_cfg_data.reader_stringByReplacingStringByString (inLexique, GGS_string ("$SIZE$"), operand_11068->mValue COMMA_SOURCE_FILE_AT_LINE (277)) ;
            var_cas_result.dotAssign_operation (var_cas_partial_result) ;
          }
        }
        GGS_string var_cas_stack_data = var_cas_named_sec.reader_stringByReplacingStringByString (inLexique, GGS_string ("$KIND$"), GGS_string ("STACK") COMMA_SOURCE_FILE_AT_LINE (281)) ;
        ::routine_doReplace (inLexique,  var_cas_stack_data,  GGS_string ("$TYPE$"),  GGS_string ("DATA") COMMA_SOURCE_FILE_AT_LINE (282)) ;
        ::routine_doReplace (inLexique,  var_cas_stack_data,  GGS_string ("$SECTION_KIND$"),  GGS_string ("data") COMMA_SOURCE_FILE_AT_LINE (283)) ;
        ::routine_doReplace (inLexique,  var_cas_stack_data,  GGS_string ("$SUBKIND$"),  GGS_string ("") COMMA_SOURCE_FILE_AT_LINE (284)) ;
        ::routine_doReplace (inLexique,  var_cas_stack_data,  GGS_string ("$SIZE$"),  GGS_string ("") COMMA_SOURCE_FILE_AT_LINE (285)) ;
        var_cas_result.dotAssign_operation (var_cas_stack_data) ;
      }
    }
    var_cas_obj_tpl = var_cas_section_tpl.reader_stringByReplacingStringByString (inLexique, GGS_string ("$OBJ$"), GGS_string ("ISR") COMMA_SOURCE_FILE_AT_LINE (289)) ;
    {
      GGS_isr_map::cEnumerator enumerator_11697 (var_cas_cpu.reader_isrs (inLexique COMMA_SOURCE_FILE_AT_LINE (290)), true) ;
      const GGS_isr_map::cElement * operand_11697 = NULL ;
      while (((operand_11697 = enumerator_11697.nextObject ()))) {
        macroValidPointer (operand_11697) ;
        GGS_string var_cas_named_sec = var_cas_obj_tpl.reader_stringByReplacingStringByString (inLexique, GGS_string ("$NAME$"), operand_11697->mKey.reader_string (inLexique COMMA_SOURCE_FILE_AT_LINE (291)) COMMA_SOURCE_FILE_AT_LINE (291)) ;
        GGS_string var_cas_code_sec_tpl = var_cas_named_sec.reader_stringByReplacingStringByString (inLexique, GGS_string ("$KIND$"), GGS_string ("CODE") COMMA_SOURCE_FILE_AT_LINE (293)) ;
        ::routine_doReplace (inLexique,  var_cas_code_sec_tpl,  GGS_string ("$SUBKIND$"),  GGS_string ("") COMMA_SOURCE_FILE_AT_LINE (294)) ;
        ::routine_doReplace (inLexique,  var_cas_code_sec_tpl,  GGS_string ("$SIZE$"),  GGS_string ("") COMMA_SOURCE_FILE_AT_LINE (295)) ;
        ::routine_doReplace (inLexique,  var_cas_code_sec_tpl,  GGS_string ("$TYPE$"),  GGS_string ("CODE") COMMA_SOURCE_FILE_AT_LINE (296)) ;
        ::routine_doReplace (inLexique,  var_cas_code_sec_tpl,  GGS_string ("$SECTION_KIND$"),  GGS_string ("text") COMMA_SOURCE_FILE_AT_LINE (297)) ;
        var_cas_result.dotAssign_operation (var_cas_code_sec_tpl) ;
        GGS_string var_cas_var_sec_tpl = var_cas_named_sec.reader_stringByReplacingStringByString (inLexique, GGS_string ("$KIND$"), GGS_string ("VAR") COMMA_SOURCE_FILE_AT_LINE (300)) ;
        ::routine_doReplace (inLexique,  var_cas_var_sec_tpl,  GGS_string ("$TYPE$"),  GGS_string ("DATA") COMMA_SOURCE_FILE_AT_LINE (301)) ;
        ::routine_doReplace (inLexique,  var_cas_var_sec_tpl,  GGS_string ("$SECTION_KIND$"),  GGS_string ("data") COMMA_SOURCE_FILE_AT_LINE (302)) ;
        {
          GGS_stringlist::cEnumerator enumerator_12423 (var_cas_sub_kind, true) ;
          const GGS_stringlist::cElement * operand_12423 = NULL ;
          while (((operand_12423 = enumerator_12423.nextObject ()))) {
            macroValidPointer (operand_12423) ;
            GGS_string var_cas_var_sec_sk_tpl = var_cas_var_sec_tpl.reader_stringByReplacingStringByString (inLexique, GGS_string ("$SUBKIND$"), operand_12423->mValue COMMA_SOURCE_FILE_AT_LINE (304)) ;
            {
              GGS_stringlist::cEnumerator enumerator_12563 (var_cas_data_size, true) ;
              const GGS_stringlist::cElement * operand_12563 = NULL ;
              while (((operand_12563 = enumerator_12563.nextObject ()))) {
                macroValidPointer (operand_12563) ;
                GGS_string var_cas_partial_result = var_cas_var_sec_sk_tpl.reader_stringByReplacingStringByString (inLexique, GGS_string ("$SIZE$"), operand_12563->mValue COMMA_SOURCE_FILE_AT_LINE (306)) ;
                var_cas_result.dotAssign_operation (var_cas_partial_result) ;
              }
            }
          }
        }
        GGS_string var_cas_const_sec_tpl = var_cas_named_sec.reader_stringByReplacingStringByString (inLexique, GGS_string ("$KIND$"), GGS_string ("CONST") COMMA_SOURCE_FILE_AT_LINE (311)) ;
        ::routine_doReplace (inLexique,  var_cas_const_sec_tpl,  GGS_string ("$TYPE$"),  GGS_string ("DATA") COMMA_SOURCE_FILE_AT_LINE (312)) ;
        ::routine_doReplace (inLexique,  var_cas_const_sec_tpl,  GGS_string ("$SECTION_KIND$"),  GGS_string ("rodata") COMMA_SOURCE_FILE_AT_LINE (313)) ;
        var_cas_const_sec_tpl = var_cas_const_sec_tpl.reader_stringByReplacingStringByString (inLexique, GGS_string ("$SUBKIND$"), GGS_string ("") COMMA_SOURCE_FILE_AT_LINE (314)) ;
        {
          GGS_stringlist::cEnumerator enumerator_13119 (var_cas_data_size, true) ;
          const GGS_stringlist::cElement * operand_13119 = NULL ;
          while (((operand_13119 = enumerator_13119.nextObject ()))) {
            macroValidPointer (operand_13119) ;
            GGS_string var_cas_partial_result = var_cas_const_sec_tpl.reader_stringByReplacingStringByString (inLexique, GGS_string ("$SIZE$"), operand_13119->mValue COMMA_SOURCE_FILE_AT_LINE (316)) ;
            var_cas_result.dotAssign_operation (var_cas_partial_result) ;
          }
        }
        var_cas_const_sec_tpl = var_cas_named_sec.reader_stringByReplacingStringByString (inLexique, GGS_string ("$KIND$"), GGS_string ("CALIB") COMMA_SOURCE_FILE_AT_LINE (319)) ;
        ::routine_doReplace (inLexique,  var_cas_const_sec_tpl,  GGS_string ("$TYPE$"),  GGS_string ("DATA") COMMA_SOURCE_FILE_AT_LINE (320)) ;
        var_cas_const_sec_tpl = var_cas_const_sec_tpl.reader_stringByReplacingStringByString (inLexique, GGS_string ("$SUBKIND$"), GGS_string ("") COMMA_SOURCE_FILE_AT_LINE (321)) ;
        {
          GGS_stringlist::cEnumerator enumerator_13540 (var_cas_data_size, true) ;
          const GGS_stringlist::cElement * operand_13540 = NULL ;
          while (((operand_13540 = enumerator_13540.nextObject ()))) {
            macroValidPointer (operand_13540) ;
            GGS_string var_cas_partial_result = var_cas_const_sec_tpl.reader_stringByReplacingStringByString (inLexique, GGS_string ("$SIZE$"), operand_13540->mValue COMMA_SOURCE_FILE_AT_LINE (323)) ;
            var_cas_result.dotAssign_operation (var_cas_partial_result) ;
          }
        }
        var_cas_const_sec_tpl = var_cas_named_sec.reader_stringByReplacingStringByString (inLexique, GGS_string ("$KIND$"), GGS_string ("CARTO") COMMA_SOURCE_FILE_AT_LINE (326)) ;
        ::routine_doReplace (inLexique,  var_cas_const_sec_tpl,  GGS_string ("$TYPE$"),  GGS_string ("DATA") COMMA_SOURCE_FILE_AT_LINE (327)) ;
        var_cas_const_sec_tpl = var_cas_const_sec_tpl.reader_stringByReplacingStringByString (inLexique, GGS_string ("$SUBKIND$"), GGS_string ("") COMMA_SOURCE_FILE_AT_LINE (328)) ;
        {
          GGS_stringlist::cEnumerator enumerator_13961 (var_cas_data_size, true) ;
          const GGS_stringlist::cElement * operand_13961 = NULL ;
          while (((operand_13961 = enumerator_13961.nextObject ()))) {
            macroValidPointer (operand_13961) ;
            GGS_string var_cas_partial_result = var_cas_const_sec_tpl.reader_stringByReplacingStringByString (inLexique, GGS_string ("$SIZE$"), operand_13961->mValue COMMA_SOURCE_FILE_AT_LINE (330)) ;
            var_cas_result.dotAssign_operation (var_cas_partial_result) ;
          }
        }
        GGS_string var_cas_cfg_data = var_cas_config_tpl.reader_stringByReplacingStringByString (inLexique, GGS_string ("$KIND$"), GGS_string ("DATA") COMMA_SOURCE_FILE_AT_LINE (334)) ;
        ::routine_doReplace (inLexique,  var_cas_cfg_data,  GGS_string ("$TYPE$"),  GGS_string ("DATA") COMMA_SOURCE_FILE_AT_LINE (335)) ;
        ::routine_doReplace (inLexique,  var_cas_cfg_data,  GGS_string ("$SECTION_KIND$"),  GGS_string ("data") COMMA_SOURCE_FILE_AT_LINE (336)) ;
        var_cas_cfg_data = var_cas_cfg_data.reader_stringByReplacingStringByString (inLexique, GGS_string ("$SUBKIND$"), GGS_string ("") COMMA_SOURCE_FILE_AT_LINE (337)) ;
        var_cas_cfg_data = var_cas_cfg_data.reader_stringByReplacingStringByString (inLexique, GGS_string ("$OBJ$"), GGS_string ("ISR") COMMA_SOURCE_FILE_AT_LINE (338)) ;
        var_cas_cfg_data = var_cas_cfg_data.reader_stringByReplacingStringByString (inLexique, GGS_string ("$NAME$"), operand_11697->mKey.reader_string (inLexique COMMA_SOURCE_FILE_AT_LINE (339)) COMMA_SOURCE_FILE_AT_LINE (339)) ;
        {
          GGS_stringlist::cEnumerator enumerator_14632 (var_cas_data_size, true) ;
          const GGS_stringlist::cElement * operand_14632 = NULL ;
          while (((operand_14632 = enumerator_14632.nextObject ()))) {
            macroValidPointer (operand_14632) ;
            GGS_string var_cas_partial_result = var_cas_cfg_data.reader_stringByReplacingStringByString (inLexique, GGS_string ("$SIZE$"), operand_14632->mValue COMMA_SOURCE_FILE_AT_LINE (341)) ;
            var_cas_result.dotAssign_operation (var_cas_partial_result) ;
          }
        }
      }
    }
    ::routine_doReplace (inLexique,  var_cas_mm,  GGS_string ("$APP_MEMMAP$"),  var_cas_result COMMA_SOURCE_FILE_AT_LINE (346)) ;
    GGS_string var_cas_os_secs = GGS_string ("") ;
    GGS_string var_cas_os_tpl = function_template_string_if_exist (inLexique, var_cas_cc, GGS_string ("os_section") COMMA_SOURCE_FILE_AT_LINE (350)) ;
    GGS_string var_cas_code_section = var_cas_os_tpl.reader_stringByReplacingStringByString (inLexique, GGS_string ("$KIND$"), GGS_string ("CODE") COMMA_SOURCE_FILE_AT_LINE (351)) ;
    ::routine_doReplace (inLexique,  var_cas_code_section,  GGS_string ("$TYPE$"),  GGS_string ("CODE") COMMA_SOURCE_FILE_AT_LINE (352)) ;
    ::routine_doReplace (inLexique,  var_cas_code_section,  GGS_string ("$SECTION_KIND$"),  GGS_string ("text") COMMA_SOURCE_FILE_AT_LINE (353)) ;
    ::routine_doReplace (inLexique,  var_cas_code_section,  GGS_string ("$CONT$"),  GGS_string ("SEC") COMMA_SOURCE_FILE_AT_LINE (354)) ;
    ::routine_doReplace (inLexique,  var_cas_code_section,  GGS_string ("$SUBKIND$"),  GGS_string ("") COMMA_SOURCE_FILE_AT_LINE (355)) ;
    ::routine_doReplace (inLexique,  var_cas_code_section,  GGS_string ("$SIZE$"),  GGS_string ("") COMMA_SOURCE_FILE_AT_LINE (356)) ;
    ::routine_doReplace (inLexique,  var_cas_code_section,  GGS_string ("$SECTION$"),  GGS_string (".osCode") COMMA_SOURCE_FILE_AT_LINE (357)) ;
    var_cas_os_secs.dotAssign_operation (var_cas_code_section) ;
    GGS_string var_cas_var_section = var_cas_os_tpl.reader_stringByReplacingStringByString (inLexique, GGS_string ("$KIND$"), GGS_string ("VAR") COMMA_SOURCE_FILE_AT_LINE (360)) ;
    ::routine_doReplace (inLexique,  var_cas_var_section,  GGS_string ("$TYPE$"),  GGS_string ("DATA") COMMA_SOURCE_FILE_AT_LINE (361)) ;
    ::routine_doReplace (inLexique,  var_cas_var_section,  GGS_string ("$SECTION_KIND$"),  GGS_string ("data") COMMA_SOURCE_FILE_AT_LINE (362)) ;
    ::routine_doReplace (inLexique,  var_cas_var_section,  GGS_string ("$CONT$"),  GGS_string ("SEC") COMMA_SOURCE_FILE_AT_LINE (363)) ;
    ::routine_doReplace (inLexique,  var_cas_var_section,  GGS_string ("$SECTION$"),  GGS_string (".osVar") COMMA_SOURCE_FILE_AT_LINE (364)) ;
    GGS_string var_cas_no_init = var_cas_var_section.reader_stringByReplacingStringByString (inLexique, GGS_string ("$SUBKIND$"), GGS_string ("_NOINIT") COMMA_SOURCE_FILE_AT_LINE (365)) ;
    {
      GGS_stringlist::cEnumerator enumerator_15790 (var_cas_data_size, true) ;
      const GGS_stringlist::cElement * operand_15790 = NULL ;
      while (((operand_15790 = enumerator_15790.nextObject ()))) {
        macroValidPointer (operand_15790) ;
        var_cas_os_secs.dotAssign_operation (var_cas_no_init.reader_stringByReplacingStringByString (inLexique, GGS_string ("$SIZE$"), operand_15790->mValue COMMA_SOURCE_FILE_AT_LINE (367))) ;
      }
    }
    GGS_string var_cas_power_on = var_cas_var_section.reader_stringByReplacingStringByString (inLexique, GGS_string ("$SUBKIND$"), GGS_string ("_POWER_ON_INIT") COMMA_SOURCE_FILE_AT_LINE (369)) ;
    {
      GGS_stringlist::cEnumerator enumerator_16025 (var_cas_data_size, true) ;
      const GGS_stringlist::cElement * operand_16025 = NULL ;
      while (((operand_16025 = enumerator_16025.nextObject ()))) {
        macroValidPointer (operand_16025) ;
        var_cas_os_secs.dotAssign_operation (var_cas_power_on.reader_stringByReplacingStringByString (inLexique, GGS_string ("$SIZE$"), operand_16025->mValue COMMA_SOURCE_FILE_AT_LINE (371))) ;
      }
    }
    GGS_string var_cas_fast = var_cas_var_section.reader_stringByReplacingStringByString (inLexique, GGS_string ("$SUBKIND$"), GGS_string ("_POWER_ON_INIT") COMMA_SOURCE_FILE_AT_LINE (373)) ;
    {
      GGS_stringlist::cEnumerator enumerator_16257 (var_cas_data_size, true) ;
      const GGS_stringlist::cElement * operand_16257 = NULL ;
      while (((operand_16257 = enumerator_16257.nextObject ()))) {
        macroValidPointer (operand_16257) ;
        var_cas_os_secs.dotAssign_operation (var_cas_fast.reader_stringByReplacingStringByString (inLexique, GGS_string ("$SIZE$"), operand_16257->mValue COMMA_SOURCE_FILE_AT_LINE (375))) ;
      }
    }
    GGS_string var_cas_var = var_cas_var_section.reader_stringByReplacingStringByString (inLexique, GGS_string ("$SUBKIND$"), GGS_string ("") COMMA_SOURCE_FILE_AT_LINE (377)) ;
    {
      GGS_stringlist::cEnumerator enumerator_16470 (var_cas_data_size, true) ;
      const GGS_stringlist::cElement * operand_16470 = NULL ;
      while (((operand_16470 = enumerator_16470.nextObject ()))) {
        macroValidPointer (operand_16470) ;
        var_cas_os_secs.dotAssign_operation (var_cas_var.reader_stringByReplacingStringByString (inLexique, GGS_string ("$SIZE$"), operand_16470->mValue COMMA_SOURCE_FILE_AT_LINE (379))) ;
      }
    }
    GGS_string var_cas_const_section = var_cas_os_tpl.reader_stringByReplacingStringByString (inLexique, GGS_string ("$KIND$"), GGS_string ("CONST") COMMA_SOURCE_FILE_AT_LINE (382)) ;
    ::routine_doReplace (inLexique,  var_cas_const_section,  GGS_string ("$TYPE$"),  GGS_string ("DATA") COMMA_SOURCE_FILE_AT_LINE (383)) ;
    ::routine_doReplace (inLexique,  var_cas_const_section,  GGS_string ("$SECTION_KIND$"),  GGS_string ("rodata") COMMA_SOURCE_FILE_AT_LINE (384)) ;
    ::routine_doReplace (inLexique,  var_cas_const_section,  GGS_string ("$CONT$"),  GGS_string ("SEC") COMMA_SOURCE_FILE_AT_LINE (385)) ;
    ::routine_doReplace (inLexique,  var_cas_const_section,  GGS_string ("$SECTION$"),  GGS_string (".osConst") COMMA_SOURCE_FILE_AT_LINE (386)) ;
    GGS_string var_cas_os_const = var_cas_const_section.reader_stringByReplacingStringByString (inLexique, GGS_string ("$SUBKIND$"), GGS_string ("") COMMA_SOURCE_FILE_AT_LINE (387)) ;
    {
      GGS_stringlist::cEnumerator enumerator_16992 (var_cas_data_size, true) ;
      const GGS_stringlist::cElement * operand_16992 = NULL ;
      while (((operand_16992 = enumerator_16992.nextObject ()))) {
        macroValidPointer (operand_16992) ;
        var_cas_os_secs.dotAssign_operation (var_cas_os_const.reader_stringByReplacingStringByString (inLexique, GGS_string ("$SIZE$"), operand_16992->mValue COMMA_SOURCE_FILE_AT_LINE (389))) ;
      }
    }
    ::routine_doReplace (inLexique,  var_cas_mm,  GGS_string ("$OS_MEMMAP$"),  var_cas_os_secs COMMA_SOURCE_FILE_AT_LINE (392)) ;
    GGS_string var_cas_api_tpl = function_template_string_if_exist (inLexique, var_cas_cc, GGS_string ("api_section") COMMA_SOURCE_FILE_AT_LINE (395)) ;
    ::routine_doReplace (inLexique,  var_cas_mm,  GGS_string ("$API_MEMMAP$"),  var_cas_api_tpl COMMA_SOURCE_FILE_AT_LINE (396)) ;
    GGS_string var_cas_mm_file = (function_project_name (inLexique COMMA_SOURCE_FILE_AT_LINE (398))).operator_concat (GGS_string ("/MemMap.h")) ;
    const GGS_bool cond_17531 = (GGS_uint ::constructor_errorCount (inLexique COMMA_HERE)).operator_isEqual (GGS_uint (0U)) ;
    if (cond_17531.isBuiltAndTrue ()) {
      const GGS_bool cond_17470 = gOption_galgas_5F_cli_5F_options_verbose_5F_output.value () ;
      if (cond_17470.isBuiltAndTrue ()) {
        inLexique.printMessage (((GGS_string ("creating ")).operator_concat (var_cas_mm_file)).operator_concat (GGS_string ("\n")) COMMA_SOURCE_FILE_AT_LINE (401)) ;
      }
      const GGS_string temp_17512 = var_cas_mm ;
      if (temp_17512.isBuilt ()) {
        temp_17512 (HERE)->method_makeDirectoryAndWriteToFile (inLexique, var_cas_mm_file COMMA_SOURCE_FILE_AT_LINE (403)) ;
      }
    }
  }
  #ifdef DEBUG_TRACE_ENABLED
    printf ("LEAVE routine_generate_memmap\n") ;
  #endif
}

//---------------------------------------------------------------------------*
//                                                                           *
//             Implementation of routine "generate_memmap_new"               *
//                                                                           *
//---------------------------------------------------------------------------*

void routine_generate_memmap_new (C_Compiler & inLexique,
                                const GGS_root_obj   var_cas_cpu COMMA_UNUSED_LOCATION_ARGS) {
  #ifdef DEBUG_TRACE_ENABLED
    printf ("ENTER routine_generate_memmap_new at %s:%d\n", __FILE__, __LINE__) ;
  #endif
  GGS_string var_cas_cc = function_compiler (inLexique, var_cas_cpu.reader_os (inLexique COMMA_SOURCE_FILE_AT_LINE (413)).reader_memmap (inLexique COMMA_SOURCE_FILE_AT_LINE (413)) COMMA_SOURCE_FILE_AT_LINE (413)) ;
  const GGS_bool cond_17755 = (var_cas_cc).operator_isNotEqual (GGS_string ("")) ;
  if (cond_17755.isBuiltAndTrue ()) {
    GGS_string var_cas_mm = function_goil_template (inLexique, var_cas_cc, GGS_string ("MemMap.h") COMMA_SOURCE_FILE_AT_LINE (415)) ;
    inLexique.printMessage (var_cas_mm COMMA_SOURCE_FILE_AT_LINE (416)) ;
  }
  #ifdef DEBUG_TRACE_ENABLED
    printf ("LEAVE routine_generate_memmap_new\n") ;
  #endif
}

//---------------------------------------------------------------------------*
//                                                                           *
//              Implementation of routine "generate_compiler"                *
//                                                                           *
//---------------------------------------------------------------------------*

void routine_generate_compiler (C_Compiler & inLexique,
                                const GGS_root_obj   var_cas_cpu COMMA_UNUSED_LOCATION_ARGS) {
  #ifdef DEBUG_TRACE_ENABLED
    printf ("ENTER routine_generate_compiler at %s:%d\n", __FILE__, __LINE__) ;
  #endif
  GGS_string var_cas_cc = function_compiler (inLexique, var_cas_cpu.reader_os (inLexique COMMA_SOURCE_FILE_AT_LINE (423)).reader_memmap (inLexique COMMA_SOURCE_FILE_AT_LINE (423)) COMMA_SOURCE_FILE_AT_LINE (423)) ;
  const GGS_bool cond_18521 = (var_cas_cc).operator_isNotEqual (GGS_string ("")) ;
  if (cond_18521.isBuiltAndTrue ()) {
    GGS_string var_cas_comp = function_template_string_if_exist (inLexique, var_cas_cc, GGS_string ("Compiler.h") COMMA_SOURCE_FILE_AT_LINE (425)) ;
    GGS_string var_cas_comp_cfg = function_template_string_if_exist (inLexique, var_cas_cc, GGS_string ("Compiler_Cfg.h") COMMA_SOURCE_FILE_AT_LINE (426)) ;
    GGS_string var_cas_comp_file = (function_project_name (inLexique COMMA_SOURCE_FILE_AT_LINE (427))).operator_concat (GGS_string ("/Compiler.h")) ;
    GGS_string var_cas_comp_cfg_file = (function_project_name (inLexique COMMA_SOURCE_FILE_AT_LINE (428))).operator_concat (GGS_string ("/Compiler_Cfg.h")) ;
    const GGS_bool cond_18511 = (GGS_uint ::constructor_errorCount (inLexique COMMA_HERE)).operator_isEqual (GGS_uint (0U)) ;
    if (cond_18511.isBuiltAndTrue ()) {
      const GGS_bool cond_18278 = gOption_galgas_5F_cli_5F_options_verbose_5F_output.value () ;
      if (cond_18278.isBuiltAndTrue ()) {
        inLexique.printMessage (((GGS_string ("creating ")).operator_concat (var_cas_comp_file)).operator_concat (GGS_string ("\n")) COMMA_SOURCE_FILE_AT_LINE (432)) ;
      }
      const GGS_string temp_18322 = var_cas_comp ;
      if (temp_18322.isBuilt ()) {
        temp_18322 (HERE)->method_makeDirectoryAndWriteToFile (inLexique, var_cas_comp_file COMMA_SOURCE_FILE_AT_LINE (434)) ;
      }
      const GGS_bool cond_18438 = gOption_galgas_5F_cli_5F_options_verbose_5F_output.value () ;
      if (cond_18438.isBuiltAndTrue ()) {
        inLexique.printMessage (((GGS_string ("creating ")).operator_concat (var_cas_comp_cfg_file)).operator_concat (GGS_string ("\n")) COMMA_SOURCE_FILE_AT_LINE (436)) ;
      }
      const GGS_string temp_18486 = var_cas_comp_cfg ;
      if (temp_18486.isBuilt ()) {
        temp_18486 (HERE)->method_makeDirectoryAndWriteToFile (inLexique, var_cas_comp_cfg_file COMMA_SOURCE_FILE_AT_LINE (438)) ;
      }
    }
  }
  #ifdef DEBUG_TRACE_ENABLED
    printf ("LEAVE routine_generate_compiler\n") ;
  #endif
}

//---------------------------------------------------------------------------*

