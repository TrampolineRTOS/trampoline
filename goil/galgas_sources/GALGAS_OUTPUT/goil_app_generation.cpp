//---------------------------------------------------------------------------*
//                                                                           *
//                      File 'goil_app_generation.cpp'                       *
//                        Generated by version 1.8.3                         *
//                       may 29th, 2009, at 11h49'36"                        *
//                                                                           *
//---------------------------------------------------------------------------*

//--- START OF USER ZONE 1


//--- END OF USER ZONE 1

//---------------------------------------------------------------------------*

#include "version_libpm.h"
#if LIBPM_VERSION != 491
  #error "This file has been compiled with a version of GALGAS different than the version of libpm"
#endif

//---------------------------------------------------------------------------*

#include <typeinfo>
#include "utilities/MF_MemoryControl.h"
#include "files/C_TextFileWrite.h"
#include "goil_app_generation.h"

//---------------------------------------------------------------------------*

#ifndef DO_NOT_GENERATE_CHECKINGS
  #define SOURCE_FILE_AT_LINE(line) "goil_app_generation.ggs", line
  #define COMMA_SOURCE_FILE_AT_LINE(line) , SOURCE_FILE_AT_LINE(line)
#else
  #define SOURCE_FILE_AT_LINE(line) 
  #define COMMA_SOURCE_FILE_AT_LINE(line) 
#endif


//--- START OF USER ZONE 2


//--- END OF USER ZONE 2

//---------------------------------------------------------------------------*
//                                                                           *
//               Implementation of routine "generate_vector"                 *
//                                                                           *
//---------------------------------------------------------------------------*

void routine_generate_vector (C_Compiler & _inLexique,
                                GGS_string  var_cas_vec,
                                GGS_string & var_cas_res,
                                GGS_uint  & var_cas_byte_count COMMA_UNUSED_LOCATION_ARGS) {
  #ifdef DEBUG_TRACE_ENABLED
    printf ("ENTER routine_generate_vector at %s:%d\n", __FILE__, __LINE__) ;
  #endif
  var_cas_byte_count = var_cas_vec.reader_length (_inLexique COMMA_SOURCE_FILE_AT_LINE (47))._divide_operation (_inLexique, GGS_uint (8U) COMMA_SOURCE_FILE_AT_LINE (47)) ;
  if (((var_cas_vec.reader_length (_inLexique COMMA_SOURCE_FILE_AT_LINE (48))._modulo_operation (_inLexique, GGS_uint (8U) COMMA_SOURCE_FILE_AT_LINE (48)))._operator_isNotEqual (GGS_uint (0U))).isBuiltAndTrue ()) {
    var_cas_byte_count._increment_operation (_inLexique COMMA_SOURCE_FILE_AT_LINE (48)) ;
  }
  GGS_stringlist  var_cas_data ;
  var_cas_data = GGS_stringlist ::constructor_emptyList () ;
  GGS_uint  var_cas_i ;
  var_cas_i = GGS_uint (0U) ;
  GGS_uint  var_cas_start ;
  var_cas_start = GGS_uint (0U) ;
  GGS_uint _variant_1799 = var_cas_byte_count ;
  GGS_bool _condition_1799 (_variant_1799.isBuilt (), true) ;
  while (_condition_1799.isBuiltAndTrue ()) {
    _condition_1799 = (var_cas_i)._operator_strictInf (var_cas_byte_count) ;
    if (_condition_1799.isBuiltAndTrue ()) {
      if (_variant_1799.uintValue () == 0) {
        _inLexique.onTheFlyRunTimeError ("loop variant error" COMMA_SOURCE_FILE_AT_LINE (73)) ;
        _condition_1799 = GGS_bool (false) ;
      }else{
        _variant_1799._decrement_operation (_inLexique COMMA_HERE) ;
        GGS_string var_cas_byte ;
        var_cas_byte = var_cas_vec.reader_subString (_inLexique, var_cas_start, GGS_uint (8U) COMMA_SOURCE_FILE_AT_LINE (57)).reader_reversedString (_inLexique COMMA_SOURCE_FILE_AT_LINE (57)) ;
        GGS_uint  var_cas_bit_pos ;
        var_cas_bit_pos = GGS_uint (0U) ;
        GGS_uint  var_cas_val ;
        var_cas_val = GGS_uint (0U) ;
        GGS_uint _variant_1723 = GGS_uint (8U) ;
        GGS_bool _condition_1723 (_variant_1723.isBuilt (), true) ;
        while (_condition_1723.isBuiltAndTrue ()) {
          _condition_1723 = (var_cas_bit_pos)._operator_strictInf (var_cas_byte.reader_length (_inLexique COMMA_SOURCE_FILE_AT_LINE (62))) ;
          if (_condition_1723.isBuiltAndTrue ()) {
            if (_variant_1723.uintValue () == 0) {
              _inLexique.onTheFlyRunTimeError ("loop variant error" COMMA_SOURCE_FILE_AT_LINE (69)) ;
              _condition_1723 = GGS_bool (false) ;
            }else{
              _variant_1723._decrement_operation (_inLexique COMMA_HERE) ;
              GGS_char var_cas_bit ;
              var_cas_bit = var_cas_byte.reader_characterAtIndex (_inLexique, var_cas_bit_pos COMMA_SOURCE_FILE_AT_LINE (63)) ;
              var_cas_val = var_cas_val._left_shift_operation (_inLexique, GGS_uint (1U) COMMA_SOURCE_FILE_AT_LINE (64)) ;
              if (((var_cas_bit)._operator_isEqual (GGS_char (TO_UNICODE ('1')))).isBuiltAndTrue ()) {
                var_cas_val._increment_operation (_inLexique COMMA_SOURCE_FILE_AT_LINE (66)) ;
              }
              var_cas_bit_pos._increment_operation (_inLexique COMMA_SOURCE_FILE_AT_LINE (68)) ;
            }
          }
        }
        var_cas_data._addAssign_operation (var_cas_val.reader_string (_inLexique COMMA_SOURCE_FILE_AT_LINE (70))) ;
        var_cas_i._increment_operation (_inLexique COMMA_SOURCE_FILE_AT_LINE (71)) ;
        var_cas_start = var_cas_start._add_operation (_inLexique, GGS_uint (8U) COMMA_SOURCE_FILE_AT_LINE (72)) ;
      }
    }
  }
  var_cas_res = GGS_string::constructor_componentsJoinedByString (_inLexique, var_cas_data, GGS_string (",") COMMA_HERE) ;
  #ifdef DEBUG_TRACE_ENABLED
    printf ("LEAVE routine_generate_vector\n") ;
  #endif
}

//---------------------------------------------------------------------------*
//                                                                           *
//                Implementation of routine "generate_apps"                  *
//                                                                           *
//---------------------------------------------------------------------------*

void routine_generate_apps (C_Compiler & _inLexique,
                                GGS_app_map   var_cas_apps,
                                GGS_task_map   var_cas_tasks,
                                GGS_isr_map   var_cas_isrs,
                                GGS_alarm_map   var_cas_alarms,
                                GGS_resource_map   var_cas_rezs,
                                GGS_scheduletable_map   var_cas_sts,
                                GGS_counter_map   var_cas_cnts,
                                GGS_string & /* var_cas_head */,
                                GGS_string & var_cas_obj_head,
                                GGS_string & var_cas_imp COMMA_UNUSED_LOCATION_ARGS) {
  #ifdef DEBUG_TRACE_ENABLED
    printf ("ENTER routine_generate_apps at %s:%d\n", __FILE__, __LINE__) ;
  #endif
  GGS_string var_cas_res ;
  var_cas_res = GGS_string ("") ;
  GGS_stringlist  var_cas_app_list ;
  var_cas_app_list = GGS_stringlist ::constructor_emptyList () ;
  GGS_string var_cas_ids ;
  var_cas_ids = GGS_string ("") ;
  ::routine_doReplace (_inLexique,  var_cas_obj_head,  GGS_string ("$APP_COUNT$"),  var_cas_apps.reader_count (_inLexique COMMA_SOURCE_FILE_AT_LINE (95)).reader_string (_inLexique COMMA_SOURCE_FILE_AT_LINE (95)) COMMA_SOURCE_FILE_AT_LINE (95)) ;
  if (((var_cas_apps.reader_count (_inLexique COMMA_SOURCE_FILE_AT_LINE (97)))._operator_strictSup (GGS_uint (0U))).isBuiltAndTrue ()) {
    GGS_tasks_by_type  var_cas_stasks ;
    var_cas_stasks = GGS_tasks_by_type ::constructor_emptySortedList () ;
    {
      GGS_task_map::cEnumerator enumerator_2569 (var_cas_tasks, true) ;
      const GGS_task_map::cElement * operand_2569 = NULL ;
      while (((operand_2569 = enumerator_2569.nextObject ()))) {
        macroValidPointer (operand_2569) ;
        if (((operand_2569->mInfo.task.reader_events (_inLexique COMMA_SOURCE_FILE_AT_LINE (103)).reader_length (_inLexique COMMA_SOURCE_FILE_AT_LINE (103)))._operator_strictSup (GGS_uint (0U))).isBuiltAndTrue ()) {
          var_cas_stasks._addAssign_operation (GGS_uint (0U), operand_2569->mKey.reader_string (_inLexique COMMA_SOURCE_FILE_AT_LINE (104))) ;
        }else{
          var_cas_stasks._addAssign_operation (GGS_uint (1U), operand_2569->mKey.reader_string (_inLexique COMMA_SOURCE_FILE_AT_LINE (106))) ;
        }
      }
    }
    {
        GGS_uint var_cas_n (true, 0) ;
      GGS_app_map::cEnumerator enumerator_2736 (var_cas_apps, true) ;
      const GGS_app_map::cElement * operand_2736 = NULL ;
      while (((operand_2736 = enumerator_2736.nextObject ()))) {
        macroValidPointer (operand_2736) ;
        var_cas_app_list._addAssign_operation (((GGS_string ("&"))._operator_concat (operand_2736->mKey.reader_string (_inLexique COMMA_SOURCE_FILE_AT_LINE (112))))._operator_concat (GGS_string ("_app_access"))) ;
        var_cas_ids.appendCString ("#define ") ;
        var_cas_ids._dotAssign_operation (operand_2736->mKey.reader_string (_inLexique COMMA_SOURCE_FILE_AT_LINE (113))) ;
        var_cas_ids.appendCString ("_id ") ;
        var_cas_ids._dotAssign_operation (var_cas_n.reader_string (_inLexique COMMA_SOURCE_FILE_AT_LINE (113))) ;
        var_cas_ids.appendCString ("\n") ;
        var_cas_ids.appendCString ("CONST(ApplicationType, OS_APPL_CONST) ") ;
        var_cas_ids._dotAssign_operation (operand_2736->mKey.reader_string (_inLexique COMMA_SOURCE_FILE_AT_LINE (114))) ;
        var_cas_ids.appendCString (" = ") ;
        var_cas_ids._dotAssign_operation (operand_2736->mKey.reader_string (_inLexique COMMA_SOURCE_FILE_AT_LINE (114))) ;
        var_cas_ids.appendCString ("_id;\n") ;
        GGS_string var_cas_vectors ;
        var_cas_vectors = GGS_string ("") ;
        GGS_string var_cas_vec ;
        var_cas_vec = GGS_string ("") ;
        GGS_string var_cas_init ;
        GGS_uint  var_cas_count ;
        GGS_string var_cas_tpl ;
        ::routine_retrieveTemplateString (_inLexique,  var_cas_tpl,  GGS_string ("app") COMMA_SOURCE_FILE_AT_LINE (121)) ;
        ::routine_doReplace (_inLexique,  var_cas_tpl,  GGS_string ("$APP_NAME$"),  operand_2736->mKey.reader_string (_inLexique COMMA_SOURCE_FILE_AT_LINE (123)) COMMA_SOURCE_FILE_AT_LINE (123)) ;
        {
          GGS_tasks_by_type::cEnumerator enumerator_3358 (var_cas_stasks, true) ;
          const GGS_tasks_by_type::cElement * operand_3358 = NULL ;
          while (((operand_3358 = enumerator_3358.nextObject ()))) {
            macroValidPointer (operand_3358) ;
            if ((operand_2736->mInfo.app.reader_tasks (_inLexique COMMA_SOURCE_FILE_AT_LINE (129)).reader_hasKey (_inLexique, operand_3358->name COMMA_SOURCE_FILE_AT_LINE (129))).isBuiltAndTrue ()) {
              var_cas_vec.appendCString ("11") ;
            }else{
              var_cas_vec.appendCString ("0") ;
              GGS_task_obj  var_cas_t ;
              const GGS_task_map  _temp_3547 = var_cas_tasks ;
              if (_temp_3547.isBuilt ()) {
                _temp_3547 (HERE)->method_get (_inLexique, GGS_lstring ::constructor_new (_inLexique, operand_3358->name, GGS_location (_inLexique) COMMA_HERE), var_cas_t COMMA_SOURCE_FILE_AT_LINE (135)) ;
              }
              GGS_bool var_cas_found ;
              GGS_lstring  automatic_var_0 ;
              ::routine_is_in_lstringlist (_inLexique,  var_cas_t.reader_acc_apps (_inLexique COMMA_SOURCE_FILE_AT_LINE (137)),  operand_2736->mKey,  automatic_var_0,  var_cas_found COMMA_SOURCE_FILE_AT_LINE (137)) ;
              if ((var_cas_found).isBuiltAndTrue ()) {
                var_cas_vec.appendCString ("1") ;
              }else{
                var_cas_vec.appendCString ("0") ;
              }
            }
          }
        }
        {
          GGS_isr_map::cEnumerator enumerator_3804 (var_cas_isrs, true) ;
          const GGS_isr_map::cElement * operand_3804 = NULL ;
          while (((operand_3804 = enumerator_3804.nextObject ()))) {
            macroValidPointer (operand_3804) ;
            if ((operand_2736->mInfo.app.reader_isrs (_inLexique COMMA_SOURCE_FILE_AT_LINE (144)).reader_hasKey (_inLexique, operand_3804->mKey.reader_string (_inLexique COMMA_SOURCE_FILE_AT_LINE (144)) COMMA_SOURCE_FILE_AT_LINE (144))).isBuiltAndTrue ()) {
              var_cas_vec.appendCString ("11") ;
            }else{
              var_cas_vec.appendCString ("0") ;
              GGS_bool var_cas_found ;
              GGS_lstring  automatic_var_1 ;
              ::routine_is_in_lstringlist (_inLexique,  operand_3804->mInfo.isr.reader_acc_apps (_inLexique COMMA_SOURCE_FILE_AT_LINE (149)),  operand_2736->mKey,  automatic_var_1,  var_cas_found COMMA_SOURCE_FILE_AT_LINE (149)) ;
              if ((var_cas_found).isBuiltAndTrue ()) {
                var_cas_vec.appendCString ("1") ;
              }else{
                var_cas_vec.appendCString ("0") ;
              }
            }
          }
        }
        ::routine_generate_vector (_inLexique,  var_cas_vec,  var_cas_init,  var_cas_count COMMA_SOURCE_FILE_AT_LINE (155)) ;
        if (((var_cas_count)._operator_strictSup (GGS_uint (0U))).isBuiltAndTrue ()) {
          var_cas_vectors.appendCString ("u8 ") ;
          var_cas_vectors._dotAssign_operation (operand_2736->mKey.reader_string (_inLexique COMMA_SOURCE_FILE_AT_LINE (157))) ;
          var_cas_vectors.appendCString ("_procs_access[") ;
          var_cas_vectors._dotAssign_operation (var_cas_count.reader_string (_inLexique COMMA_SOURCE_FILE_AT_LINE (157))) ;
          var_cas_vectors.appendCString ("] = {") ;
          var_cas_vectors._dotAssign_operation (var_cas_init) ;
          var_cas_vectors.appendCString ("};\n") ;
          ::routine_doReplace (_inLexique,  var_cas_tpl,  GGS_string ("$PROC_ACCESS$"),  (operand_2736->mKey.reader_string (_inLexique COMMA_SOURCE_FILE_AT_LINE (158)))._operator_concat (GGS_string ("_procs_access")) COMMA_SOURCE_FILE_AT_LINE (158)) ;
        }else{
          ::routine_doReplace (_inLexique,  var_cas_tpl,  GGS_string ("$PROC_ACCESS$"),  GGS_string ("NULL") COMMA_SOURCE_FILE_AT_LINE (160)) ;
        }
        var_cas_vec = GGS_string ("") ;
        {
          GGS_alarm_map::cEnumerator enumerator_4543 (var_cas_alarms, true) ;
          const GGS_alarm_map::cElement * operand_4543 = NULL ;
          while (((operand_4543 = enumerator_4543.nextObject ()))) {
            macroValidPointer (operand_4543) ;
            if ((operand_2736->mInfo.app.reader_alarms (_inLexique COMMA_SOURCE_FILE_AT_LINE (166)).reader_hasKey (_inLexique, operand_4543->mKey.reader_string (_inLexique COMMA_SOURCE_FILE_AT_LINE (166)) COMMA_SOURCE_FILE_AT_LINE (166))).isBuiltAndTrue ()) {
              var_cas_vec.appendCString ("11") ;
            }else{
              var_cas_vec.appendCString ("0") ;
              GGS_bool var_cas_found ;
              GGS_lstring  automatic_var_2 ;
              ::routine_is_in_lstringlist (_inLexique,  operand_4543->mInfo.alarm.reader_acc_apps (_inLexique COMMA_SOURCE_FILE_AT_LINE (171)),  operand_2736->mKey,  automatic_var_2,  var_cas_found COMMA_SOURCE_FILE_AT_LINE (171)) ;
              if ((var_cas_found).isBuiltAndTrue ()) {
                var_cas_vec.appendCString ("1") ;
              }else{
                var_cas_vec.appendCString ("0") ;
              }
            }
          }
        }
        ::routine_generate_vector (_inLexique,  var_cas_vec,  var_cas_init,  var_cas_count COMMA_SOURCE_FILE_AT_LINE (177)) ;
        if (((var_cas_count)._operator_strictSup (GGS_uint (0U))).isBuiltAndTrue ()) {
          var_cas_vectors.appendCString ("u8 ") ;
          var_cas_vectors._dotAssign_operation (operand_2736->mKey.reader_string (_inLexique COMMA_SOURCE_FILE_AT_LINE (179))) ;
          var_cas_vectors.appendCString ("_alarms_access[") ;
          var_cas_vectors._dotAssign_operation (var_cas_count.reader_string (_inLexique COMMA_SOURCE_FILE_AT_LINE (179))) ;
          var_cas_vectors.appendCString ("] = {") ;
          var_cas_vectors._dotAssign_operation (var_cas_init) ;
          var_cas_vectors.appendCString ("};\n") ;
          ::routine_doReplace (_inLexique,  var_cas_tpl,  GGS_string ("$ALARM_ACCESS$"),  (operand_2736->mKey.reader_string (_inLexique COMMA_SOURCE_FILE_AT_LINE (180)))._operator_concat (GGS_string ("_alarms_access")) COMMA_SOURCE_FILE_AT_LINE (180)) ;
        }else{
          ::routine_doReplace (_inLexique,  var_cas_tpl,  GGS_string ("$ALARM_ACCESS$"),  GGS_string ("NULL") COMMA_SOURCE_FILE_AT_LINE (182)) ;
        }
        var_cas_vec = GGS_string ("") ;
        {
          GGS_resource_map::cEnumerator enumerator_5292 (var_cas_rezs, true) ;
          const GGS_resource_map::cElement * operand_5292 = NULL ;
          while (((operand_5292 = enumerator_5292.nextObject ()))) {
            macroValidPointer (operand_5292) ;
            if ((operand_2736->mInfo.app.reader_resources (_inLexique COMMA_SOURCE_FILE_AT_LINE (189)).reader_hasKey (_inLexique, operand_5292->mKey.reader_string (_inLexique COMMA_SOURCE_FILE_AT_LINE (189)) COMMA_SOURCE_FILE_AT_LINE (189))).isBuiltAndTrue ()) {
              var_cas_vec.appendCString ("11") ;
            }else{
              var_cas_vec.appendCString ("0") ;
              GGS_bool var_cas_found ;
              GGS_lstring  automatic_var_3 ;
              ::routine_is_in_lstringlist (_inLexique,  operand_5292->mInfo.resource.reader_acc_apps (_inLexique COMMA_SOURCE_FILE_AT_LINE (194)),  operand_2736->mKey,  automatic_var_3,  var_cas_found COMMA_SOURCE_FILE_AT_LINE (194)) ;
              if ((var_cas_found).isBuiltAndTrue ()) {
                var_cas_vec.appendCString ("1") ;
              }else{
                var_cas_vec.appendCString ("0") ;
              }
            }
          }
        }
        var_cas_vec.appendCString ("01") ;
        ::routine_generate_vector (_inLexique,  var_cas_vec,  var_cas_init,  var_cas_count COMMA_SOURCE_FILE_AT_LINE (204)) ;
        if (((var_cas_count)._operator_strictSup (GGS_uint (0U))).isBuiltAndTrue ()) {
          var_cas_vectors.appendCString ("u8 ") ;
          var_cas_vectors._dotAssign_operation (operand_2736->mKey.reader_string (_inLexique COMMA_SOURCE_FILE_AT_LINE (206))) ;
          var_cas_vectors.appendCString ("_rezs_access[") ;
          var_cas_vectors._dotAssign_operation (var_cas_count.reader_string (_inLexique COMMA_SOURCE_FILE_AT_LINE (206))) ;
          var_cas_vectors.appendCString ("] = {") ;
          var_cas_vectors._dotAssign_operation (var_cas_init) ;
          var_cas_vectors.appendCString ("};\n") ;
          ::routine_doReplace (_inLexique,  var_cas_tpl,  GGS_string ("$REZ_ACCESS$"),  (operand_2736->mKey.reader_string (_inLexique COMMA_SOURCE_FILE_AT_LINE (207)))._operator_concat (GGS_string ("_rezs_access")) COMMA_SOURCE_FILE_AT_LINE (207)) ;
        }else{
          ::routine_doReplace (_inLexique,  var_cas_tpl,  GGS_string ("$REZ_ACCESS$"),  GGS_string ("NULL") COMMA_SOURCE_FILE_AT_LINE (209)) ;
        }
        var_cas_vec = GGS_string ("") ;
        {
          GGS_scheduletable_map::cEnumerator enumerator_6092 (var_cas_sts, true) ;
          const GGS_scheduletable_map::cElement * operand_6092 = NULL ;
          while (((operand_6092 = enumerator_6092.nextObject ()))) {
            macroValidPointer (operand_6092) ;
            if ((operand_2736->mInfo.app.reader_schedtables (_inLexique COMMA_SOURCE_FILE_AT_LINE (216)).reader_hasKey (_inLexique, operand_6092->mKey.reader_string (_inLexique COMMA_SOURCE_FILE_AT_LINE (216)) COMMA_SOURCE_FILE_AT_LINE (216))).isBuiltAndTrue ()) {
              var_cas_vec.appendCString ("11") ;
            }else{
              var_cas_vec.appendCString ("0") ;
              GGS_bool var_cas_found ;
              GGS_lstring  automatic_var_4 ;
              ::routine_is_in_lstringlist (_inLexique,  operand_6092->mInfo.st.reader_acc_apps (_inLexique COMMA_SOURCE_FILE_AT_LINE (221)),  operand_2736->mKey,  automatic_var_4,  var_cas_found COMMA_SOURCE_FILE_AT_LINE (221)) ;
              if ((var_cas_found).isBuiltAndTrue ()) {
                var_cas_vec.appendCString ("1") ;
              }else{
                var_cas_vec.appendCString ("0") ;
              }
            }
          }
        }
        ::routine_generate_vector (_inLexique,  var_cas_vec,  var_cas_init,  var_cas_count COMMA_SOURCE_FILE_AT_LINE (226)) ;
        if (((var_cas_count)._operator_strictSup (GGS_uint (0U))).isBuiltAndTrue ()) {
          var_cas_vectors.appendCString ("u8 ") ;
          var_cas_vectors._dotAssign_operation (operand_2736->mKey.reader_string (_inLexique COMMA_SOURCE_FILE_AT_LINE (228))) ;
          var_cas_vectors.appendCString ("_sts_access[") ;
          var_cas_vectors._dotAssign_operation (var_cas_count.reader_string (_inLexique COMMA_SOURCE_FILE_AT_LINE (228))) ;
          var_cas_vectors.appendCString ("] = {") ;
          var_cas_vectors._dotAssign_operation (var_cas_init) ;
          var_cas_vectors.appendCString ("};\n") ;
          ::routine_doReplace (_inLexique,  var_cas_tpl,  GGS_string ("$ST_ACCESS$"),  (operand_2736->mKey.reader_string (_inLexique COMMA_SOURCE_FILE_AT_LINE (229)))._operator_concat (GGS_string ("_sts_access")) COMMA_SOURCE_FILE_AT_LINE (229)) ;
        }else{
          ::routine_doReplace (_inLexique,  var_cas_tpl,  GGS_string ("$ST_ACCESS$"),  GGS_string ("NULL") COMMA_SOURCE_FILE_AT_LINE (231)) ;
        }
        var_cas_vec = GGS_string ("") ;
        {
          GGS_counter_map::cEnumerator enumerator_6806 (var_cas_cnts, true) ;
          const GGS_counter_map::cElement * operand_6806 = NULL ;
          while (((operand_6806 = enumerator_6806.nextObject ()))) {
            macroValidPointer (operand_6806) ;
            if ((operand_2736->mInfo.app.reader_counters (_inLexique COMMA_SOURCE_FILE_AT_LINE (238)).reader_hasKey (_inLexique, operand_6806->mKey.reader_string (_inLexique COMMA_SOURCE_FILE_AT_LINE (238)) COMMA_SOURCE_FILE_AT_LINE (238))).isBuiltAndTrue ()) {
              var_cas_vec.appendCString ("11") ;
            }else{
              var_cas_vec.appendCString ("0") ;
              GGS_bool var_cas_found ;
              GGS_lstring  automatic_var_5 ;
              ::routine_is_in_lstringlist (_inLexique,  operand_6806->mInfo.counter.reader_acc_apps (_inLexique COMMA_SOURCE_FILE_AT_LINE (243)),  operand_2736->mKey,  automatic_var_5,  var_cas_found COMMA_SOURCE_FILE_AT_LINE (243)) ;
              if ((var_cas_found).isBuiltAndTrue ()) {
                var_cas_vec.appendCString ("1") ;
              }else{
                var_cas_vec.appendCString ("0") ;
              }
            }
          }
        }
        ::routine_generate_vector (_inLexique,  var_cas_vec,  var_cas_init,  var_cas_count COMMA_SOURCE_FILE_AT_LINE (248)) ;
        if (((var_cas_count)._operator_strictSup (GGS_uint (0U))).isBuiltAndTrue ()) {
          var_cas_vectors.appendCString ("u8 ") ;
          var_cas_vectors._dotAssign_operation (operand_2736->mKey.reader_string (_inLexique COMMA_SOURCE_FILE_AT_LINE (250))) ;
          var_cas_vectors.appendCString ("_cnts_access[") ;
          var_cas_vectors._dotAssign_operation (var_cas_count.reader_string (_inLexique COMMA_SOURCE_FILE_AT_LINE (250))) ;
          var_cas_vectors.appendCString ("] = {") ;
          var_cas_vectors._dotAssign_operation (var_cas_init) ;
          var_cas_vectors.appendCString ("};\n") ;
          ::routine_doReplace (_inLexique,  var_cas_tpl,  GGS_string ("$CNT_ACCESS$"),  (operand_2736->mKey.reader_string (_inLexique COMMA_SOURCE_FILE_AT_LINE (251)))._operator_concat (GGS_string ("_cnts_access")) COMMA_SOURCE_FILE_AT_LINE (251)) ;
        }else{
          ::routine_doReplace (_inLexique,  var_cas_tpl,  GGS_string ("$CNT_ACCESS$"),  GGS_string ("NULL") COMMA_SOURCE_FILE_AT_LINE (253)) ;
        }
        ::routine_doReplace (_inLexique,  var_cas_tpl,  GGS_string ("$ACCESS_VEC$"),  var_cas_vectors COMMA_SOURCE_FILE_AT_LINE (256)) ;
        GGS_string var_cas_ownership_vec ;
        var_cas_ownership_vec = GGS_string ("") ;
        GGS_lstringlist  var_cas_procs ;
        var_cas_procs = (operand_2736->mInfo.app.reader_tasks (_inLexique COMMA_SOURCE_FILE_AT_LINE (260)).reader_keyList (_inLexique COMMA_SOURCE_FILE_AT_LINE (260)))._operator_concat (operand_2736->mInfo.app.reader_isrs (_inLexique COMMA_SOURCE_FILE_AT_LINE (260)).reader_keyList (_inLexique COMMA_SOURCE_FILE_AT_LINE (260))) ;
        GGS_string var_cas_table ;
        var_cas_table = GGS_string ("") ;
        {
          GGS_lstringlist::cEnumerator enumerator_7630 (var_cas_procs, true) ;
          const GGS_lstringlist::cElement * operand_7630 = enumerator_7630.nextObject () ;
          if ((operand_7630 != NULL)) {
            var_cas_table = ((((GGS_string ("tpl_proc_id "))._operator_concat (operand_2736->mKey.reader_string (_inLexique COMMA_SOURCE_FILE_AT_LINE (263))))._operator_concat (GGS_string ("_proc_own [")))._operator_concat (var_cas_procs.reader_length (_inLexique COMMA_SOURCE_FILE_AT_LINE (263)).reader_string (_inLexique COMMA_SOURCE_FILE_AT_LINE (263))))._operator_concat (GGS_string ("] = {")) ;
            bool _foreach_loop_7630 ;
            do{
              macroValidPointer (operand_7630) ;
              var_cas_table._dotAssign_operation (operand_7630->mValue.reader_string (_inLexique COMMA_SOURCE_FILE_AT_LINE (264))) ;
              var_cas_table.appendCString ("_id") ;
              operand_7630 = enumerator_7630.nextObject () ;
              _foreach_loop_7630 = ((operand_7630 != NULL)) ;
              if (_foreach_loop_7630) {
                var_cas_table.appendCString (",") ;
              }
            }while (_foreach_loop_7630) ;
            var_cas_table.appendCString ("};\n") ;
          }
        }
        var_cas_ownership_vec._dotAssign_operation (var_cas_table) ;
        ::routine_doReplace (_inLexique,  var_cas_tpl,  GGS_string ("$PROC_COUNT$"),  var_cas_procs.reader_length (_inLexique COMMA_SOURCE_FILE_AT_LINE (269)).reader_string (_inLexique COMMA_SOURCE_FILE_AT_LINE (269)) COMMA_SOURCE_FILE_AT_LINE (269)) ;
        if (((var_cas_table)._operator_isNotEqual (GGS_string (""))).isBuiltAndTrue ()) {
          ::routine_doReplace (_inLexique,  var_cas_tpl,  GGS_string ("$PROC_OWNERSHIP$"),  (operand_2736->mKey.reader_string (_inLexique COMMA_SOURCE_FILE_AT_LINE (271)))._operator_concat (GGS_string ("_proc_own")) COMMA_SOURCE_FILE_AT_LINE (271)) ;
        }else{
          ::routine_doReplace (_inLexique,  var_cas_tpl,  GGS_string ("$PROC_OWNERSHIP$"),  GGS_string ("NULL") COMMA_SOURCE_FILE_AT_LINE (273)) ;
        }
        var_cas_table = GGS_string ("") ;
        {
          GGS_ident_map::cEnumerator enumerator_8165 (operand_2736->mInfo.app.reader_alarms (_inLexique COMMA_SOURCE_FILE_AT_LINE (277)), true) ;
          const GGS_ident_map::cElement * operand_8165 = enumerator_8165.nextObject () ;
          if ((operand_8165 != NULL)) {
            var_cas_table = ((((GGS_string ("tpl_alarm_id "))._operator_concat (operand_2736->mKey.reader_string (_inLexique COMMA_SOURCE_FILE_AT_LINE (278))))._operator_concat (GGS_string ("_alarm_own [")))._operator_concat (operand_2736->mInfo.app.reader_alarms (_inLexique COMMA_SOURCE_FILE_AT_LINE (278)).reader_count (_inLexique COMMA_SOURCE_FILE_AT_LINE (278)).reader_string (_inLexique COMMA_SOURCE_FILE_AT_LINE (278))))._operator_concat (GGS_string ("] = {")) ;
            bool _foreach_loop_8165 ;
            do{
              macroValidPointer (operand_8165) ;
              var_cas_table._dotAssign_operation (operand_8165->mKey.reader_string (_inLexique COMMA_SOURCE_FILE_AT_LINE (279))) ;
              var_cas_table.appendCString ("_id") ;
              operand_8165 = enumerator_8165.nextObject () ;
              _foreach_loop_8165 = ((operand_8165 != NULL)) ;
              if (_foreach_loop_8165) {
                var_cas_table.appendCString (",") ;
              }
            }while (_foreach_loop_8165) ;
            var_cas_table.appendCString ("};\n") ;
          }
        }
        var_cas_ownership_vec._dotAssign_operation (var_cas_table) ;
        ::routine_doReplace (_inLexique,  var_cas_tpl,  GGS_string ("$ALARM_COUNT$"),  operand_2736->mInfo.app.reader_alarms (_inLexique COMMA_SOURCE_FILE_AT_LINE (284)).reader_count (_inLexique COMMA_SOURCE_FILE_AT_LINE (284)).reader_string (_inLexique COMMA_SOURCE_FILE_AT_LINE (284)) COMMA_SOURCE_FILE_AT_LINE (284)) ;
        if (((var_cas_table)._operator_isNotEqual (GGS_string (""))).isBuiltAndTrue ()) {
          ::routine_doReplace (_inLexique,  var_cas_tpl,  GGS_string ("$ALARM_OWNERSHIP$"),  (operand_2736->mKey.reader_string (_inLexique COMMA_SOURCE_FILE_AT_LINE (286)))._operator_concat (GGS_string ("_alarm_own")) COMMA_SOURCE_FILE_AT_LINE (286)) ;
        }else{
          ::routine_doReplace (_inLexique,  var_cas_tpl,  GGS_string ("$ALARM_OWNERSHIP$"),  GGS_string ("NULL") COMMA_SOURCE_FILE_AT_LINE (288)) ;
        }
        var_cas_table = GGS_string ("") ;
        {
          GGS_ident_map::cEnumerator enumerator_8712 (operand_2736->mInfo.app.reader_resources (_inLexique COMMA_SOURCE_FILE_AT_LINE (292)), true) ;
          const GGS_ident_map::cElement * operand_8712 = enumerator_8712.nextObject () ;
          if ((operand_8712 != NULL)) {
            var_cas_table = ((((GGS_string ("tpl_resource_id "))._operator_concat (operand_2736->mKey.reader_string (_inLexique COMMA_SOURCE_FILE_AT_LINE (293))))._operator_concat (GGS_string ("_rez_own [")))._operator_concat (operand_2736->mInfo.app.reader_resources (_inLexique COMMA_SOURCE_FILE_AT_LINE (293)).reader_count (_inLexique COMMA_SOURCE_FILE_AT_LINE (293)).reader_string (_inLexique COMMA_SOURCE_FILE_AT_LINE (293))))._operator_concat (GGS_string ("] = {")) ;
            bool _foreach_loop_8712 ;
            do{
              macroValidPointer (operand_8712) ;
              var_cas_table._dotAssign_operation (operand_8712->mKey.reader_string (_inLexique COMMA_SOURCE_FILE_AT_LINE (294))) ;
              var_cas_table.appendCString ("_id") ;
              operand_8712 = enumerator_8712.nextObject () ;
              _foreach_loop_8712 = ((operand_8712 != NULL)) ;
              if (_foreach_loop_8712) {
                var_cas_table.appendCString (",") ;
              }
            }while (_foreach_loop_8712) ;
            var_cas_table.appendCString ("};\n") ;
          }
        }
        var_cas_ownership_vec._dotAssign_operation (var_cas_table) ;
        ::routine_doReplace (_inLexique,  var_cas_tpl,  GGS_string ("$REZ_COUNT$"),  operand_2736->mInfo.app.reader_resources (_inLexique COMMA_SOURCE_FILE_AT_LINE (299)).reader_count (_inLexique COMMA_SOURCE_FILE_AT_LINE (299)).reader_string (_inLexique COMMA_SOURCE_FILE_AT_LINE (299)) COMMA_SOURCE_FILE_AT_LINE (299)) ;
        if (((var_cas_table)._operator_isNotEqual (GGS_string (""))).isBuiltAndTrue ()) {
          ::routine_doReplace (_inLexique,  var_cas_tpl,  GGS_string ("$REZ_OWNERSHIP$"),  (operand_2736->mKey.reader_string (_inLexique COMMA_SOURCE_FILE_AT_LINE (301)))._operator_concat (GGS_string ("_rez_own")) COMMA_SOURCE_FILE_AT_LINE (301)) ;
        }else{
          ::routine_doReplace (_inLexique,  var_cas_tpl,  GGS_string ("$REZ_OWNERSHIP$"),  GGS_string ("NULL") COMMA_SOURCE_FILE_AT_LINE (303)) ;
        }
        var_cas_table = GGS_string ("") ;
        {
          GGS_ident_map::cEnumerator enumerator_9261 (operand_2736->mInfo.app.reader_schedtables (_inLexique COMMA_SOURCE_FILE_AT_LINE (307)), true) ;
          const GGS_ident_map::cElement * operand_9261 = enumerator_9261.nextObject () ;
          if ((operand_9261 != NULL)) {
            var_cas_table = ((((GGS_string ("tpl_schedtable_id "))._operator_concat (operand_2736->mKey.reader_string (_inLexique COMMA_SOURCE_FILE_AT_LINE (308))))._operator_concat (GGS_string ("_st_own [")))._operator_concat (operand_2736->mInfo.app.reader_schedtables (_inLexique COMMA_SOURCE_FILE_AT_LINE (308)).reader_count (_inLexique COMMA_SOURCE_FILE_AT_LINE (308)).reader_string (_inLexique COMMA_SOURCE_FILE_AT_LINE (308))))._operator_concat (GGS_string ("] = {")) ;
            bool _foreach_loop_9261 ;
            do{
              macroValidPointer (operand_9261) ;
              var_cas_table._dotAssign_operation (operand_9261->mKey.reader_string (_inLexique COMMA_SOURCE_FILE_AT_LINE (309))) ;
              var_cas_table.appendCString ("_id") ;
              operand_9261 = enumerator_9261.nextObject () ;
              _foreach_loop_9261 = ((operand_9261 != NULL)) ;
              if (_foreach_loop_9261) {
                var_cas_table.appendCString (",") ;
              }
            }while (_foreach_loop_9261) ;
            var_cas_table.appendCString ("};\n") ;
          }
        }
        var_cas_ownership_vec._dotAssign_operation (var_cas_table) ;
        ::routine_doReplace (_inLexique,  var_cas_tpl,  GGS_string ("$ST_COUNT$"),  operand_2736->mInfo.app.reader_schedtables (_inLexique COMMA_SOURCE_FILE_AT_LINE (314)).reader_count (_inLexique COMMA_SOURCE_FILE_AT_LINE (314)).reader_string (_inLexique COMMA_SOURCE_FILE_AT_LINE (314)) COMMA_SOURCE_FILE_AT_LINE (314)) ;
        if (((var_cas_table)._operator_isNotEqual (GGS_string (""))).isBuiltAndTrue ()) {
          ::routine_doReplace (_inLexique,  var_cas_tpl,  GGS_string ("$ST_OWNERSHIP$"),  (operand_2736->mKey.reader_string (_inLexique COMMA_SOURCE_FILE_AT_LINE (316)))._operator_concat (GGS_string ("_st_own")) COMMA_SOURCE_FILE_AT_LINE (316)) ;
        }else{
          ::routine_doReplace (_inLexique,  var_cas_tpl,  GGS_string ("$ST_OWNERSHIP$"),  GGS_string ("NULL") COMMA_SOURCE_FILE_AT_LINE (318)) ;
        }
        var_cas_table = GGS_string ("") ;
        {
          GGS_ident_map::cEnumerator enumerator_9813 (operand_2736->mInfo.app.reader_counters (_inLexique COMMA_SOURCE_FILE_AT_LINE (322)), true) ;
          const GGS_ident_map::cElement * operand_9813 = enumerator_9813.nextObject () ;
          if ((operand_9813 != NULL)) {
            var_cas_table = ((((GGS_string ("tpl_counter_id "))._operator_concat (operand_2736->mKey.reader_string (_inLexique COMMA_SOURCE_FILE_AT_LINE (323))))._operator_concat (GGS_string ("_cnt_own [")))._operator_concat (operand_2736->mInfo.app.reader_counters (_inLexique COMMA_SOURCE_FILE_AT_LINE (323)).reader_count (_inLexique COMMA_SOURCE_FILE_AT_LINE (323)).reader_string (_inLexique COMMA_SOURCE_FILE_AT_LINE (323))))._operator_concat (GGS_string ("] = {")) ;
            bool _foreach_loop_9813 ;
            do{
              macroValidPointer (operand_9813) ;
              var_cas_table._dotAssign_operation (operand_9813->mKey.reader_string (_inLexique COMMA_SOURCE_FILE_AT_LINE (324))) ;
              var_cas_table.appendCString ("_id") ;
              operand_9813 = enumerator_9813.nextObject () ;
              _foreach_loop_9813 = ((operand_9813 != NULL)) ;
              if (_foreach_loop_9813) {
                var_cas_table.appendCString (",") ;
              }
            }while (_foreach_loop_9813) ;
            var_cas_table.appendCString ("};\n") ;
          }
        }
        var_cas_ownership_vec._dotAssign_operation (var_cas_table) ;
        ::routine_doReplace (_inLexique,  var_cas_tpl,  GGS_string ("$CNT_COUNT$"),  operand_2736->mInfo.app.reader_counters (_inLexique COMMA_SOURCE_FILE_AT_LINE (329)).reader_count (_inLexique COMMA_SOURCE_FILE_AT_LINE (329)).reader_string (_inLexique COMMA_SOURCE_FILE_AT_LINE (329)) COMMA_SOURCE_FILE_AT_LINE (329)) ;
        if (((var_cas_table)._operator_isNotEqual (GGS_string (""))).isBuiltAndTrue ()) {
          ::routine_doReplace (_inLexique,  var_cas_tpl,  GGS_string ("$CNT_OWNERSHIP$"),  (operand_2736->mKey.reader_string (_inLexique COMMA_SOURCE_FILE_AT_LINE (331)))._operator_concat (GGS_string ("_cnt_own")) COMMA_SOURCE_FILE_AT_LINE (331)) ;
        }else{
          ::routine_doReplace (_inLexique,  var_cas_tpl,  GGS_string ("$CNT_OWNERSHIP$"),  GGS_string ("NULL") COMMA_SOURCE_FILE_AT_LINE (333)) ;
        }
        { const GGS_basic_type _var_10574 = operand_2736->mInfo.app.reader_restart (_inLexique COMMA_SOURCE_FILE_AT_LINE (339)) ; // CAST instruction
          if (_var_10574.getPtr () != NULL) {
            macroValidPointer (_var_10574.getPtr ()) ;
            if (typeid (cPtr_string_class) == typeid (* (_var_10574.getPtr ()))) {
              const GGS_string_class var_cas_rst (_var_10574.getPtr ()) ;
              ::routine_doReplace (_inLexique,  var_cas_tpl,  GGS_string ("$RESTART$"),  (var_cas_rst.reader_value (_inLexique COMMA_SOURCE_FILE_AT_LINE (341)))._operator_concat (GGS_string ("_id")) COMMA_SOURCE_FILE_AT_LINE (341)) ;
            }else{
              ::routine_doReplace (_inLexique,  var_cas_tpl,  GGS_string ("$RESTART$"),  GGS_string ("INVALID_TASK_ID") COMMA_SOURCE_FILE_AT_LINE (343)) ;
            }
          }
        }
        ::routine_doReplace (_inLexique,  var_cas_tpl,  GGS_string ("$OWNERSHIP_VEC$"),  var_cas_ownership_vec COMMA_SOURCE_FILE_AT_LINE (346)) ;
        var_cas_res._dotAssign_operation (var_cas_tpl) ;
        var_cas_n.mValue ++ ;
      }
    }
    var_cas_res.appendCString ("CONSTP2CONST(tpl_app_access, AUTOMATIC, OS_APPL_CONST) tpl_app_table[APP_COUNT] = {\n") ;
    var_cas_res.appendCString ("  ") ;
    var_cas_res._dotAssign_operation (GGS_string::constructor_componentsJoinedByString (_inLexique, var_cas_app_list, GGS_string (",\n"
      "  ") COMMA_HERE)) ;
    var_cas_res.appendCString ("\n"
      "};\n") ;
  }
  ::routine_doReplace (_inLexique,  var_cas_imp,  GGS_string ("$OSAPPLICATIONS$"),  var_cas_res COMMA_SOURCE_FILE_AT_LINE (358)) ;
  ::routine_doReplace (_inLexique,  var_cas_imp,  GGS_string ("$OSAPPIDS$"),  var_cas_ids COMMA_SOURCE_FILE_AT_LINE (359)) ;
  #ifdef DEBUG_TRACE_ENABLED
    printf ("LEAVE routine_generate_apps\n") ;
  #endif
}

//---------------------------------------------------------------------------*
//                                                                           *
//          Implementation of routine "generate_trusted_functions"           *
//                                                                           *
//---------------------------------------------------------------------------*

void routine_generate_trusted_functions (C_Compiler & _inLexique,
                                GGS_app_map   var_cas_apps,
                                GGS_string & /* var_cas_head */,
                                GGS_string & var_cas_obj_head,
                                GGS_string & var_cas_imp COMMA_UNUSED_LOCATION_ARGS) {
  #ifdef DEBUG_TRACE_ENABLED
    printf ("ENTER routine_generate_trusted_functions at %s:%d\n", __FILE__, __LINE__) ;
  #endif
  GGS_stringset  var_cas_tfs ;
  var_cas_tfs = GGS_stringset ::constructor_emptySet () ;
  {
    GGS_app_map::cEnumerator enumerator_11299 (var_cas_apps, true) ;
    const GGS_app_map::cElement * operand_11299 = NULL ;
    while (((operand_11299 = enumerator_11299.nextObject ()))) {
      macroValidPointer (operand_11299) ;
      { const GGS_app_trusted_obj _var_11461 = operand_11299->mInfo.app.reader_trusted (_inLexique COMMA_SOURCE_FILE_AT_LINE (376)) ; // CAST instruction
        if (_var_11461.getPtr () != NULL) {
          macroValidPointer (_var_11461.getPtr ()) ;
          if (typeid (cPtr_app_trusted_true) == typeid (* (_var_11461.getPtr ()))) {
            const GGS_app_trusted_true var_cas_t (_var_11461.getPtr ()) ;
            {
              GGS_stringset::cEnumerator enumerator_11378 (var_cas_t.reader_trusted_fcts (_inLexique COMMA_SOURCE_FILE_AT_LINE (378)), true) ;
              while (enumerator_11378.hc ()) {
                var_cas_tfs._addAssign_operation (enumerator_11378._key (HERE)) ;
                enumerator_11378.next () ;
              }
            }
          }else{
          }
        }
      }
    }
  }
  GGS_string var_cas_fcts ;
  var_cas_fcts = GGS_string ("") ;
  GGS_string var_cas_fct_ids ;
  var_cas_fct_ids = GGS_string ("") ;
  GGS_string var_cas_fct_table ;
  var_cas_fct_table = GGS_string ("") ;
  GGS_uint  var_cas_tf_id ;
  var_cas_tf_id = GGS_uint (0U) ;
  {
    GGS_stringset::cEnumerator enumerator_11598 (var_cas_tfs, true) ;
    if (enumerator_11598 .hc ()) {
      var_cas_fct_table = GGS_string ("CONST(tpl_trusted_fct, OS_APPL_CODE)\n") ;
      var_cas_fct_table.appendCString ("  tpl_trusted_fct_table[TRUSTED_FCT_COUNT] = {\n") ;
      bool _foreach_loop_11598 ;
      do{
        var_cas_fcts.appendCString ("FUNC(void, OS_APPL_CODE) TRUSTED_") ;
        var_cas_fcts._dotAssign_operation (enumerator_11598._key (HERE)) ;
        var_cas_fcts.appendCString ("(\n") ;
        var_cas_fcts.appendCString ("  CONST(TrustedFunctionIndexType, AUTOMATIC) idx,\n") ;
        var_cas_fcts.appendCString ("  CONST(TrustedFunctionParameterRefType, AUTOMATIC) params);\n") ;
        var_cas_fct_ids.appendCString ("#define ") ;
        var_cas_fct_ids._dotAssign_operation (enumerator_11598._key (HERE)) ;
        var_cas_fct_ids.appendCString ("_id    ") ;
        var_cas_fct_ids._dotAssign_operation (var_cas_tf_id.reader_string (_inLexique COMMA_SOURCE_FILE_AT_LINE (397))) ;
        var_cas_fct_ids.appendCString ("\n") ;
        var_cas_fct_ids.appendCString ("CONST(TrustedFunctionIndexType, AUTOMATIC) ") ;
        var_cas_fct_ids._dotAssign_operation (enumerator_11598._key (HERE)) ;
        var_cas_fct_ids.appendCString (" = ") ;
        var_cas_fct_ids._dotAssign_operation (enumerator_11598._key (HERE)) ;
        var_cas_fct_ids.appendCString ("_id;\n") ;
        var_cas_fct_table.appendCString ("  TRUSTED_") ;
        var_cas_fct_table._dotAssign_operation (enumerator_11598._key (HERE)) ;
        var_cas_tf_id._increment_operation (_inLexique COMMA_SOURCE_FILE_AT_LINE (400)) ;
        enumerator_11598.next () ;
        _foreach_loop_11598 = (enumerator_11598 .hc ()) ;
        if (_foreach_loop_11598) {
          var_cas_fct_table.appendCString (",\n") ;
        }
      }while (_foreach_loop_11598) ;
      var_cas_fct_table.appendCString ("\n"
        "};\n") ;
    }
  }
  ::routine_doReplace (_inLexique,  var_cas_imp,  GGS_string ("$TRUSTED_IDS$"),  var_cas_fct_ids COMMA_SOURCE_FILE_AT_LINE (407)) ;
  ::routine_doReplace (_inLexique,  var_cas_imp,  GGS_string ("$TRUSTED_FCTS$"),  var_cas_fcts COMMA_SOURCE_FILE_AT_LINE (408)) ;
  ::routine_doReplace (_inLexique,  var_cas_imp,  GGS_string ("$TRUSTED_TABLE$"),  var_cas_fct_table COMMA_SOURCE_FILE_AT_LINE (409)) ;
  ::routine_doReplace (_inLexique,  var_cas_obj_head,  GGS_string ("$TRUSTED_FCT_COUNT$"),  var_cas_tf_id.reader_string (_inLexique COMMA_SOURCE_FILE_AT_LINE (410)) COMMA_SOURCE_FILE_AT_LINE (410)) ;
  #ifdef DEBUG_TRACE_ENABLED
    printf ("LEAVE routine_generate_trusted_functions\n") ;
  #endif
}

//---------------------------------------------------------------------------*

