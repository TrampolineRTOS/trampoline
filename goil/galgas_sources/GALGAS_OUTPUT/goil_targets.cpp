//---------------------------------------------------------------------------*
//                                                                           *
//                         File 'goil_targets.cpp'                           *
//                        Generated by version 1.9.6                         *
//                    december 10th, 2009, at 13h41'27"                      *
//                                                                           *
//---------------------------------------------------------------------------*

//--- START OF USER ZONE 1


//--- END OF USER ZONE 1

//---------------------------------------------------------------------------*

#include "version_libpm.h"
#if LIBPM_VERSION != 621
  #error "This file has been compiled with a version of GALGAS different than the version of libpm"
#endif

//---------------------------------------------------------------------------*

#include <typeinfo>
#include "utilities/MF_MemoryControl.h"
#include "files/C_TextFileWrite.h"
#include "galgas/C_galgas_CLI_Options.h"
#include "goil_targets.h"

//---------------------------------------------------------------------------*

#ifndef DO_NOT_GENERATE_CHECKINGS
  #define SOURCE_FILE_AT_LINE(line) "goil_targets.ggs", line
  #define COMMA_SOURCE_FILE_AT_LINE(line) , SOURCE_FILE_AT_LINE(line)
#else
  #define SOURCE_FILE_AT_LINE(line) 
  #define COMMA_SOURCE_FILE_AT_LINE(line) 
#endif


//--- START OF USER ZONE 2


//--- END OF USER ZONE 2

//---------------------------------------------------------------------------*
//                                                                           *
//          Implementation of routine "generate_context_and_stack"           *
//                                                                           *
//---------------------------------------------------------------------------*

void routine_generate_context_and_stack (C_Compiler & inLexique,
                                GGS_config   var_cas_cfg,
                                GGS_lstring   var_cas_name,
                                GGS_oil_obj   var_cas_exe,
                                GGS_string & var_cas_result COMMA_UNUSED_LOCATION_ARGS) {
  #ifdef DEBUG_TRACE_ENABLED
    printf ("ENTER routine_generate_context_and_stack at %s:%d\n", __FILE__, __LINE__) ;
  #endif
  GGS_string var_cas_tpl_context_and_stack = GGS_string ("") ;
  GGS_string var_cas_context_and_stack = GGS_string ("") ;
  GGS_ident_map  var_cas_idents = GGS_ident_map ::constructor_emptyMap (inLexique COMMA_HERE) ;
  GGS_attrs  var_cas_attrs = GGS_attrs ::constructor_new (inLexique, GGS_location (inLexique), GGS_cfg_attrs ::constructor_emptyMap (inLexique COMMA_HERE) COMMA_HERE) ;
  GGS_string var_cas_target = function_arch (inLexique COMMA_SOURCE_FILE_AT_LINE (63)) ;
  { const GGS_oil_obj _var_3319 = var_cas_exe ; // CAST instruction
    if (_var_3319.getPtr () != NULL) {
      macroValidPointer (_var_3319.getPtr ()) ;
      if (typeid (cPtr_task_obj) == typeid (* (_var_3319.getPtr ()))) {
        const GGS_task_obj var_cas_tk (_var_3319.getPtr ()) ;
        var_cas_tpl_context_and_stack = function_template_string (inLexique, GGS_string ("code"), GGS_string ("each_task_specific") COMMA_SOURCE_FILE_AT_LINE (67)) ;
        var_cas_context_and_stack = var_cas_tpl_context_and_stack ;
        var_cas_idents = var_cas_tk.reader_others (inLexique COMMA_SOURCE_FILE_AT_LINE (69)) ;
        GGS_basic_type  var_cas_b_attrs ;
        const GGS_config  temp_2598 = var_cas_cfg ;
        if (temp_2598.isBuilt ()) {
          temp_2598 (HERE)->method_get (inLexique, GGS_lstring ::constructor_new (inLexique, GGS_string ("task_attrs"), GGS_location (inLexique) COMMA_HERE), var_cas_b_attrs COMMA_SOURCE_FILE_AT_LINE (71)) ;
        }
        { const GGS_basic_type _var_2798 = var_cas_b_attrs ; // CAST instruction
          if (_var_2798.getPtr () != NULL) {
            macroValidPointer (_var_2798.getPtr ()) ;
            if (typeid (cPtr_attrs) == typeid (* (_var_2798.getPtr ()))) {
              const GGS_attrs var_cas_at (_var_2798.getPtr ()) ;
              var_cas_attrs = var_cas_at ;
            }else{
              GGS_location (inLexique).reader_location (inLexique COMMA_HERE).signalGGSSemanticError (inLexique, GGS_string ("Internal error, unknown config task attributes") COMMA_SOURCE_FILE_AT_LINE (75)) ;
            }
          }
        }
      }else if (typeid (cPtr_isr_obj) == typeid (* (_var_3319.getPtr ()))) {
        const GGS_isr_obj var_cas_isr (_var_3319.getPtr ()) ;
        var_cas_tpl_context_and_stack = function_template_string (inLexique, GGS_string ("code"), GGS_string ("each_isr_specific") COMMA_SOURCE_FILE_AT_LINE (77)) ;
        var_cas_context_and_stack = var_cas_tpl_context_and_stack ;
        var_cas_idents = var_cas_isr.reader_other_fields (inLexique COMMA_SOURCE_FILE_AT_LINE (79)) ;
        GGS_basic_type  var_cas_b_attrs ;
        const GGS_config  temp_3048 = var_cas_cfg ;
        if (temp_3048.isBuilt ()) {
          temp_3048 (HERE)->method_get (inLexique, GGS_lstring ::constructor_new (inLexique, GGS_string ("isr_attrs"), GGS_location (inLexique) COMMA_HERE), var_cas_b_attrs COMMA_SOURCE_FILE_AT_LINE (81)) ;
        }
        { const GGS_basic_type _var_3246 = var_cas_b_attrs ; // CAST instruction
          if (_var_3246.getPtr () != NULL) {
            macroValidPointer (_var_3246.getPtr ()) ;
            if (typeid (cPtr_attrs) == typeid (* (_var_3246.getPtr ()))) {
              const GGS_attrs var_cas_at (_var_3246.getPtr ()) ;
              var_cas_attrs = var_cas_at ;
            }else{
              GGS_location (inLexique).reader_location (inLexique COMMA_HERE).signalGGSSemanticError (inLexique, GGS_string ("Internal error, unknown config isr attributes") COMMA_SOURCE_FILE_AT_LINE (85)) ;
            }
          }
        }
      }else{
        var_cas_name.reader_location (inLexique COMMA_HERE).signalGGSSemanticError (inLexique, GGS_string ("Unknown executable object") COMMA_SOURCE_FILE_AT_LINE (88)) ;
      }
    }
  }
  const GGS_bool cond_3435 = (var_cas_target).operator_isEqual (GGS_string ("c166")) ;
  if (cond_3435.isBuiltAndTrue ()) {
    ::routine_generate_target_c166 (inLexique,  var_cas_name,  var_cas_idents,  var_cas_exe,  var_cas_context_and_stack COMMA_SOURCE_FILE_AT_LINE (91)) ;
  }else if (cond_3435.isBuiltAndFalse ()) {
    const GGS_bool cond_3538 = (var_cas_target).operator_isEqual (GGS_string ("libpcl")) ;
    if (cond_3538.isBuiltAndTrue ()) {
      ::routine_generate_target_libpcl (inLexique,  var_cas_name,  var_cas_idents,  var_cas_exe,  var_cas_context_and_stack COMMA_SOURCE_FILE_AT_LINE (93)) ;
    }else if (cond_3538.isBuiltAndFalse ()) {
      const GGS_bool cond_3639 = (var_cas_target).operator_isEqual (GGS_string ("posix")) ;
      if (cond_3639.isBuiltAndTrue ()) {
        ::routine_generate_target_posix (inLexique,  var_cas_name,  var_cas_idents,  var_cas_exe,  var_cas_context_and_stack COMMA_SOURCE_FILE_AT_LINE (95)) ;
      }else if (cond_3639.isBuiltAndFalse ()) {
        const GGS_bool cond_3748 = (var_cas_target).operator_isEqual (GGS_string ("posix_vp2")) ;
        if (cond_3748.isBuiltAndTrue ()) {
          ::routine_generate_target_posix_vp2 (inLexique,  var_cas_name,  var_cas_idents,  var_cas_exe,  var_cas_context_and_stack COMMA_SOURCE_FILE_AT_LINE (97)) ;
        }else if (cond_3748.isBuiltAndFalse ()) {
          const GGS_bool cond_3850 = (var_cas_target).operator_isEqual (GGS_string ("hcs12")) ;
          if (cond_3850.isBuiltAndTrue ()) {
            ::routine_generate_target_hcs12 (inLexique,  var_cas_name,  var_cas_idents,  var_cas_exe,  var_cas_context_and_stack COMMA_SOURCE_FILE_AT_LINE (99)) ;
          }else if (cond_3850.isBuiltAndFalse ()) {
            const GGS_bool cond_3948 = (var_cas_target).operator_isEqual (GGS_string ("ppc")) ;
            if (cond_3948.isBuiltAndTrue ()) {
              ::routine_generate_target_ppc (inLexique,  var_cas_name,  var_cas_idents,  var_cas_exe,  var_cas_context_and_stack COMMA_SOURCE_FILE_AT_LINE (101)) ;
            }else if (cond_3948.isBuiltAndFalse ()) {
              const GGS_bool cond_4050 = (var_cas_target).operator_isEqual (GGS_string ("v850e")) ;
              if (cond_4050.isBuiltAndTrue ()) {
                ::routine_generate_target_v850e (inLexique,  var_cas_name,  var_cas_idents,  var_cas_exe,  var_cas_context_and_stack COMMA_SOURCE_FILE_AT_LINE (103)) ;
              }else if (cond_4050.isBuiltAndFalse ()) {
                const GGS_bool cond_4154 = (var_cas_target).operator_isEqual (GGS_string ("h8300h")) ;
                if (cond_4154.isBuiltAndTrue ()) {
                  ::routine_generate_target_h8300h (inLexique,  var_cas_name,  var_cas_idents,  var_cas_exe,  var_cas_context_and_stack COMMA_SOURCE_FILE_AT_LINE (105)) ;
                }else if (cond_4154.isBuiltAndFalse ()) {
                  const GGS_bool cond_4253 = (var_cas_target).operator_isEqual (GGS_string ("arm")) ;
                  if (cond_4253.isBuiltAndTrue ()) {
                    ::routine_generate_target_arm7 (inLexique,  var_cas_name,  var_cas_idents,  var_cas_exe,  var_cas_context_and_stack COMMA_SOURCE_FILE_AT_LINE (107)) ;
                  }else if (cond_4253.isBuiltAndFalse ()) {
                    const GGS_bool cond_4351 = (var_cas_target).operator_isEqual (GGS_string ("avr")) ;
                    if (cond_4351.isBuiltAndTrue ()) {
                      ::routine_generate_target_avr (inLexique,  var_cas_name,  var_cas_idents,  var_cas_exe,  var_cas_context_and_stack COMMA_SOURCE_FILE_AT_LINE (109)) ;
                    }else if (cond_4351.isBuiltAndFalse ()) {
                      const GGS_bool cond_4461 = (var_cas_target).operator_isEqual (GGS_string ("cortex-m3")) ;
                      if (cond_4461.isBuiltAndTrue ()) {
                        ::routine_generate_target_cortex_m3 (inLexique,  var_cas_name,  var_cas_idents,  var_cas_exe,  var_cas_context_and_stack COMMA_SOURCE_FILE_AT_LINE (111)) ;
                      }else if (cond_4461.isBuiltAndFalse ()) {
                        GGS_location (inLexique).reader_location (inLexique COMMA_HERE).signalGGSSemanticError (inLexique, (GGS_string ("unknown target: ")).operator_concat (var_cas_target) COMMA_SOURCE_FILE_AT_LINE (115)) ;
                      }
                    }
                  }
                }
              }
            }
          }
        }
      }
    }
  }
  var_cas_result = (var_cas_result).operator_concat (var_cas_context_and_stack) ;
  #ifdef DEBUG_TRACE_ENABLED
    printf ("LEAVE routine_generate_context_and_stack\n") ;
  #endif
}

//---------------------------------------------------------------------------*
//                                                                           *
//            Implementation of routine "generate_isr_specific"              *
//                                                                           *
//---------------------------------------------------------------------------*

void routine_generate_isr_specific (C_Compiler & inLexique,
                                const GGS_isr_map   var_cas_isrs,
                                GGS_string & var_cas_code COMMA_UNUSED_LOCATION_ARGS) {
  #ifdef DEBUG_TRACE_ENABLED
    printf ("ENTER routine_generate_isr_specific at %s:%d\n", __FILE__, __LINE__) ;
  #endif
  GGS_string var_cas_target = function_arch (inLexique COMMA_SOURCE_FILE_AT_LINE (124)) ;
  var_cas_code = function_template_string (inLexique, GGS_string ("code"), GGS_string ("isr_specific") COMMA_SOURCE_FILE_AT_LINE (126)) ;
  const GGS_bool cond_4834 = (var_cas_target).operator_isEqual (GGS_string ("c166")) ;
  if (cond_4834.isBuiltAndTrue ()) {
    ::routine_generate_isr_c166 (inLexique,  var_cas_isrs,  var_cas_code COMMA_SOURCE_FILE_AT_LINE (129)) ;
  }else if (cond_4834.isBuiltAndFalse ()) {
    const GGS_bool cond_4908 = (var_cas_target).operator_isEqual (GGS_string ("libpcl")) ;
    if (cond_4908.isBuiltAndTrue ()) {
      ::routine_generate_isr_libpcl (inLexique,  var_cas_isrs,  var_cas_code COMMA_SOURCE_FILE_AT_LINE (131)) ;
    }else if (cond_4908.isBuiltAndFalse ()) {
      const GGS_bool cond_4980 = (var_cas_target).operator_isEqual (GGS_string ("posix")) ;
      if (cond_4980.isBuiltAndTrue ()) {
        ::routine_generate_isr_posix (inLexique,  var_cas_isrs,  var_cas_code COMMA_SOURCE_FILE_AT_LINE (133)) ;
      }else if (cond_4980.isBuiltAndFalse ()) {
        const GGS_bool cond_5060 = (var_cas_target).operator_isEqual (GGS_string ("posix_vp2")) ;
        if (cond_5060.isBuiltAndTrue ()) {
          ::routine_generate_isr_posix_vp2 (inLexique,  var_cas_isrs,  var_cas_code COMMA_SOURCE_FILE_AT_LINE (135)) ;
        }else if (cond_5060.isBuiltAndFalse ()) {
          const GGS_bool cond_5133 = (var_cas_target).operator_isEqual (GGS_string ("hcs12")) ;
          if (cond_5133.isBuiltAndTrue ()) {
            ::routine_generate_isr_hcs12 (inLexique,  var_cas_isrs,  var_cas_code COMMA_SOURCE_FILE_AT_LINE (137)) ;
          }else if (cond_5133.isBuiltAndFalse ()) {
            const GGS_bool cond_5202 = (var_cas_target).operator_isEqual (GGS_string ("ppc")) ;
            if (cond_5202.isBuiltAndTrue ()) {
              ::routine_generate_isr_ppc (inLexique,  var_cas_isrs,  var_cas_code COMMA_SOURCE_FILE_AT_LINE (139)) ;
            }else if (cond_5202.isBuiltAndFalse ()) {
              const GGS_bool cond_5275 = (var_cas_target).operator_isEqual (GGS_string ("v850e")) ;
              if (cond_5275.isBuiltAndTrue ()) {
                ::routine_generate_isr_v850e (inLexique,  var_cas_isrs,  var_cas_code COMMA_SOURCE_FILE_AT_LINE (141)) ;
              }else if (cond_5275.isBuiltAndFalse ()) {
                const GGS_bool cond_5350 = (var_cas_target).operator_isEqual (GGS_string ("h8300h")) ;
                if (cond_5350.isBuiltAndTrue ()) {
                  ::routine_generate_isr_h8300h (inLexique,  var_cas_isrs,  var_cas_code COMMA_SOURCE_FILE_AT_LINE (143)) ;
                }else if (cond_5350.isBuiltAndFalse ()) {
                  const GGS_bool cond_5420 = (var_cas_target).operator_isEqual (GGS_string ("arm")) ;
                  if (cond_5420.isBuiltAndTrue ()) {
                    ::routine_generate_isr_arm7 (inLexique,  var_cas_isrs,  var_cas_code COMMA_SOURCE_FILE_AT_LINE (145)) ;
                  }else if (cond_5420.isBuiltAndFalse ()) {
                    const GGS_bool cond_5489 = (var_cas_target).operator_isEqual (GGS_string ("avr")) ;
                    if (cond_5489.isBuiltAndTrue ()) {
                      ::routine_generate_isr_avr (inLexique,  var_cas_isrs,  var_cas_code COMMA_SOURCE_FILE_AT_LINE (147)) ;
                    }else if (cond_5489.isBuiltAndFalse ()) {
                      const GGS_bool cond_5569 = (var_cas_target).operator_isEqual (GGS_string ("cortex-m3")) ;
                      if (cond_5569.isBuiltAndTrue ()) {
                        ::routine_generate_isr_cortex_m3 (inLexique,  var_cas_isrs,  var_cas_code COMMA_SOURCE_FILE_AT_LINE (149)) ;
                      }else if (cond_5569.isBuiltAndFalse ()) {
                        GGS_location (inLexique).reader_location (inLexique COMMA_HERE).signalGGSSemanticError (inLexique, (GGS_string ("unknown target: ")).operator_concat (var_cas_target) COMMA_SOURCE_FILE_AT_LINE (152)) ;
                      }
                    }
                  }
                }
              }
            }
          }
        }
      }
    }
  }
  #ifdef DEBUG_TRACE_ENABLED
    printf ("LEAVE routine_generate_isr_specific\n") ;
  #endif
}

//---------------------------------------------------------------------------*
//                                                                           *
//         Implementation of routine "generate_counter_for_target"           *
//                                                                           *
//---------------------------------------------------------------------------*

void routine_generate_counter_for_target (C_Compiler & inLexique,
                                const GGS_string  var_cas_target,
                                const GGS_counter_map   var_cas_counters,
                                GGS_string & var_cas_code COMMA_UNUSED_LOCATION_ARGS) {
  #ifdef DEBUG_TRACE_ENABLED
    printf ("ENTER routine_generate_counter_for_target at %s:%d\n", __FILE__, __LINE__) ;
  #endif
  const GGS_bool cond_5831 = (var_cas_target).operator_isEqual (GGS_string ("c166")) ;
  if (cond_5831.isBuiltAndTrue ()) {
    ::routine_generate_counter_c166 (inLexique,  var_cas_counters,  var_cas_code COMMA_SOURCE_FILE_AT_LINE (161)) ;
  }else if (cond_5831.isBuiltAndFalse ()) {
    const GGS_bool cond_5909 = (var_cas_target).operator_isEqual (GGS_string ("libpcl")) ;
    if (cond_5909.isBuiltAndTrue ()) {
      ::routine_generate_counter_libpcl (inLexique,  var_cas_counters,  var_cas_code COMMA_SOURCE_FILE_AT_LINE (163)) ;
    }else if (cond_5909.isBuiltAndFalse ()) {
      const GGS_bool cond_5984 = (var_cas_target).operator_isEqual (GGS_string ("posix")) ;
      if (cond_5984.isBuiltAndTrue ()) {
        ::routine_generate_counter_posix (inLexique,  var_cas_counters,  var_cas_code COMMA_SOURCE_FILE_AT_LINE (165)) ;
      }else if (cond_5984.isBuiltAndFalse ()) {
        const GGS_bool cond_6065 = (var_cas_target).operator_isEqual (GGS_string ("posix_vp2")) ;
        if (cond_6065.isBuiltAndTrue ()) {
          ::routine_generate_counter_posix_vp2 (inLexique,  var_cas_counters,  var_cas_code COMMA_SOURCE_FILE_AT_LINE (167)) ;
        }else if (cond_6065.isBuiltAndFalse ()) {
          const GGS_bool cond_6141 = (var_cas_target).operator_isEqual (GGS_string ("hcs12")) ;
          if (cond_6141.isBuiltAndTrue ()) {
            ::routine_generate_counter_hcs12 (inLexique,  var_cas_counters,  var_cas_code COMMA_SOURCE_FILE_AT_LINE (169)) ;
          }else if (cond_6141.isBuiltAndFalse ()) {
            const GGS_bool cond_6213 = (var_cas_target).operator_isEqual (GGS_string ("ppc")) ;
            if (cond_6213.isBuiltAndTrue ()) {
              ::routine_generate_counter_ppc (inLexique,  var_cas_counters,  var_cas_code COMMA_SOURCE_FILE_AT_LINE (171)) ;
            }else if (cond_6213.isBuiltAndFalse ()) {
              const GGS_bool cond_6289 = (var_cas_target).operator_isEqual (GGS_string ("v850e")) ;
              if (cond_6289.isBuiltAndTrue ()) {
                ::routine_generate_counter_v850e (inLexique,  var_cas_counters,  var_cas_code COMMA_SOURCE_FILE_AT_LINE (173)) ;
              }else if (cond_6289.isBuiltAndFalse ()) {
                const GGS_bool cond_6367 = (var_cas_target).operator_isEqual (GGS_string ("h8300h")) ;
                if (cond_6367.isBuiltAndTrue ()) {
                  ::routine_generate_counter_h8300h (inLexique,  var_cas_counters,  var_cas_code COMMA_SOURCE_FILE_AT_LINE (175)) ;
                }else if (cond_6367.isBuiltAndFalse ()) {
                  const GGS_bool cond_6440 = (var_cas_target).operator_isEqual (GGS_string ("arm")) ;
                  if (cond_6440.isBuiltAndTrue ()) {
                    ::routine_generate_counter_arm7 (inLexique,  var_cas_counters,  var_cas_code COMMA_SOURCE_FILE_AT_LINE (177)) ;
                  }else if (cond_6440.isBuiltAndFalse ()) {
                    const GGS_bool cond_6512 = (var_cas_target).operator_isEqual (GGS_string ("avr")) ;
                    if (cond_6512.isBuiltAndTrue ()) {
                      ::routine_generate_counter_avr (inLexique,  var_cas_counters,  var_cas_code COMMA_SOURCE_FILE_AT_LINE (179)) ;
                    }else if (cond_6512.isBuiltAndFalse ()) {
                      const GGS_bool cond_6595 = (var_cas_target).operator_isEqual (GGS_string ("cortex-m3")) ;
                      if (cond_6595.isBuiltAndTrue ()) {
                        ::routine_generate_counter_cortex_m3 (inLexique,  var_cas_counters,  var_cas_code COMMA_SOURCE_FILE_AT_LINE (181)) ;
                      }else if (cond_6595.isBuiltAndFalse ()) {
                        GGS_location (inLexique).reader_location (inLexique COMMA_HERE).signalGGSSemanticError (inLexique, (GGS_string ("unknown target: ")).operator_concat (var_cas_target) COMMA_SOURCE_FILE_AT_LINE (184)) ;
                      }
                    }
                  }
                }
              }
            }
          }
        }
      }
    }
  }
  #ifdef DEBUG_TRACE_ENABLED
    printf ("LEAVE routine_generate_counter_for_target\n") ;
  #endif
}

//---------------------------------------------------------------------------*
//                                                                           *
//          Implementation of routine "generate_counter_specific"            *
//                                                                           *
//---------------------------------------------------------------------------*

void routine_generate_counter_specific (C_Compiler & inLexique,
                                const GGS_counter_map   var_cas_counters,
                                GGS_string & var_cas_code COMMA_UNUSED_LOCATION_ARGS) {
  #ifdef DEBUG_TRACE_ENABLED
    printf ("ENTER routine_generate_counter_specific at %s:%d\n", __FILE__, __LINE__) ;
  #endif
  GGS_string var_cas_target = function_arch (inLexique COMMA_SOURCE_FILE_AT_LINE (192)) ;
  const GGS_bool cond_7941 = gOption_goil_5F_options_posix_5F_it.reader_value () ;
  if (cond_7941.isBuiltAndTrue ()) {
    GGS_counter_by_source  var_cas_cbs = GGS_counter_by_source ::constructor_emptySortedList () ;
    {
      GGS_counter_map::cEnumerator enumerator_6893 (var_cas_counters, true) ;
      const GGS_counter_map::cElement * operand_6893 = NULL ;
      while (((operand_6893 = enumerator_6893.nextObject ()))) {
        macroValidPointer (operand_6893) ;
        var_cas_cbs.addAssign_operation (operand_6893->mInfo.counter.reader_source (inLexique COMMA_SOURCE_FILE_AT_LINE (197)).reader_string (inLexique COMMA_SOURCE_FILE_AT_LINE (197)), operand_6893->mKey, operand_6893->mInfo.counter) ;
      }
    }
    GGS_string var_cas_prev_src = GGS_string ("") ;
    GGS_counter_map  var_cas_cnt_set = GGS_counter_map ::constructor_emptyMap (inLexique COMMA_HERE) ;
    var_cas_code = GGS_string ("") ;
    {
      GGS_counter_by_source::cEnumerator enumerator_7065 (var_cas_cbs, true) ;
      const GGS_counter_by_source::cElement * operand_7065 = NULL ;
      while (((operand_7065 = enumerator_7065.nextObject ()))) {
        macroValidPointer (operand_7065) ;
        const GGS_bool cond_7517 = (operand_7065->source).operator_isNotEqual (var_cas_prev_src) ;
        if (cond_7517.isBuiltAndTrue ()) {
          const GGS_bool cond_7503 = (var_cas_cnt_set.reader_count ()).operator_strictSup (GGS_uint (0U)) ;
          if (cond_7503.isBuiltAndTrue ()) {
            GGS_string var_cas_cnt_set_code = function_template_string (inLexique, GGS_string ("code"), GGS_string ("counter_specific") COMMA_SOURCE_FILE_AT_LINE (205)) ;
            ::routine_doReplace (inLexique,  var_cas_cnt_set_code,  GGS_string ("$TICK_FUNC$"),  GGS_string ("tpl_tick_") COMMA_SOURCE_FILE_AT_LINE (206)) ;
            ::routine_doReplace (inLexique,  var_cas_cnt_set_code,  GGS_string ("$IT_SOURCE$"),  var_cas_prev_src COMMA_SOURCE_FILE_AT_LINE (207)) ;
            ::routine_generate_counter_for_target (inLexique,  var_cas_target,  var_cas_cnt_set,  var_cas_cnt_set_code COMMA_SOURCE_FILE_AT_LINE (208)) ;
            var_cas_code.dotAssign_operation (var_cas_cnt_set_code) ;
            var_cas_cnt_set = GGS_counter_map ::constructor_emptyMap (inLexique COMMA_HERE) ;
          }
        }
        var_cas_cnt_set.modifier_put (inLexique, operand_7065->name, operand_7065->counter COMMA_SOURCE_FILE_AT_LINE (213)) ;
        var_cas_prev_src = operand_7065->source ;
      }
    }
    const GGS_bool cond_7930 = (var_cas_cnt_set.reader_count ()).operator_strictSup (GGS_uint (0U)) ;
    if (cond_7930.isBuiltAndTrue ()) {
      GGS_string var_cas_cnt_set_code = function_template_string (inLexique, GGS_string ("code"), GGS_string ("counter_specific") COMMA_SOURCE_FILE_AT_LINE (217)) ;
      ::routine_doReplace (inLexique,  var_cas_cnt_set_code,  GGS_string ("$TICK_FUNC$"),  GGS_string ("tpl_tick_") COMMA_SOURCE_FILE_AT_LINE (218)) ;
      ::routine_doReplace (inLexique,  var_cas_cnt_set_code,  GGS_string ("$IT_SOURCE$"),  var_cas_prev_src COMMA_SOURCE_FILE_AT_LINE (219)) ;
      ::routine_generate_counter_for_target (inLexique,  var_cas_target,  var_cas_cnt_set,  var_cas_cnt_set_code COMMA_SOURCE_FILE_AT_LINE (220)) ;
      var_cas_code.dotAssign_operation (var_cas_cnt_set_code) ;
    }
  }else if (cond_7941.isBuiltAndFalse ()) {
    var_cas_code = function_template_string (inLexique, GGS_string ("code"), GGS_string ("counter_specific") COMMA_SOURCE_FILE_AT_LINE (224)) ;
    ::routine_doReplace (inLexique,  var_cas_code,  GGS_string ("$TICK_FUNC$"),  GGS_string ("tpl_call_counter_tick") COMMA_SOURCE_FILE_AT_LINE (225)) ;
    ::routine_doReplace (inLexique,  var_cas_code,  GGS_string ("$IT_SOURCE$"),  GGS_string ("") COMMA_SOURCE_FILE_AT_LINE (226)) ;
    ::routine_generate_counter_for_target (inLexique,  var_cas_target,  var_cas_counters,  var_cas_code COMMA_SOURCE_FILE_AT_LINE (227)) ;
  }
  #ifdef DEBUG_TRACE_ENABLED
    printf ("LEAVE routine_generate_counter_specific\n") ;
  #endif
}

//---------------------------------------------------------------------------*

