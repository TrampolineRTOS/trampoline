//---------------------------------------------------------------------------*
//                                                                           *
//                      File 'goil_types_counter.cpp'                        *
//                 Generated by version GALGAS_BETA_VERSION                  *
//                      june 22th, 2010, at 19h16'54"                        *
//                                                                           *
//---------------------------------------------------------------------------*

//--- START OF USER ZONE 1


//--- END OF USER ZONE 1

#include "version_libpm.h"
#if CURRENT_LIBPM_VERSION != VERSION_OF_LIBPM_USED_BY_GALGAS_COMPILER
  #error "This file has been compiled with a version of GALGAS that uses libpm version VERSION_OF_LIBPM_USED_BY_GALGAS_COMPILER, different than the current version (CURRENT_LIBPM_VERSION) of libpm"
#endif

//---------------------------------------------------------------------------*

#include "goil_types_counter.h"
#include "galgas-utilities/C_Compiler.h"
#include "galgas/C_galgas_CLI_Options.h"

//---------------------------------------------------------------------------*


//---------------------------------------------------------------------------*

#ifndef DO_NOT_GENERATE_CHECKINGS
  #define SOURCE_FILE_AT_LINE(line) "goil_types_counter.gSemantics", line
  #define COMMA_SOURCE_FILE_AT_LINE(line) , SOURCE_FILE_AT_LINE(line)
#else
  #define SOURCE_FILE_AT_LINE(line) 
  #define COMMA_SOURCE_FILE_AT_LINE(line) 
#endif

//---------------------------------------------------------------------------*
//                                                                           *
//                       @counter_driver auto ptr type                       *
//                                                                           *
//---------------------------------------------------------------------------*

GALGASap_counter_5F_driver::GALGASap_counter_5F_driver (const GALGASap_counter_5F_driver & inSource) :
GALGASap_class (inSource) {
}

//---------------------------------------------------------------------------*

GALGASap_counter_5F_driver::GALGASap_counter_5F_driver (const GALGASap_object & inSource) :
GALGASap_class (inSource) {
  macroNullOrValidObject (mPtr, GALGAS_counter_5F_driver) ;
}

//---------------------------------------------------------------------------*

GALGASap_counter_5F_driver & GALGASap_counter_5F_driver::operator = (const GALGASap_counter_5F_driver & inSource) {
  macroAssignObject (mPtr, inSource.mPtr) ;
  return * this ;
}

//---------------------------------------------------------------------------*

GALGASap_location GALGASap_counter_5F_driver::readerCall_location (LOCATION_ARGS) const {
  GALGASap_location result ;
  if (isValid ()) {
    result = ptr (HERE)->reader_location (THERE) ;
  }
  return result ;
}

//---------------------------------------------------------------------------*

#ifndef DO_NOT_GENERATE_CHECKINGS
  GALGAS_counter_5F_driver * GALGASap_counter_5F_driver::ptr (LOCATION_ARGS) {
    macroValidObjectThere (mPtr, GALGAS_counter_5F_driver) ;
    return (GALGAS_counter_5F_driver *) mPtr ;
  }
#endif

//---------------------------------------------------------------------------*

#ifndef DO_NOT_GENERATE_CHECKINGS
  const GALGAS_counter_5F_driver * GALGASap_counter_5F_driver::ptr (LOCATION_ARGS) const {
    macroValidObjectThere (mPtr, const GALGAS_counter_5F_driver) ;
    return (const GALGAS_counter_5F_driver *) mPtr ;
  }
#endif

//---------------------------------------------------------------------------*

GALGASap_counter_5F_driver::GALGASap_counter_5F_driver (const GALGAS_counter_5F_driver * inSourcePtr) :
GALGASap_class (inSourcePtr) {
}

//---------------------------------------------------------------------------*

GALGASap_counter_5F_driver & GALGASap_counter_5F_driver::operator = (GALGAS_counter_5F_driver * inSourcePtr) {
  macroAssignObject (mPtr, inSourcePtr) ;
  return *this ;
}

//---------------------------------------------------------------------------*

enumComparisonResult GALGASap_counter_5F_driver::objectCompare (const GALGASap_counter_5F_driver & inOperand1,
                                                                const GALGASap_counter_5F_driver & inOperand2) {
  enumComparisonResult result = (inOperand1.isValid () && inOperand2.isValid ()) ? kOperandEqual : kOperandNotValid ;
  if (kOperandEqual == result) {
    result = GALGASap_location::objectCompare (inOperand1.ptr (HERE)->mAttribute_location, inOperand2.ptr (HERE)->mAttribute_location) ;
  }
  return result ;
}


//---------------------------------------------------------------------------*

GALGAS_counter_5F_driver::GALGAS_counter_5F_driver (const GALGASap_location & constinAttribute_location
                                                    COMMA_LOCATION_ARGS) :
GALGAS_class (THERE),
mAttribute_location (constinAttribute_location) {
}

//---------------------------------------------------------------------------*

GALGAS_counter_5F_driver::~GALGAS_counter_5F_driver (void) {
}

//---------------------------------------------------------------------------*

GALGASap_location GALGAS_counter_5F_driver::reader_location (UNUSED_LOCATION_ARGS) const {
  return mAttribute_location ;
}

//---------------------------------------------------------------------------*
//                                                                           *
//                        @counter_driver class type                         *
//                                                                           *
//---------------------------------------------------------------------------*

const C_galgas_type_descriptor
kTypeDescriptor_GALGAS_counter_5F_driver ("counter_driver",
                                          & kTypeDescriptor_GALGAS_class) ;


//---------------------------------------------------------------------------*

const C_galgas_type_descriptor * GALGAS_counter_5F_driver::typeDescriptor (void) const {
  return & kTypeDescriptor_GALGAS_counter_5F_driver ;
}
//---------------------------------------------------------------------------*
//                                                                           *
//                        @void_driver auto ptr type                         *
//                                                                           *
//---------------------------------------------------------------------------*

GALGASap_void_5F_driver::GALGASap_void_5F_driver (const GALGASap_void_5F_driver & inSource) :
GALGASap_counter_5F_driver (inSource) {
}

//---------------------------------------------------------------------------*

GALGASap_void_5F_driver::GALGASap_void_5F_driver (const GALGASap_object & inSource) :
GALGASap_counter_5F_driver (inSource) {
  macroNullOrValidObject (mPtr, GALGAS_void_5F_driver) ;
}

//---------------------------------------------------------------------------*

GALGASap_void_5F_driver & GALGASap_void_5F_driver::operator = (const GALGASap_void_5F_driver & inSource) {
  macroAssignObject (mPtr, inSource.mPtr) ;
  return * this ;
}

//---------------------------------------------------------------------------*

#ifndef DO_NOT_GENERATE_CHECKINGS
  GALGAS_void_5F_driver * GALGASap_void_5F_driver::ptr (LOCATION_ARGS) {
    macroValidObjectThere (mPtr, GALGAS_void_5F_driver) ;
    return (GALGAS_void_5F_driver *) mPtr ;
  }
#endif

//---------------------------------------------------------------------------*

#ifndef DO_NOT_GENERATE_CHECKINGS
  const GALGAS_void_5F_driver * GALGASap_void_5F_driver::ptr (LOCATION_ARGS) const {
    macroValidObjectThere (mPtr, const GALGAS_void_5F_driver) ;
    return (const GALGAS_void_5F_driver *) mPtr ;
  }
#endif

//---------------------------------------------------------------------------*

GALGASap_void_5F_driver::GALGASap_void_5F_driver (const GALGAS_void_5F_driver * inSourcePtr) :
GALGASap_counter_5F_driver (inSourcePtr) {
}

//---------------------------------------------------------------------------*

GALGASap_void_5F_driver & GALGASap_void_5F_driver::operator = (GALGAS_void_5F_driver * inSourcePtr) {
  macroAssignObject (mPtr, inSourcePtr) ;
  return *this ;
}

//---------------------------------------------------------------------------*

enumComparisonResult GALGASap_void_5F_driver::objectCompare (const GALGASap_void_5F_driver & inOperand1,
                                                             const GALGASap_void_5F_driver & inOperand2) {
  return (inOperand1.isValid () && inOperand2.isValid ()) ? kOperandEqual : kOperandNotValid ;
}


//---------------------------------------------------------------------------*

GALGAS_void_5F_driver::GALGAS_void_5F_driver (const GALGASap_location & constinAttribute_location
                                              COMMA_LOCATION_ARGS) :
GALGAS_counter_5F_driver (constinAttribute_location COMMA_THERE) {
}

//---------------------------------------------------------------------------*

GALGASap_void_5F_driver GALGASap_void_5F_driver::constructor_new (GALGASap_location & inAttribute_location
                                                                  COMMA_LOCATION_ARGS) {
  GALGAS_void_5F_driver * result = NULL ;
  if (inAttribute_location.isValid ()) {
    macroMyNew (result, GALGAS_void_5F_driver (inAttribute_location COMMA_THERE)) ;
  }
  return result ;
}

//---------------------------------------------------------------------------*

void GALGAS_void_5F_driver::description (C_String & ioString,
                                         const PMSInt32 /* inIndentation */) const {
  ioString << "<class @"
           << typeDescriptor ()->mGalgasTypeName
           << ":" ;
  ioString << ">" ;
}

//---------------------------------------------------------------------------*

GALGAS_void_5F_driver::~GALGAS_void_5F_driver (void) {
}

//---------------------------------------------------------------------------*

void GALGASap_void_5F_driver::insulate (LOCATION_ARGS) {
  if (isValid () && (ptr (HERE)->retainCount () > 1)) {
    GALGASap_void_5F_driver p = constructor_new (ptr (HERE)->mAttribute_location COMMA_THERE) ;
    *this = p ;
  }
}

//---------------------------------------------------------------------------*

void GALGAS_void_5F_driver::modifier_setLocation (GALGASap_location inValue
                                                  COMMA_UNUSED_LOCATION_ARGS) {
  mAttribute_location = inValue ;
}

//---------------------------------------------------------------------------*
//                                                                           *
//                          @void_driver class type                          *
//                                                                           *
//---------------------------------------------------------------------------*

const C_galgas_type_descriptor
kTypeDescriptor_GALGAS_void_5F_driver ("void_driver",
                                       & kTypeDescriptor_GALGAS_counter_5F_driver) ;


//---------------------------------------------------------------------------*

const C_galgas_type_descriptor * GALGAS_void_5F_driver::typeDescriptor (void) const {
  return & kTypeDescriptor_GALGAS_void_5F_driver ;
}
//---------------------------------------------------------------------------*

void GALGASap_void_5F_driver::modifierCall_setLocation (GALGASap_location inArgument0
                                                        COMMA_LOCATION_ARGS) {
//--- Release 'output' arguments
//---
  if (isValid ()) {
    insulate (THERE) ;
    ptr (HERE)->modifier_setLocation (inArgument0 COMMA_THERE) ;
  }
}

//---------------------------------------------------------------------------*
//                                                                           *
//                     @os_internal_driver auto ptr type                     *
//                                                                           *
//---------------------------------------------------------------------------*

GALGASap_os_5F_internal_5F_driver::GALGASap_os_5F_internal_5F_driver (const GALGASap_os_5F_internal_5F_driver & inSource) :
GALGASap_counter_5F_driver (inSource) {
}

//---------------------------------------------------------------------------*

GALGASap_os_5F_internal_5F_driver::GALGASap_os_5F_internal_5F_driver (const GALGASap_object & inSource) :
GALGASap_counter_5F_driver (inSource) {
  macroNullOrValidObject (mPtr, GALGAS_os_5F_internal_5F_driver) ;
}

//---------------------------------------------------------------------------*

GALGASap_os_5F_internal_5F_driver & GALGASap_os_5F_internal_5F_driver::operator = (const GALGASap_os_5F_internal_5F_driver & inSource) {
  macroAssignObject (mPtr, inSource.mPtr) ;
  return * this ;
}

//---------------------------------------------------------------------------*

#ifndef DO_NOT_GENERATE_CHECKINGS
  GALGAS_os_5F_internal_5F_driver * GALGASap_os_5F_internal_5F_driver::ptr (LOCATION_ARGS) {
    macroValidObjectThere (mPtr, GALGAS_os_5F_internal_5F_driver) ;
    return (GALGAS_os_5F_internal_5F_driver *) mPtr ;
  }
#endif

//---------------------------------------------------------------------------*

#ifndef DO_NOT_GENERATE_CHECKINGS
  const GALGAS_os_5F_internal_5F_driver * GALGASap_os_5F_internal_5F_driver::ptr (LOCATION_ARGS) const {
    macroValidObjectThere (mPtr, const GALGAS_os_5F_internal_5F_driver) ;
    return (const GALGAS_os_5F_internal_5F_driver *) mPtr ;
  }
#endif

//---------------------------------------------------------------------------*

GALGASap_os_5F_internal_5F_driver::GALGASap_os_5F_internal_5F_driver (const GALGAS_os_5F_internal_5F_driver * inSourcePtr) :
GALGASap_counter_5F_driver (inSourcePtr) {
}

//---------------------------------------------------------------------------*

GALGASap_os_5F_internal_5F_driver & GALGASap_os_5F_internal_5F_driver::operator = (GALGAS_os_5F_internal_5F_driver * inSourcePtr) {
  macroAssignObject (mPtr, inSourcePtr) ;
  return *this ;
}

//---------------------------------------------------------------------------*

enumComparisonResult GALGASap_os_5F_internal_5F_driver::objectCompare (const GALGASap_os_5F_internal_5F_driver & inOperand1,
                                                                       const GALGASap_os_5F_internal_5F_driver & inOperand2) {
  return (inOperand1.isValid () && inOperand2.isValid ()) ? kOperandEqual : kOperandNotValid ;
}


//---------------------------------------------------------------------------*

GALGAS_os_5F_internal_5F_driver::GALGAS_os_5F_internal_5F_driver (const GALGASap_location & constinAttribute_location
                                                                  COMMA_LOCATION_ARGS) :
GALGAS_counter_5F_driver (constinAttribute_location COMMA_THERE) {
}

//---------------------------------------------------------------------------*

GALGASap_os_5F_internal_5F_driver GALGASap_os_5F_internal_5F_driver::constructor_new (GALGASap_location & inAttribute_location
                                                                                      COMMA_LOCATION_ARGS) {
  GALGAS_os_5F_internal_5F_driver * result = NULL ;
  if (inAttribute_location.isValid ()) {
    macroMyNew (result, GALGAS_os_5F_internal_5F_driver (inAttribute_location COMMA_THERE)) ;
  }
  return result ;
}

//---------------------------------------------------------------------------*

void GALGAS_os_5F_internal_5F_driver::description (C_String & ioString,
                                                   const PMSInt32 /* inIndentation */) const {
  ioString << "<class @"
           << typeDescriptor ()->mGalgasTypeName
           << ":" ;
  ioString << ">" ;
}

//---------------------------------------------------------------------------*

GALGAS_os_5F_internal_5F_driver::~GALGAS_os_5F_internal_5F_driver (void) {
}

//---------------------------------------------------------------------------*

void GALGASap_os_5F_internal_5F_driver::insulate (LOCATION_ARGS) {
  if (isValid () && (ptr (HERE)->retainCount () > 1)) {
    GALGASap_os_5F_internal_5F_driver p = constructor_new (ptr (HERE)->mAttribute_location COMMA_THERE) ;
    *this = p ;
  }
}

//---------------------------------------------------------------------------*

void GALGAS_os_5F_internal_5F_driver::modifier_setLocation (GALGASap_location inValue
                                                            COMMA_UNUSED_LOCATION_ARGS) {
  mAttribute_location = inValue ;
}

//---------------------------------------------------------------------------*
//                                                                           *
//                      @os_internal_driver class type                       *
//                                                                           *
//---------------------------------------------------------------------------*

const C_galgas_type_descriptor
kTypeDescriptor_GALGAS_os_5F_internal_5F_driver ("os_internal_driver",
                                                 & kTypeDescriptor_GALGAS_counter_5F_driver) ;


//---------------------------------------------------------------------------*

const C_galgas_type_descriptor * GALGAS_os_5F_internal_5F_driver::typeDescriptor (void) const {
  return & kTypeDescriptor_GALGAS_os_5F_internal_5F_driver ;
}
//---------------------------------------------------------------------------*

void GALGASap_os_5F_internal_5F_driver::modifierCall_setLocation (GALGASap_location inArgument0
                                                                  COMMA_LOCATION_ARGS) {
//--- Release 'output' arguments
//---
  if (isValid ()) {
    insulate (THERE) ;
    ptr (HERE)->modifier_setLocation (inArgument0 COMMA_THERE) ;
  }
}

//---------------------------------------------------------------------------*
//                                                                           *
//                         @gpt_driver auto ptr type                         *
//                                                                           *
//---------------------------------------------------------------------------*

GALGASap_gpt_5F_driver::GALGASap_gpt_5F_driver (const GALGASap_gpt_5F_driver & inSource) :
GALGASap_counter_5F_driver (inSource) {
}

//---------------------------------------------------------------------------*

GALGASap_gpt_5F_driver::GALGASap_gpt_5F_driver (const GALGASap_object & inSource) :
GALGASap_counter_5F_driver (inSource) {
  macroNullOrValidObject (mPtr, GALGAS_gpt_5F_driver) ;
}

//---------------------------------------------------------------------------*

GALGASap_gpt_5F_driver & GALGASap_gpt_5F_driver::operator = (const GALGASap_gpt_5F_driver & inSource) {
  macroAssignObject (mPtr, inSource.mPtr) ;
  return * this ;
}

//---------------------------------------------------------------------------*

GALGASap_lstring GALGASap_gpt_5F_driver::readerCall_gpt_5F_channel_5F_name (LOCATION_ARGS) const {
  GALGASap_lstring result ;
  if (isValid ()) {
    result = ptr (HERE)->reader_gpt_5F_channel_5F_name (THERE) ;
  }
  return result ;
}

//---------------------------------------------------------------------------*

GALGASap_basic_5F_type GALGASap_gpt_5F_driver::readerCall_ns_5F_per_5F_hw_5F_tick (LOCATION_ARGS) const {
  GALGASap_basic_5F_type result ;
  if (isValid ()) {
    result = ptr (HERE)->reader_ns_5F_per_5F_hw_5F_tick (THERE) ;
  }
  return result ;
}

//---------------------------------------------------------------------------*

#ifndef DO_NOT_GENERATE_CHECKINGS
  GALGAS_gpt_5F_driver * GALGASap_gpt_5F_driver::ptr (LOCATION_ARGS) {
    macroValidObjectThere (mPtr, GALGAS_gpt_5F_driver) ;
    return (GALGAS_gpt_5F_driver *) mPtr ;
  }
#endif

//---------------------------------------------------------------------------*

#ifndef DO_NOT_GENERATE_CHECKINGS
  const GALGAS_gpt_5F_driver * GALGASap_gpt_5F_driver::ptr (LOCATION_ARGS) const {
    macroValidObjectThere (mPtr, const GALGAS_gpt_5F_driver) ;
    return (const GALGAS_gpt_5F_driver *) mPtr ;
  }
#endif

//---------------------------------------------------------------------------*

GALGASap_gpt_5F_driver::GALGASap_gpt_5F_driver (const GALGAS_gpt_5F_driver * inSourcePtr) :
GALGASap_counter_5F_driver (inSourcePtr) {
}

//---------------------------------------------------------------------------*

GALGASap_gpt_5F_driver & GALGASap_gpt_5F_driver::operator = (GALGAS_gpt_5F_driver * inSourcePtr) {
  macroAssignObject (mPtr, inSourcePtr) ;
  return *this ;
}

//---------------------------------------------------------------------------*

enumComparisonResult GALGASap_gpt_5F_driver::objectCompare (const GALGASap_gpt_5F_driver & inOperand1,
                                                            const GALGASap_gpt_5F_driver & inOperand2) {
  enumComparisonResult result = GALGASap_counter_5F_driver::objectCompare (inOperand1, inOperand2) ;
  if (kOperandEqual == result) {
    result = GALGASap_basic_5F_type::objectCompare (inOperand1.ptr (HERE)->mAttribute_ns_5F_per_5F_hw_5F_tick, inOperand2.ptr (HERE)->mAttribute_ns_5F_per_5F_hw_5F_tick) ;
  }
  if (kOperandEqual == result) {
    result = GALGASap_lstring::objectCompare (inOperand1.ptr (HERE)->mAttribute_gpt_5F_channel_5F_name, inOperand2.ptr (HERE)->mAttribute_gpt_5F_channel_5F_name) ;
  }
  return result ;
}


//---------------------------------------------------------------------------*

GALGAS_gpt_5F_driver::GALGAS_gpt_5F_driver (const GALGASap_location & constinAttribute_location,
                                            const GALGASap_basic_5F_type & constinAttribute_ns_5F_per_5F_hw_5F_tick,
                                            const GALGASap_lstring & constinAttribute_gpt_5F_channel_5F_name
                                            COMMA_LOCATION_ARGS) :
GALGAS_counter_5F_driver (constinAttribute_location COMMA_THERE),
mAttribute_ns_5F_per_5F_hw_5F_tick (constinAttribute_ns_5F_per_5F_hw_5F_tick),
mAttribute_gpt_5F_channel_5F_name (constinAttribute_gpt_5F_channel_5F_name) {
}

//---------------------------------------------------------------------------*

GALGASap_gpt_5F_driver GALGASap_gpt_5F_driver::constructor_new (GALGASap_location & inAttribute_location,
                                                                GALGASap_basic_5F_type & inAttribute_ns_5F_per_5F_hw_5F_tick,
                                                                GALGASap_lstring & inAttribute_gpt_5F_channel_5F_name
                                                                COMMA_LOCATION_ARGS) {
  GALGAS_gpt_5F_driver * result = NULL ;
  if (inAttribute_location.isValid () && inAttribute_ns_5F_per_5F_hw_5F_tick.isValid () && inAttribute_gpt_5F_channel_5F_name.isValid ()) {
    macroMyNew (result, GALGAS_gpt_5F_driver (inAttribute_location, inAttribute_ns_5F_per_5F_hw_5F_tick, inAttribute_gpt_5F_channel_5F_name COMMA_THERE)) ;
  }
  return result ;
}

//---------------------------------------------------------------------------*

void GALGAS_gpt_5F_driver::description (C_String & ioString,
                                        const PMSInt32 /* inIndentation */) const {
  ioString << "<class @"
           << typeDescriptor ()->mGalgasTypeName
           << ":" ;
//  mAttribute_ns_5F_per_5F_hw_5F_tick->description (ioString, inIndentation + 1) ;
  ioString << ", " ;
//  mAttribute_gpt_5F_channel_5F_name->description (ioString, inIndentation + 1) ;
  ioString << ">" ;
}

//---------------------------------------------------------------------------*

GALGAS_gpt_5F_driver::~GALGAS_gpt_5F_driver (void) {
}

//---------------------------------------------------------------------------*

void GALGASap_gpt_5F_driver::insulate (LOCATION_ARGS) {
  if (isValid () && (ptr (HERE)->retainCount () > 1)) {
    GALGASap_gpt_5F_driver p = constructor_new (ptr (HERE)->mAttribute_location, ptr (HERE)->mAttribute_ns_5F_per_5F_hw_5F_tick, ptr (HERE)->mAttribute_gpt_5F_channel_5F_name COMMA_THERE) ;
    *this = p ;
  }
}

//---------------------------------------------------------------------------*

GALGASap_basic_5F_type GALGAS_gpt_5F_driver::reader_ns_5F_per_5F_hw_5F_tick (UNUSED_LOCATION_ARGS) const {
  return mAttribute_ns_5F_per_5F_hw_5F_tick ;
}

//---------------------------------------------------------------------------*

GALGASap_lstring GALGAS_gpt_5F_driver::reader_gpt_5F_channel_5F_name (UNUSED_LOCATION_ARGS) const {
  return mAttribute_gpt_5F_channel_5F_name ;
}

//---------------------------------------------------------------------------*

void GALGAS_gpt_5F_driver::modifier_setLocation (GALGASap_location inValue
                                                 COMMA_UNUSED_LOCATION_ARGS) {
  mAttribute_location = inValue ;
}

//---------------------------------------------------------------------------*

void GALGAS_gpt_5F_driver::modifier_setNs_5F_per_5F_hw_5F_tick (GALGASap_basic_5F_type inValue
                                                                COMMA_UNUSED_LOCATION_ARGS) {
  mAttribute_ns_5F_per_5F_hw_5F_tick = inValue ;
}

//---------------------------------------------------------------------------*

void GALGAS_gpt_5F_driver::modifier_setGpt_5F_channel_5F_name (GALGASap_lstring inValue
                                                               COMMA_UNUSED_LOCATION_ARGS) {
  mAttribute_gpt_5F_channel_5F_name = inValue ;
}

//---------------------------------------------------------------------------*
//                                                                           *
//                          @gpt_driver class type                           *
//                                                                           *
//---------------------------------------------------------------------------*

const C_galgas_type_descriptor
kTypeDescriptor_GALGAS_gpt_5F_driver ("gpt_driver",
                                      & kTypeDescriptor_GALGAS_counter_5F_driver) ;


//---------------------------------------------------------------------------*

const C_galgas_type_descriptor * GALGAS_gpt_5F_driver::typeDescriptor (void) const {
  return & kTypeDescriptor_GALGAS_gpt_5F_driver ;
}
//---------------------------------------------------------------------------*

void GALGASap_gpt_5F_driver::modifierCall_setGpt_5F_channel_5F_name (GALGASap_lstring inArgument0
                                                                     COMMA_LOCATION_ARGS) {
//--- Release 'output' arguments
//---
  if (isValid ()) {
    insulate (THERE) ;
    ptr (HERE)->modifier_setGpt_5F_channel_5F_name (inArgument0 COMMA_THERE) ;
  }
}

//---------------------------------------------------------------------------*

void GALGASap_gpt_5F_driver::modifierCall_setLocation (GALGASap_location inArgument0
                                                       COMMA_LOCATION_ARGS) {
//--- Release 'output' arguments
//---
  if (isValid ()) {
    insulate (THERE) ;
    ptr (HERE)->modifier_setLocation (inArgument0 COMMA_THERE) ;
  }
}

//---------------------------------------------------------------------------*

void GALGASap_gpt_5F_driver::modifierCall_setNs_5F_per_5F_hw_5F_tick (GALGASap_basic_5F_type inArgument0
                                                                      COMMA_LOCATION_ARGS) {
//--- Release 'output' arguments
//---
  if (isValid ()) {
    insulate (THERE) ;
    ptr (HERE)->modifier_setNs_5F_per_5F_hw_5F_tick (inArgument0 COMMA_THERE) ;
  }
}

//---------------------------------------------------------------------------*
//                                                                           *
//                       @time_constants auto ptr type                       *
//                                                                           *
//---------------------------------------------------------------------------*

GALGASap_time_5F_constants::GALGASap_time_5F_constants (const GALGASap_time_5F_constants & inSource) :
GALGASap_list (inSource) {
}

//---------------------------------------------------------------------------*

GALGASap_time_5F_constants::GALGASap_time_5F_constants (const GALGASap_object & inSource) :
GALGASap_list (inSource) {
  macroNullOrValidObject (mPtr, GALGAS_time_5F_constants) ;
}

//---------------------------------------------------------------------------*

GALGASap_time_5F_constants & GALGASap_time_5F_constants::operator = (const GALGASap_time_5F_constants & inSource) {
  macroAssignObject (mPtr, inSource.mPtr) ;
  return * this ;
}

//---------------------------------------------------------------------------*

GALGASap_lstring GALGASap_time_5F_constants::readerCall_const_5F_nameAtIndex (const GALGASap_uint & inOperand_0,
                                                                              C_Compiler * inCompiler
                                                                              COMMA_LOCATION_ARGS) const {
  GALGASap_lstring result ;
  if (isValid ()) {
    result = ptr (HERE)->reader_const_5F_nameAtIndex (inOperand_0, inCompiler COMMA_THERE) ;
  }
  return result ;
}

//---------------------------------------------------------------------------*

GALGASap_basic_5F_type GALGASap_time_5F_constants::readerCall_nsAtIndex (const GALGASap_uint & inOperand_0,
                                                                         C_Compiler * inCompiler
                                                                         COMMA_LOCATION_ARGS) const {
  GALGASap_basic_5F_type result ;
  if (isValid ()) {
    result = ptr (HERE)->reader_nsAtIndex (inOperand_0, inCompiler COMMA_THERE) ;
  }
  return result ;
}

//---------------------------------------------------------------------------*

GALGASap_time_5F_constants GALGASap_time_5F_constants::readerCall_subListFromIndex (const GALGASap_uint & inOperand_0,
                                                                                    C_Compiler * inCompiler
                                                                                    COMMA_LOCATION_ARGS) const {
  GALGASap_time_5F_constants result ;
  if (isValid ()) {
    result = ptr (HERE)->reader_subListFromIndex (inOperand_0, inCompiler COMMA_THERE) ;
  }
  return result ;
}

//---------------------------------------------------------------------------*

GALGASap_time_5F_constants GALGASap_time_5F_constants::readerCall_subListWithRange (const GALGASap_uint & inOperand_0,
                                                                                    const GALGASap_uint & inOperand_1,
                                                                                    C_Compiler * inCompiler
                                                                                    COMMA_LOCATION_ARGS) const {
  GALGASap_time_5F_constants result ;
  if (isValid ()) {
    result = ptr (HERE)->reader_subListWithRange (inOperand_0, inOperand_1, inCompiler COMMA_THERE) ;
  }
  return result ;
}

//---------------------------------------------------------------------------*

#ifndef DO_NOT_GENERATE_CHECKINGS
  GALGAS_time_5F_constants * GALGASap_time_5F_constants::ptr (LOCATION_ARGS) {
    macroValidObjectThere (mPtr, GALGAS_time_5F_constants) ;
    return (GALGAS_time_5F_constants *) mPtr ;
  }
#endif

//---------------------------------------------------------------------------*

#ifndef DO_NOT_GENERATE_CHECKINGS
  const GALGAS_time_5F_constants * GALGASap_time_5F_constants::ptr (LOCATION_ARGS) const {
    macroValidObjectThere (mPtr, const GALGAS_time_5F_constants) ;
    return (const GALGAS_time_5F_constants *) mPtr ;
  }
#endif

//---------------------------------------------------------------------------*

GALGASap_time_5F_constants::GALGASap_time_5F_constants (const GALGAS_time_5F_constants * inSourcePtr) :
GALGASap_list (inSourcePtr) {
}

//---------------------------------------------------------------------------*

GALGASap_time_5F_constants & GALGASap_time_5F_constants::operator = (GALGAS_time_5F_constants * inSourcePtr) {
  macroAssignObject (mPtr, inSourcePtr) ;
  return *this ;
}

//---------------------------------------------------------------------------*
//                                                                           *
//              Class for element of '@time_5F_constants' list               *
//                                                                           *
//---------------------------------------------------------------------------*

class cCollectionElement_time_5F_constants : public cCollectionElement {
//--- List attributes
  public : GALGASap_basic_5F_type mAttribute_ns ;
  public : GALGASap_lstring mAttribute_const_5F_name ;

//--- Constructor
  public : cCollectionElement_time_5F_constants (const GALGASap_basic_5F_type & in_ns,
                                                 const GALGASap_lstring & in_const_5F_name
                                                 COMMA_LOCATION_ARGS) ;

//--- Virtual method for comparing elements
  public : virtual enumComparisonResult compare (const cCollectionElement * inOperand) ;

//--- Virtual method that checks that all attributes are valid
  public : virtual bool isValid (void) const ;

//--- Virtual method that returns a copy of current object
  public : virtual cCollectionElement * copy (void) ;

//--- Description
 public : virtual void description (C_String & ioString, const PMSInt32 inIndentation) const ;
} ;

//---------------------------------------------------------------------------*

cCollectionElement_time_5F_constants::cCollectionElement_time_5F_constants (const GALGASap_basic_5F_type & in_ns,
                                                                            const GALGASap_lstring & in_const_5F_name
                                                                            COMMA_LOCATION_ARGS) :
cCollectionElement (THERE),
mAttribute_ns (in_ns),
mAttribute_const_5F_name (in_const_5F_name) {
}

//---------------------------------------------------------------------------*

bool cCollectionElement_time_5F_constants::isValid (void) const {
  return mAttribute_ns.isValid () && mAttribute_const_5F_name.isValid () ;
}

//---------------------------------------------------------------------------*

cCollectionElement * cCollectionElement_time_5F_constants::copy (void) {
  cCollectionElement * result = NULL ;
  macroMyNew (result, cCollectionElement_time_5F_constants (mAttribute_ns, mAttribute_const_5F_name COMMA_HERE)) ;
  return result ;
}

//---------------------------------------------------------------------------*

void cCollectionElement_time_5F_constants::description (C_String & /* ioString */, const PMSInt32 /* inIndentation */) const {
// mAttribute_ns.description (ioString, inIndentation) ;
// mAttribute_const_5F_name.description (ioString, inIndentation) ;
}

//---------------------------------------------------------------------------*

enumComparisonResult cCollectionElement_time_5F_constants::compare (const cCollectionElement * inOperand) {
  cCollectionElement_time_5F_constants * operand = (cCollectionElement_time_5F_constants *) inOperand ;
  enumComparisonResult result = kOperandEqual ;
  if (kOperandEqual == result) {
    result = GALGASap_basic_5F_type::objectCompare (mAttribute_ns, operand->mAttribute_ns) ;
  }
  if (kOperandEqual == result) {
    result = GALGASap_lstring::objectCompare (mAttribute_const_5F_name, operand->mAttribute_const_5F_name) ;
  }
  return result ;
}

//---------------------------------------------------------------------------*

static const C_galgas_type_descriptor * kFieldList_time_5F_constants [2] = {
  & kTypeDescriptor_GALGAS_basic_5F_type,
  & kTypeDescriptor_GALGAS_lstring
} ;

//---------------------------------------------------------------------------*

GALGAS_time_5F_constants::GALGAS_time_5F_constants (LOCATION_ARGS) :
GALGAS_list (kFieldList_time_5F_constants COMMA_THERE) {
}

//---------------------------------------------------------------------------*

GALGASap_time_5F_constants GALGASap_time_5F_constants::constructor_emptyList (LOCATION_ARGS) {
  GALGAS_time_5F_constants * result = NULL ;
  macroMyNew (result, GALGAS_time_5F_constants (THERE)) ;
  return result ;
}

//---------------------------------------------------------------------------*

GALGASap_time_5F_constants GALGASap_time_5F_constants::constructor_listWithValue (GALGASap_basic_5F_type & inOperand0,
                                                                                  GALGASap_lstring & inOperand1
                                                                                  COMMA_LOCATION_ARGS) {
  GALGASap_time_5F_constants result (constructor_emptyList (THERE)) ;
  cCollectionElement * p = NULL ;
  macroMyNew (p, cCollectionElement_time_5F_constants (inOperand0, inOperand1 COMMA_THERE)) ;
  capCollectionElement attributes (p) ;
  result.ptr (HERE)->addObject (attributes) ;
  return result ;
}

//---------------------------------------------------------------------------*

void GALGASap_time_5F_constants::insulate (LOCATION_ARGS) {
  if (ptr (HERE)->retainCount () > 1) {
    GALGASap_time_5F_constants newList (constructor_emptyList (THERE)) ;
    newList.ptr (HERE)->copyFrom (ptr (HERE)) ;
    *this = newList ;
  }
}

//---------------------------------------------------------------------------*

void GALGASap_time_5F_constants::addAssign_operation (const GALGASap_basic_5F_type inOperand0,
                                                      const GALGASap_lstring inOperand1
                                                      COMMA_LOCATION_ARGS) {
  if (isValid ()) {
    insulate (THERE) ;
    cCollectionElement * p = NULL ;
    macroMyNew (p, cCollectionElement_time_5F_constants (inOperand0, inOperand1 COMMA_THERE)) ;
    capCollectionElement attributes (p) ;
    ptr (HERE)->addObject (attributes) ;
  }
}

//---------------------------------------------------------------------------*

void GALGAS_time_5F_constants::modifier_prependValue (GALGASap_basic_5F_type inOperand0,
                                                      GALGASap_lstring inOperand1
                                                      COMMA_LOCATION_ARGS) {
  if (inOperand0.isValid () && inOperand1.isValid ()) {
    cCollectionElement * p = NULL ;
    macroMyNew (p, cCollectionElement_time_5F_constants (inOperand0, inOperand1 COMMA_THERE)) ;
    capCollectionElement attributes (p) ;
    prependAttributeArray (attributes) ;
  }
}

//---------------------------------------------------------------------------*

void GALGAS_time_5F_constants::modifier_popFirst (GALGASap_basic_5F_type & outOperand0,
                                                  GALGASap_lstring & outOperand1,
                                                  C_Compiler * inCompiler
                                                  COMMA_LOCATION_ARGS) {
  capCollectionElement attributes ;
  removeFirstObject (attributes, inCompiler COMMA_THERE) ;
  cCollectionElement_time_5F_constants * p = (cCollectionElement_time_5F_constants *) attributes.ptrNoVerif () ;
  if (NULL == p) {
    outOperand0.drop () ;
    outOperand1.drop () ;
  }else{
    macroValidObject (p, cCollectionElement_time_5F_constants) ;
    outOperand0 = p->mAttribute_ns ;
    outOperand1 = p->mAttribute_const_5F_name ;
  }
}

//---------------------------------------------------------------------------*

void GALGAS_time_5F_constants::modifier_popLast (GALGASap_basic_5F_type & outOperand0,
                                                 GALGASap_lstring & outOperand1,
                                                 C_Compiler * inCompiler
                                                 COMMA_LOCATION_ARGS) {
  capCollectionElement attributes ;
  removeLastObject (attributes, inCompiler COMMA_THERE) ;
  cCollectionElement_time_5F_constants * p = (cCollectionElement_time_5F_constants *) attributes.ptrNoVerif () ;
  if (NULL == p) {
    outOperand0.drop () ;
    outOperand1.drop () ;
  }else{
    macroValidObject (p, cCollectionElement_time_5F_constants) ;
    outOperand0 = p->mAttribute_ns ;
    outOperand1 = p->mAttribute_const_5F_name ;
  }
}

//---------------------------------------------------------------------------*

void GALGAS_time_5F_constants::method_first (GALGASap_basic_5F_type & outOperand0,
                                             GALGASap_lstring & outOperand1,
                                             C_Compiler * inCompiler
                                             COMMA_LOCATION_ARGS) {
  capCollectionElement attributes ;
  readFirst (attributes, inCompiler COMMA_THERE) ;
  cCollectionElement_time_5F_constants * p = (cCollectionElement_time_5F_constants *) attributes.ptrNoVerif () ;
  if (NULL == p) {
    outOperand0.drop () ;
    outOperand1.drop () ;
  }else{
    macroValidObject (p, cCollectionElement_time_5F_constants) ;
    outOperand0 = p->mAttribute_ns ;
    outOperand1 = p->mAttribute_const_5F_name ;
  }
}

//---------------------------------------------------------------------------*

void GALGAS_time_5F_constants::method_last (GALGASap_basic_5F_type & outOperand0,
                                            GALGASap_lstring & outOperand1,
                                            C_Compiler * inCompiler
                                            COMMA_LOCATION_ARGS) {
  capCollectionElement attributes ;
  readLast (attributes, inCompiler COMMA_THERE) ;
  cCollectionElement_time_5F_constants * p = (cCollectionElement_time_5F_constants *) attributes.ptrNoVerif () ;
  if (NULL == p) {
    outOperand0.drop () ;
    outOperand1.drop () ;
  }else{
    macroValidObject (p, cCollectionElement_time_5F_constants) ;
    outOperand0 = p->mAttribute_ns ;
    outOperand1 = p->mAttribute_const_5F_name ;
  }
}

//---------------------------------------------------------------------------*

GALGASap_time_5F_constants GALGASap_time_5F_constants::operator_concat (const GALGASap_time_5F_constants & inOperand
                                                                        COMMA_UNUSED_LOCATION_ARGS) const {
  GALGASap_time_5F_constants result ;
  if (isValid () && inOperand.isValid ()) {
    result = *this ;
    result.ptr (HERE)->appendList (inOperand.ptr (HERE)) ;
  }
  return result ;
}

//---------------------------------------------------------------------------*

GALGASap_time_5F_constants GALGAS_time_5F_constants::reader_subListWithRange (const GALGASap_uint & inOperand0,
                                                                              const GALGASap_uint & inOperand1,
                                                                              C_Compiler * inCompiler
                                                                              COMMA_LOCATION_ARGS) const {
  GALGASap_time_5F_constants result ;
  if (inOperand0.isValid () && inOperand1.isValid ()) {
    result = GALGASap_time_5F_constants::constructor_emptyList (THERE) ;
    const bool ok = subListWithRange (result.ptr (HERE), inOperand0, inOperand1, inCompiler COMMA_THERE) ;
    if (! ok) {
      result.drop () ;
    }
  }
  return result ;
}

//---------------------------------------------------------------------------*

GALGASap_time_5F_constants GALGAS_time_5F_constants::reader_subListFromIndex (const GALGASap_uint & inIndex,
                                                                              C_Compiler * inCompiler
                                                                              COMMA_LOCATION_ARGS) const {
  GALGASap_time_5F_constants result ;
  if (inIndex.isValid ()) {
    result = GALGASap_time_5F_constants::constructor_emptyList (THERE) ;
    const bool ok = subListFromIndex (result.ptr (HERE), inIndex, inCompiler COMMA_THERE) ;
    if (! ok) {
      result.drop () ;
    }
  }
  return result ;
}

//---------------------------------------------------------------------------*

void GALGASap_time_5F_constants::dotAssign_operation (const GALGASap_time_5F_constants inOperand
                                                      COMMA_LOCATION_ARGS) {
  if (isValid () && inOperand.isValid ()) {
    insulate (THERE) ;
    ptr (HERE)->appendList (inOperand.ptr (HERE)) ;
  }
}
//---------------------------------------------------------------------------*

void GALGAS_time_5F_constants::modifier_setNsAtIndex (GALGASap_basic_5F_type inOperand,
                                                      GALGASap_uint inIndex,
                                                      C_Compiler * inCompiler
                                                      COMMA_LOCATION_ARGS) {
  cCollectionElement_time_5F_constants * p = (cCollectionElement_time_5F_constants *) writeObjectAccessAtIndex (inIndex, inCompiler COMMA_THERE) ;
  if (NULL != p) {
    macroValidObject (p, cCollectionElement_time_5F_constants) ;
    p->mAttribute_ns = inOperand ;
  }
}

//---------------------------------------------------------------------------*

void GALGAS_time_5F_constants::modifier_setConst_5F_nameAtIndex (GALGASap_lstring inOperand,
                                                                 GALGASap_uint inIndex,
                                                                 C_Compiler * inCompiler
                                                                 COMMA_LOCATION_ARGS) {
  cCollectionElement_time_5F_constants * p = (cCollectionElement_time_5F_constants *) writeObjectAccessAtIndex (inIndex, inCompiler COMMA_THERE) ;
  if (NULL != p) {
    macroValidObject (p, cCollectionElement_time_5F_constants) ;
    p->mAttribute_const_5F_name = inOperand ;
  }
}


//---------------------------------------------------------------------------*

GALGASap_basic_5F_type GALGAS_time_5F_constants::reader_nsAtIndex (const GALGASap_uint & inIndex,
                                                                   C_Compiler * inCompiler
                                                                   COMMA_LOCATION_ARGS) const {
  capCollectionElement attributes = readObjectAtIndex (inIndex, inCompiler COMMA_THERE) ;
  cCollectionElement_time_5F_constants * p = (cCollectionElement_time_5F_constants *) attributes.ptrNoVerif () ;
  GALGASap_basic_5F_type result ;
  if (NULL != p) {
    macroValidObject (p, cCollectionElement_time_5F_constants) ;
    result = p->mAttribute_ns ;
  }
  return result ;
}

//---------------------------------------------------------------------------*

GALGASap_lstring GALGAS_time_5F_constants::reader_const_5F_nameAtIndex (const GALGASap_uint & inIndex,
                                                                        C_Compiler * inCompiler
                                                                        COMMA_LOCATION_ARGS) const {
  capCollectionElement attributes = readObjectAtIndex (inIndex, inCompiler COMMA_THERE) ;
  cCollectionElement_time_5F_constants * p = (cCollectionElement_time_5F_constants *) attributes.ptrNoVerif () ;
  GALGASap_lstring result ;
  if (NULL != p) {
    macroValidObject (p, cCollectionElement_time_5F_constants) ;
    result = p->mAttribute_const_5F_name ;
  }
  return result ;
}



//---------------------------------------------------------------------------*
//                                                                           *
//                         @time_constants list type                         *
//                                                                           *
//---------------------------------------------------------------------------*

const C_galgas_type_descriptor
kTypeDescriptor_GALGAS_time_5F_constants ("time_constants",
                                          & kTypeDescriptor_GALGAS_list) ;


//---------------------------------------------------------------------------*

const C_galgas_type_descriptor * GALGAS_time_5F_constants::typeDescriptor (void) const {
  return & kTypeDescriptor_GALGAS_time_5F_constants ;
}
//---------------------------------------------------------------------------*

void GALGASap_time_5F_constants::modifierCall_popFirst (GALGASap_basic_5F_type & outArgument0,
                                                        GALGASap_lstring & outArgument1,
                                                        C_Compiler * inCompiler
                                                        COMMA_LOCATION_ARGS) {
//--- Release 'output' arguments
  outArgument0.drop () ;
  outArgument1.drop () ;
//---
  if (isValid ()) {
    insulate (THERE) ;
    ptr (HERE)->modifier_popFirst (outArgument0, outArgument1, inCompiler COMMA_THERE) ;
  }
}

//---------------------------------------------------------------------------*

void GALGASap_time_5F_constants::modifierCall_popLast (GALGASap_basic_5F_type & outArgument0,
                                                       GALGASap_lstring & outArgument1,
                                                       C_Compiler * inCompiler
                                                       COMMA_LOCATION_ARGS) {
//--- Release 'output' arguments
  outArgument0.drop () ;
  outArgument1.drop () ;
//---
  if (isValid ()) {
    insulate (THERE) ;
    ptr (HERE)->modifier_popLast (outArgument0, outArgument1, inCompiler COMMA_THERE) ;
  }
}

//---------------------------------------------------------------------------*

void GALGASap_time_5F_constants::modifierCall_prependValue (GALGASap_basic_5F_type constinArgument0,
                                                            GALGASap_lstring constinArgument1
                                                            COMMA_LOCATION_ARGS) {
//--- Release 'output' arguments
//---
  if (isValid ()) {
    insulate (THERE) ;
    ptr (HERE)->modifier_prependValue (constinArgument0, constinArgument1 COMMA_THERE) ;
  }
}

//---------------------------------------------------------------------------*

void GALGASap_time_5F_constants::modifierCall_setConst_5F_nameAtIndex (GALGASap_lstring constinArgument0,
                                                                       GALGASap_uint constinArgument1,
                                                                       C_Compiler * inCompiler
                                                                       COMMA_LOCATION_ARGS) {
//--- Release 'output' arguments
//---
  if (isValid ()) {
    insulate (THERE) ;
    ptr (HERE)->modifier_setConst_5F_nameAtIndex (constinArgument0, constinArgument1, inCompiler COMMA_THERE) ;
  }
}

//---------------------------------------------------------------------------*

void GALGASap_time_5F_constants::modifierCall_setNsAtIndex (GALGASap_basic_5F_type constinArgument0,
                                                            GALGASap_uint constinArgument1,
                                                            C_Compiler * inCompiler
                                                            COMMA_LOCATION_ARGS) {
//--- Release 'output' arguments
//---
  if (isValid ()) {
    insulate (THERE) ;
    ptr (HERE)->modifier_setNsAtIndex (constinArgument0, constinArgument1, inCompiler COMMA_THERE) ;
  }
}

//---------------------------------------------------------------------------*

void GALGASap_time_5F_constants::instanceMethodCall_first (GALGASap_basic_5F_type & outArgument0,
                                                           GALGASap_lstring & outArgument1,
                                                           C_Compiler * inCompiler
                                                           COMMA_LOCATION_ARGS) {
//--- Release 'output' arguments
  outArgument0.drop () ;
  outArgument1.drop () ;
//---
  if (isValid ()) {
    ptr (HERE)->method_first (outArgument0, outArgument1, inCompiler COMMA_THERE) ;
  }
}

//---------------------------------------------------------------------------*

void GALGASap_time_5F_constants::instanceMethodCall_last (GALGASap_basic_5F_type & outArgument0,
                                                          GALGASap_lstring & outArgument1,
                                                          C_Compiler * inCompiler
                                                          COMMA_LOCATION_ARGS) {
//--- Release 'output' arguments
  outArgument0.drop () ;
  outArgument1.drop () ;
//---
  if (isValid ()) {
    ptr (HERE)->method_last (outArgument0, outArgument1, inCompiler COMMA_THERE) ;
  }
}

//---------------------------------------------------------------------------*
//                     @time_constants list enumeration                      *
//---------------------------------------------------------------------------*

GALGAS_time_5F_constants::cEnumerator::cEnumerator (const GALGASap_time_5F_constants & inEnumeratedObject,
                                                    const bool inAscending) :
AC_GALGAS_Enumerator (inEnumeratedObject.ptrNoVerif (), inAscending),
attribute_ns (),
attribute_const_5F_name () {
}

//---------------------------------------------------------------------------*

void GALGAS_time_5F_constants::cEnumerator::updateAttributeProxies (void) {
  capCollectionElement object = currentObject () ;
  cCollectionElement_time_5F_constants * p = (cCollectionElement_time_5F_constants *) object.ptrNoVerif () ;
  macroValidObject (p, cCollectionElement_time_5F_constants) ;
  attribute_ns = p->mAttribute_ns ;
  attribute_const_5F_name = p->mAttribute_const_5F_name ;
}

//---------------------------------------------------------------------------*
//                                                                           *
//                        @counter_type auto ptr type                        *
//                                                                           *
//---------------------------------------------------------------------------*

GALGASap_counter_5F_type::GALGASap_counter_5F_type (const GALGASap_counter_5F_type & inSource) :
GALGASap_class (inSource) {
}

//---------------------------------------------------------------------------*

GALGASap_counter_5F_type::GALGASap_counter_5F_type (const GALGASap_object & inSource) :
GALGASap_class (inSource) {
  macroNullOrValidObject (mPtr, GALGAS_counter_5F_type) ;
}

//---------------------------------------------------------------------------*

GALGASap_counter_5F_type & GALGASap_counter_5F_type::operator = (const GALGASap_counter_5F_type & inSource) {
  macroAssignObject (mPtr, inSource.mPtr) ;
  return * this ;
}

//---------------------------------------------------------------------------*

GALGASap_location GALGASap_counter_5F_type::readerCall_location (LOCATION_ARGS) const {
  GALGASap_location result ;
  if (isValid ()) {
    result = ptr (HERE)->reader_location (THERE) ;
  }
  return result ;
}

//---------------------------------------------------------------------------*

#ifndef DO_NOT_GENERATE_CHECKINGS
  GALGAS_counter_5F_type * GALGASap_counter_5F_type::ptr (LOCATION_ARGS) {
    macroValidObjectThere (mPtr, GALGAS_counter_5F_type) ;
    return (GALGAS_counter_5F_type *) mPtr ;
  }
#endif

//---------------------------------------------------------------------------*

#ifndef DO_NOT_GENERATE_CHECKINGS
  const GALGAS_counter_5F_type * GALGASap_counter_5F_type::ptr (LOCATION_ARGS) const {
    macroValidObjectThere (mPtr, const GALGAS_counter_5F_type) ;
    return (const GALGAS_counter_5F_type *) mPtr ;
  }
#endif

//---------------------------------------------------------------------------*

GALGASap_counter_5F_type::GALGASap_counter_5F_type (const GALGAS_counter_5F_type * inSourcePtr) :
GALGASap_class (inSourcePtr) {
}

//---------------------------------------------------------------------------*

GALGASap_counter_5F_type & GALGASap_counter_5F_type::operator = (GALGAS_counter_5F_type * inSourcePtr) {
  macroAssignObject (mPtr, inSourcePtr) ;
  return *this ;
}

//---------------------------------------------------------------------------*

enumComparisonResult GALGASap_counter_5F_type::objectCompare (const GALGASap_counter_5F_type & inOperand1,
                                                              const GALGASap_counter_5F_type & inOperand2) {
  enumComparisonResult result = (inOperand1.isValid () && inOperand2.isValid ()) ? kOperandEqual : kOperandNotValid ;
  if (kOperandEqual == result) {
    result = GALGASap_location::objectCompare (inOperand1.ptr (HERE)->mAttribute_location, inOperand2.ptr (HERE)->mAttribute_location) ;
  }
  return result ;
}


//---------------------------------------------------------------------------*

GALGAS_counter_5F_type::GALGAS_counter_5F_type (const GALGASap_location & constinAttribute_location
                                                COMMA_LOCATION_ARGS) :
GALGAS_class (THERE),
mAttribute_location (constinAttribute_location) {
}

//---------------------------------------------------------------------------*

GALGAS_counter_5F_type::~GALGAS_counter_5F_type (void) {
}

//---------------------------------------------------------------------------*

GALGASap_location GALGAS_counter_5F_type::reader_location (UNUSED_LOCATION_ARGS) const {
  return mAttribute_location ;
}

//---------------------------------------------------------------------------*
//                                                                           *
//                         @counter_type class type                          *
//                                                                           *
//---------------------------------------------------------------------------*

const C_galgas_type_descriptor
kTypeDescriptor_GALGAS_counter_5F_type ("counter_type",
                                        & kTypeDescriptor_GALGAS_class) ;


//---------------------------------------------------------------------------*

const C_galgas_type_descriptor * GALGAS_counter_5F_type::typeDescriptor (void) const {
  return & kTypeDescriptor_GALGAS_counter_5F_type ;
}
//---------------------------------------------------------------------------*
//                                                                           *
//                        @void_counter auto ptr type                        *
//                                                                           *
//---------------------------------------------------------------------------*

GALGASap_void_5F_counter::GALGASap_void_5F_counter (const GALGASap_void_5F_counter & inSource) :
GALGASap_counter_5F_type (inSource) {
}

//---------------------------------------------------------------------------*

GALGASap_void_5F_counter::GALGASap_void_5F_counter (const GALGASap_object & inSource) :
GALGASap_counter_5F_type (inSource) {
  macroNullOrValidObject (mPtr, GALGAS_void_5F_counter) ;
}

//---------------------------------------------------------------------------*

GALGASap_void_5F_counter & GALGASap_void_5F_counter::operator = (const GALGASap_void_5F_counter & inSource) {
  macroAssignObject (mPtr, inSource.mPtr) ;
  return * this ;
}

//---------------------------------------------------------------------------*

#ifndef DO_NOT_GENERATE_CHECKINGS
  GALGAS_void_5F_counter * GALGASap_void_5F_counter::ptr (LOCATION_ARGS) {
    macroValidObjectThere (mPtr, GALGAS_void_5F_counter) ;
    return (GALGAS_void_5F_counter *) mPtr ;
  }
#endif

//---------------------------------------------------------------------------*

#ifndef DO_NOT_GENERATE_CHECKINGS
  const GALGAS_void_5F_counter * GALGASap_void_5F_counter::ptr (LOCATION_ARGS) const {
    macroValidObjectThere (mPtr, const GALGAS_void_5F_counter) ;
    return (const GALGAS_void_5F_counter *) mPtr ;
  }
#endif

//---------------------------------------------------------------------------*

GALGASap_void_5F_counter::GALGASap_void_5F_counter (const GALGAS_void_5F_counter * inSourcePtr) :
GALGASap_counter_5F_type (inSourcePtr) {
}

//---------------------------------------------------------------------------*

GALGASap_void_5F_counter & GALGASap_void_5F_counter::operator = (GALGAS_void_5F_counter * inSourcePtr) {
  macroAssignObject (mPtr, inSourcePtr) ;
  return *this ;
}

//---------------------------------------------------------------------------*

enumComparisonResult GALGASap_void_5F_counter::objectCompare (const GALGASap_void_5F_counter & inOperand1,
                                                              const GALGASap_void_5F_counter & inOperand2) {
  return (inOperand1.isValid () && inOperand2.isValid ()) ? kOperandEqual : kOperandNotValid ;
}


//---------------------------------------------------------------------------*

GALGAS_void_5F_counter::GALGAS_void_5F_counter (const GALGASap_location & constinAttribute_location
                                                COMMA_LOCATION_ARGS) :
GALGAS_counter_5F_type (constinAttribute_location COMMA_THERE) {
}

//---------------------------------------------------------------------------*

GALGASap_void_5F_counter GALGASap_void_5F_counter::constructor_new (GALGASap_location & inAttribute_location
                                                                    COMMA_LOCATION_ARGS) {
  GALGAS_void_5F_counter * result = NULL ;
  if (inAttribute_location.isValid ()) {
    macroMyNew (result, GALGAS_void_5F_counter (inAttribute_location COMMA_THERE)) ;
  }
  return result ;
}

//---------------------------------------------------------------------------*

void GALGAS_void_5F_counter::description (C_String & ioString,
                                          const PMSInt32 /* inIndentation */) const {
  ioString << "<class @"
           << typeDescriptor ()->mGalgasTypeName
           << ":" ;
  ioString << ">" ;
}

//---------------------------------------------------------------------------*

GALGAS_void_5F_counter::~GALGAS_void_5F_counter (void) {
}

//---------------------------------------------------------------------------*

void GALGASap_void_5F_counter::insulate (LOCATION_ARGS) {
  if (isValid () && (ptr (HERE)->retainCount () > 1)) {
    GALGASap_void_5F_counter p = constructor_new (ptr (HERE)->mAttribute_location COMMA_THERE) ;
    *this = p ;
  }
}

//---------------------------------------------------------------------------*

void GALGAS_void_5F_counter::modifier_setLocation (GALGASap_location inValue
                                                   COMMA_UNUSED_LOCATION_ARGS) {
  mAttribute_location = inValue ;
}

//---------------------------------------------------------------------------*
//                                                                           *
//                         @void_counter class type                          *
//                                                                           *
//---------------------------------------------------------------------------*

const C_galgas_type_descriptor
kTypeDescriptor_GALGAS_void_5F_counter ("void_counter",
                                        & kTypeDescriptor_GALGAS_counter_5F_type) ;


//---------------------------------------------------------------------------*

const C_galgas_type_descriptor * GALGAS_void_5F_counter::typeDescriptor (void) const {
  return & kTypeDescriptor_GALGAS_void_5F_counter ;
}
//---------------------------------------------------------------------------*

void GALGASap_void_5F_counter::modifierCall_setLocation (GALGASap_location inArgument0
                                                         COMMA_LOCATION_ARGS) {
//--- Release 'output' arguments
//---
  if (isValid ()) {
    insulate (THERE) ;
    ptr (HERE)->modifier_setLocation (inArgument0 COMMA_THERE) ;
  }
}

//---------------------------------------------------------------------------*
//                                                                           *
//                      @software_counter auto ptr type                      *
//                                                                           *
//---------------------------------------------------------------------------*

GALGASap_software_5F_counter::GALGASap_software_5F_counter (const GALGASap_software_5F_counter & inSource) :
GALGASap_counter_5F_type (inSource) {
}

//---------------------------------------------------------------------------*

GALGASap_software_5F_counter::GALGASap_software_5F_counter (const GALGASap_object & inSource) :
GALGASap_counter_5F_type (inSource) {
  macroNullOrValidObject (mPtr, GALGAS_software_5F_counter) ;
}

//---------------------------------------------------------------------------*

GALGASap_software_5F_counter & GALGASap_software_5F_counter::operator = (const GALGASap_software_5F_counter & inSource) {
  macroAssignObject (mPtr, inSource.mPtr) ;
  return * this ;
}

//---------------------------------------------------------------------------*

#ifndef DO_NOT_GENERATE_CHECKINGS
  GALGAS_software_5F_counter * GALGASap_software_5F_counter::ptr (LOCATION_ARGS) {
    macroValidObjectThere (mPtr, GALGAS_software_5F_counter) ;
    return (GALGAS_software_5F_counter *) mPtr ;
  }
#endif

//---------------------------------------------------------------------------*

#ifndef DO_NOT_GENERATE_CHECKINGS
  const GALGAS_software_5F_counter * GALGASap_software_5F_counter::ptr (LOCATION_ARGS) const {
    macroValidObjectThere (mPtr, const GALGAS_software_5F_counter) ;
    return (const GALGAS_software_5F_counter *) mPtr ;
  }
#endif

//---------------------------------------------------------------------------*

GALGASap_software_5F_counter::GALGASap_software_5F_counter (const GALGAS_software_5F_counter * inSourcePtr) :
GALGASap_counter_5F_type (inSourcePtr) {
}

//---------------------------------------------------------------------------*

GALGASap_software_5F_counter & GALGASap_software_5F_counter::operator = (GALGAS_software_5F_counter * inSourcePtr) {
  macroAssignObject (mPtr, inSourcePtr) ;
  return *this ;
}

//---------------------------------------------------------------------------*

enumComparisonResult GALGASap_software_5F_counter::objectCompare (const GALGASap_software_5F_counter & inOperand1,
                                                                  const GALGASap_software_5F_counter & inOperand2) {
  return (inOperand1.isValid () && inOperand2.isValid ()) ? kOperandEqual : kOperandNotValid ;
}


//---------------------------------------------------------------------------*

GALGAS_software_5F_counter::GALGAS_software_5F_counter (const GALGASap_location & constinAttribute_location
                                                        COMMA_LOCATION_ARGS) :
GALGAS_counter_5F_type (constinAttribute_location COMMA_THERE) {
}

//---------------------------------------------------------------------------*

GALGASap_software_5F_counter GALGASap_software_5F_counter::constructor_new (GALGASap_location & inAttribute_location
                                                                            COMMA_LOCATION_ARGS) {
  GALGAS_software_5F_counter * result = NULL ;
  if (inAttribute_location.isValid ()) {
    macroMyNew (result, GALGAS_software_5F_counter (inAttribute_location COMMA_THERE)) ;
  }
  return result ;
}

//---------------------------------------------------------------------------*

void GALGAS_software_5F_counter::description (C_String & ioString,
                                              const PMSInt32 /* inIndentation */) const {
  ioString << "<class @"
           << typeDescriptor ()->mGalgasTypeName
           << ":" ;
  ioString << ">" ;
}

//---------------------------------------------------------------------------*

GALGAS_software_5F_counter::~GALGAS_software_5F_counter (void) {
}

//---------------------------------------------------------------------------*

void GALGASap_software_5F_counter::insulate (LOCATION_ARGS) {
  if (isValid () && (ptr (HERE)->retainCount () > 1)) {
    GALGASap_software_5F_counter p = constructor_new (ptr (HERE)->mAttribute_location COMMA_THERE) ;
    *this = p ;
  }
}

//---------------------------------------------------------------------------*

void GALGAS_software_5F_counter::modifier_setLocation (GALGASap_location inValue
                                                       COMMA_UNUSED_LOCATION_ARGS) {
  mAttribute_location = inValue ;
}

//---------------------------------------------------------------------------*
//                                                                           *
//                       @software_counter class type                        *
//                                                                           *
//---------------------------------------------------------------------------*

const C_galgas_type_descriptor
kTypeDescriptor_GALGAS_software_5F_counter ("software_counter",
                                            & kTypeDescriptor_GALGAS_counter_5F_type) ;


//---------------------------------------------------------------------------*

const C_galgas_type_descriptor * GALGAS_software_5F_counter::typeDescriptor (void) const {
  return & kTypeDescriptor_GALGAS_software_5F_counter ;
}
//---------------------------------------------------------------------------*

void GALGASap_software_5F_counter::modifierCall_setLocation (GALGASap_location inArgument0
                                                             COMMA_LOCATION_ARGS) {
//--- Release 'output' arguments
//---
  if (isValid ()) {
    insulate (THERE) ;
    ptr (HERE)->modifier_setLocation (inArgument0 COMMA_THERE) ;
  }
}

//---------------------------------------------------------------------------*
//                                                                           *
//                      @hardware_counter auto ptr type                      *
//                                                                           *
//---------------------------------------------------------------------------*

GALGASap_hardware_5F_counter::GALGASap_hardware_5F_counter (const GALGASap_hardware_5F_counter & inSource) :
GALGASap_counter_5F_type (inSource) {
}

//---------------------------------------------------------------------------*

GALGASap_hardware_5F_counter::GALGASap_hardware_5F_counter (const GALGASap_object & inSource) :
GALGASap_counter_5F_type (inSource) {
  macroNullOrValidObject (mPtr, GALGAS_hardware_5F_counter) ;
}

//---------------------------------------------------------------------------*

GALGASap_hardware_5F_counter & GALGASap_hardware_5F_counter::operator = (const GALGASap_hardware_5F_counter & inSource) {
  macroAssignObject (mPtr, inSource.mPtr) ;
  return * this ;
}

//---------------------------------------------------------------------------*

GALGASap_counter_5F_driver GALGASap_hardware_5F_counter::readerCall_driver (LOCATION_ARGS) const {
  GALGASap_counter_5F_driver result ;
  if (isValid ()) {
    result = ptr (HERE)->reader_driver (THERE) ;
  }
  return result ;
}

//---------------------------------------------------------------------------*

GALGASap_time_5F_constants GALGASap_hardware_5F_counter::readerCall_time_5F_consts (LOCATION_ARGS) const {
  GALGASap_time_5F_constants result ;
  if (isValid ()) {
    result = ptr (HERE)->reader_time_5F_consts (THERE) ;
  }
  return result ;
}

//---------------------------------------------------------------------------*

#ifndef DO_NOT_GENERATE_CHECKINGS
  GALGAS_hardware_5F_counter * GALGASap_hardware_5F_counter::ptr (LOCATION_ARGS) {
    macroValidObjectThere (mPtr, GALGAS_hardware_5F_counter) ;
    return (GALGAS_hardware_5F_counter *) mPtr ;
  }
#endif

//---------------------------------------------------------------------------*

#ifndef DO_NOT_GENERATE_CHECKINGS
  const GALGAS_hardware_5F_counter * GALGASap_hardware_5F_counter::ptr (LOCATION_ARGS) const {
    macroValidObjectThere (mPtr, const GALGAS_hardware_5F_counter) ;
    return (const GALGAS_hardware_5F_counter *) mPtr ;
  }
#endif

//---------------------------------------------------------------------------*

GALGASap_hardware_5F_counter::GALGASap_hardware_5F_counter (const GALGAS_hardware_5F_counter * inSourcePtr) :
GALGASap_counter_5F_type (inSourcePtr) {
}

//---------------------------------------------------------------------------*

GALGASap_hardware_5F_counter & GALGASap_hardware_5F_counter::operator = (GALGAS_hardware_5F_counter * inSourcePtr) {
  macroAssignObject (mPtr, inSourcePtr) ;
  return *this ;
}

//---------------------------------------------------------------------------*

enumComparisonResult GALGASap_hardware_5F_counter::objectCompare (const GALGASap_hardware_5F_counter & inOperand1,
                                                                  const GALGASap_hardware_5F_counter & inOperand2) {
  enumComparisonResult result = GALGASap_counter_5F_type::objectCompare (inOperand1, inOperand2) ;
  if (kOperandEqual == result) {
    result = GALGASap_counter_5F_driver::objectCompare (inOperand1.ptr (HERE)->mAttribute_driver, inOperand2.ptr (HERE)->mAttribute_driver) ;
  }
  if (kOperandEqual == result) {
    result = GALGASap_time_5F_constants::objectCompare (inOperand1.ptr (HERE)->mAttribute_time_5F_consts, inOperand2.ptr (HERE)->mAttribute_time_5F_consts) ;
  }
  return result ;
}


//---------------------------------------------------------------------------*

GALGAS_hardware_5F_counter::GALGAS_hardware_5F_counter (const GALGASap_location & constinAttribute_location,
                                                        const GALGASap_counter_5F_driver & constinAttribute_driver,
                                                        const GALGASap_time_5F_constants & constinAttribute_time_5F_consts
                                                        COMMA_LOCATION_ARGS) :
GALGAS_counter_5F_type (constinAttribute_location COMMA_THERE),
mAttribute_driver (constinAttribute_driver),
mAttribute_time_5F_consts (constinAttribute_time_5F_consts) {
}

//---------------------------------------------------------------------------*

GALGASap_hardware_5F_counter GALGASap_hardware_5F_counter::constructor_new (GALGASap_location & inAttribute_location,
                                                                            GALGASap_counter_5F_driver & inAttribute_driver,
                                                                            GALGASap_time_5F_constants & inAttribute_time_5F_consts
                                                                            COMMA_LOCATION_ARGS) {
  GALGAS_hardware_5F_counter * result = NULL ;
  if (inAttribute_location.isValid () && inAttribute_driver.isValid () && inAttribute_time_5F_consts.isValid ()) {
    macroMyNew (result, GALGAS_hardware_5F_counter (inAttribute_location, inAttribute_driver, inAttribute_time_5F_consts COMMA_THERE)) ;
  }
  return result ;
}

//---------------------------------------------------------------------------*

void GALGAS_hardware_5F_counter::description (C_String & ioString,
                                              const PMSInt32 /* inIndentation */) const {
  ioString << "<class @"
           << typeDescriptor ()->mGalgasTypeName
           << ":" ;
//  mAttribute_driver->description (ioString, inIndentation + 1) ;
  ioString << ", " ;
//  mAttribute_time_5F_consts->description (ioString, inIndentation + 1) ;
  ioString << ">" ;
}

//---------------------------------------------------------------------------*

GALGAS_hardware_5F_counter::~GALGAS_hardware_5F_counter (void) {
}

//---------------------------------------------------------------------------*

void GALGASap_hardware_5F_counter::insulate (LOCATION_ARGS) {
  if (isValid () && (ptr (HERE)->retainCount () > 1)) {
    GALGASap_hardware_5F_counter p = constructor_new (ptr (HERE)->mAttribute_location, ptr (HERE)->mAttribute_driver, ptr (HERE)->mAttribute_time_5F_consts COMMA_THERE) ;
    *this = p ;
  }
}

//---------------------------------------------------------------------------*

GALGASap_counter_5F_driver GALGAS_hardware_5F_counter::reader_driver (UNUSED_LOCATION_ARGS) const {
  return mAttribute_driver ;
}

//---------------------------------------------------------------------------*

GALGASap_time_5F_constants GALGAS_hardware_5F_counter::reader_time_5F_consts (UNUSED_LOCATION_ARGS) const {
  return mAttribute_time_5F_consts ;
}

//---------------------------------------------------------------------------*

void GALGAS_hardware_5F_counter::modifier_setLocation (GALGASap_location inValue
                                                       COMMA_UNUSED_LOCATION_ARGS) {
  mAttribute_location = inValue ;
}

//---------------------------------------------------------------------------*

void GALGAS_hardware_5F_counter::modifier_setDriver (GALGASap_counter_5F_driver inValue
                                                     COMMA_UNUSED_LOCATION_ARGS) {
  mAttribute_driver = inValue ;
}

//---------------------------------------------------------------------------*

void GALGAS_hardware_5F_counter::modifier_setTime_5F_consts (GALGASap_time_5F_constants inValue
                                                             COMMA_UNUSED_LOCATION_ARGS) {
  mAttribute_time_5F_consts = inValue ;
}

//---------------------------------------------------------------------------*
//                                                                           *
//                       @hardware_counter class type                        *
//                                                                           *
//---------------------------------------------------------------------------*

const C_galgas_type_descriptor
kTypeDescriptor_GALGAS_hardware_5F_counter ("hardware_counter",
                                            & kTypeDescriptor_GALGAS_counter_5F_type) ;


//---------------------------------------------------------------------------*

const C_galgas_type_descriptor * GALGAS_hardware_5F_counter::typeDescriptor (void) const {
  return & kTypeDescriptor_GALGAS_hardware_5F_counter ;
}
//---------------------------------------------------------------------------*

void GALGASap_hardware_5F_counter::modifierCall_setDriver (GALGASap_counter_5F_driver inArgument0
                                                           COMMA_LOCATION_ARGS) {
//--- Release 'output' arguments
//---
  if (isValid ()) {
    insulate (THERE) ;
    ptr (HERE)->modifier_setDriver (inArgument0 COMMA_THERE) ;
  }
}

//---------------------------------------------------------------------------*

void GALGASap_hardware_5F_counter::modifierCall_setLocation (GALGASap_location inArgument0
                                                             COMMA_LOCATION_ARGS) {
//--- Release 'output' arguments
//---
  if (isValid ()) {
    insulate (THERE) ;
    ptr (HERE)->modifier_setLocation (inArgument0 COMMA_THERE) ;
  }
}

//---------------------------------------------------------------------------*

void GALGASap_hardware_5F_counter::modifierCall_setTime_5F_consts (GALGASap_time_5F_constants inArgument0
                                                                   COMMA_LOCATION_ARGS) {
//--- Release 'output' arguments
//---
  if (isValid ()) {
    insulate (THERE) ;
    ptr (HERE)->modifier_setTime_5F_consts (inArgument0 COMMA_THERE) ;
  }
}

//---------------------------------------------------------------------------*
//                                                                           *
//                        @counter_obj auto ptr type                         *
//                                                                           *
//---------------------------------------------------------------------------*

GALGASap_counter_5F_obj::GALGASap_counter_5F_obj (const GALGASap_counter_5F_obj & inSource) :
GALGASap_oil_5F_obj (inSource) {
}

//---------------------------------------------------------------------------*

GALGASap_counter_5F_obj::GALGASap_counter_5F_obj (const GALGASap_object & inSource) :
GALGASap_oil_5F_obj (inSource) {
  macroNullOrValidObject (mPtr, GALGAS_counter_5F_obj) ;
}

//---------------------------------------------------------------------------*

GALGASap_counter_5F_obj & GALGASap_counter_5F_obj::operator = (const GALGASap_counter_5F_obj & inSource) {
  macroAssignObject (mPtr, inSource.mPtr) ;
  return * this ;
}

//---------------------------------------------------------------------------*

GALGASap_lstringlist GALGASap_counter_5F_obj::readerCall_acc_5F_apps (LOCATION_ARGS) const {
  GALGASap_lstringlist result ;
  if (isValid ()) {
    result = ptr (HERE)->reader_acc_5F_apps (THERE) ;
  }
  return result ;
}

//---------------------------------------------------------------------------*

GALGASap_basic_5F_type GALGASap_counter_5F_obj::readerCall_max_5F_allowed_5F_value (LOCATION_ARGS) const {
  GALGASap_basic_5F_type result ;
  if (isValid ()) {
    result = ptr (HERE)->reader_max_5F_allowed_5F_value (THERE) ;
  }
  return result ;
}

//---------------------------------------------------------------------------*

GALGASap_basic_5F_type GALGASap_counter_5F_obj::readerCall_min_5F_cycle (LOCATION_ARGS) const {
  GALGASap_basic_5F_type result ;
  if (isValid ()) {
    result = ptr (HERE)->reader_min_5F_cycle (THERE) ;
  }
  return result ;
}

//---------------------------------------------------------------------------*

GALGASap_lstring GALGASap_counter_5F_obj::readerCall_source (LOCATION_ARGS) const {
  GALGASap_lstring result ;
  if (isValid ()) {
    result = ptr (HERE)->reader_source (THERE) ;
  }
  return result ;
}

//---------------------------------------------------------------------------*

GALGASap_basic_5F_type GALGASap_counter_5F_obj::readerCall_ticks_5F_per_5F_base (LOCATION_ARGS) const {
  GALGASap_basic_5F_type result ;
  if (isValid ()) {
    result = ptr (HERE)->reader_ticks_5F_per_5F_base (THERE) ;
  }
  return result ;
}

//---------------------------------------------------------------------------*

GALGASap_counter_5F_type GALGASap_counter_5F_obj::readerCall_type (LOCATION_ARGS) const {
  GALGASap_counter_5F_type result ;
  if (isValid ()) {
    result = ptr (HERE)->reader_type (THERE) ;
  }
  return result ;
}

//---------------------------------------------------------------------------*

GALGASap_lstring GALGASap_counter_5F_obj::readerCall_unit (LOCATION_ARGS) const {
  GALGASap_lstring result ;
  if (isValid ()) {
    result = ptr (HERE)->reader_unit (THERE) ;
  }
  return result ;
}

//---------------------------------------------------------------------------*

#ifndef DO_NOT_GENERATE_CHECKINGS
  GALGAS_counter_5F_obj * GALGASap_counter_5F_obj::ptr (LOCATION_ARGS) {
    macroValidObjectThere (mPtr, GALGAS_counter_5F_obj) ;
    return (GALGAS_counter_5F_obj *) mPtr ;
  }
#endif

//---------------------------------------------------------------------------*

#ifndef DO_NOT_GENERATE_CHECKINGS
  const GALGAS_counter_5F_obj * GALGASap_counter_5F_obj::ptr (LOCATION_ARGS) const {
    macroValidObjectThere (mPtr, const GALGAS_counter_5F_obj) ;
    return (const GALGAS_counter_5F_obj *) mPtr ;
  }
#endif

//---------------------------------------------------------------------------*

GALGASap_counter_5F_obj::GALGASap_counter_5F_obj (const GALGAS_counter_5F_obj * inSourcePtr) :
GALGASap_oil_5F_obj (inSourcePtr) {
}

//---------------------------------------------------------------------------*

GALGASap_counter_5F_obj & GALGASap_counter_5F_obj::operator = (GALGAS_counter_5F_obj * inSourcePtr) {
  macroAssignObject (mPtr, inSourcePtr) ;
  return *this ;
}

//---------------------------------------------------------------------------*

enumComparisonResult GALGASap_counter_5F_obj::objectCompare (const GALGASap_counter_5F_obj & inOperand1,
                                                             const GALGASap_counter_5F_obj & inOperand2) {
  enumComparisonResult result = GALGASap_oil_5F_obj::objectCompare (inOperand1, inOperand2) ;
  if (kOperandEqual == result) {
    result = GALGASap_basic_5F_type::objectCompare (inOperand1.ptr (HERE)->mAttribute_max_5F_allowed_5F_value, inOperand2.ptr (HERE)->mAttribute_max_5F_allowed_5F_value) ;
  }
  if (kOperandEqual == result) {
    result = GALGASap_basic_5F_type::objectCompare (inOperand1.ptr (HERE)->mAttribute_ticks_5F_per_5F_base, inOperand2.ptr (HERE)->mAttribute_ticks_5F_per_5F_base) ;
  }
  if (kOperandEqual == result) {
    result = GALGASap_basic_5F_type::objectCompare (inOperand1.ptr (HERE)->mAttribute_min_5F_cycle, inOperand2.ptr (HERE)->mAttribute_min_5F_cycle) ;
  }
  if (kOperandEqual == result) {
    result = GALGASap_lstring::objectCompare (inOperand1.ptr (HERE)->mAttribute_source, inOperand2.ptr (HERE)->mAttribute_source) ;
  }
  if (kOperandEqual == result) {
    result = GALGASap_lstringlist::objectCompare (inOperand1.ptr (HERE)->mAttribute_acc_5F_apps, inOperand2.ptr (HERE)->mAttribute_acc_5F_apps) ;
  }
  if (kOperandEqual == result) {
    result = GALGASap_counter_5F_type::objectCompare (inOperand1.ptr (HERE)->mAttribute_type, inOperand2.ptr (HERE)->mAttribute_type) ;
  }
  if (kOperandEqual == result) {
    result = GALGASap_lstring::objectCompare (inOperand1.ptr (HERE)->mAttribute_unit, inOperand2.ptr (HERE)->mAttribute_unit) ;
  }
  return result ;
}


//---------------------------------------------------------------------------*

GALGAS_counter_5F_obj::GALGAS_counter_5F_obj (const GALGASap_lstring & constinAttribute_desc,
                                              const GALGASap_basic_5F_type & constinAttribute_max_5F_allowed_5F_value,
                                              const GALGASap_basic_5F_type & constinAttribute_ticks_5F_per_5F_base,
                                              const GALGASap_basic_5F_type & constinAttribute_min_5F_cycle,
                                              const GALGASap_lstring & constinAttribute_source,
                                              const GALGASap_lstringlist & constinAttribute_acc_5F_apps,
                                              const GALGASap_counter_5F_type & constinAttribute_type,
                                              const GALGASap_lstring & constinAttribute_unit
                                              COMMA_LOCATION_ARGS) :
GALGAS_oil_5F_obj (constinAttribute_desc COMMA_THERE),
mAttribute_max_5F_allowed_5F_value (constinAttribute_max_5F_allowed_5F_value),
mAttribute_ticks_5F_per_5F_base (constinAttribute_ticks_5F_per_5F_base),
mAttribute_min_5F_cycle (constinAttribute_min_5F_cycle),
mAttribute_source (constinAttribute_source),
mAttribute_acc_5F_apps (constinAttribute_acc_5F_apps),
mAttribute_type (constinAttribute_type),
mAttribute_unit (constinAttribute_unit) {
}

//---------------------------------------------------------------------------*

GALGASap_counter_5F_obj GALGASap_counter_5F_obj::constructor_new (GALGASap_lstring & inAttribute_desc,
                                                                  GALGASap_basic_5F_type & inAttribute_max_5F_allowed_5F_value,
                                                                  GALGASap_basic_5F_type & inAttribute_ticks_5F_per_5F_base,
                                                                  GALGASap_basic_5F_type & inAttribute_min_5F_cycle,
                                                                  GALGASap_lstring & inAttribute_source,
                                                                  GALGASap_lstringlist & inAttribute_acc_5F_apps,
                                                                  GALGASap_counter_5F_type & inAttribute_type,
                                                                  GALGASap_lstring & inAttribute_unit
                                                                  COMMA_LOCATION_ARGS) {
  GALGAS_counter_5F_obj * result = NULL ;
  if (inAttribute_desc.isValid () && inAttribute_max_5F_allowed_5F_value.isValid () && inAttribute_ticks_5F_per_5F_base.isValid () && inAttribute_min_5F_cycle.isValid () && inAttribute_source.isValid () && inAttribute_acc_5F_apps.isValid () && inAttribute_type.isValid () && inAttribute_unit.isValid ()) {
    macroMyNew (result, GALGAS_counter_5F_obj (inAttribute_desc, inAttribute_max_5F_allowed_5F_value, inAttribute_ticks_5F_per_5F_base, inAttribute_min_5F_cycle, inAttribute_source, inAttribute_acc_5F_apps, inAttribute_type, inAttribute_unit COMMA_THERE)) ;
  }
  return result ;
}

//---------------------------------------------------------------------------*

void GALGAS_counter_5F_obj::description (C_String & ioString,
                                         const PMSInt32 /* inIndentation */) const {
  ioString << "<class @"
           << typeDescriptor ()->mGalgasTypeName
           << ":" ;
//  mAttribute_max_5F_allowed_5F_value->description (ioString, inIndentation + 1) ;
  ioString << ", " ;
//  mAttribute_ticks_5F_per_5F_base->description (ioString, inIndentation + 1) ;
  ioString << ", " ;
//  mAttribute_min_5F_cycle->description (ioString, inIndentation + 1) ;
  ioString << ", " ;
//  mAttribute_source->description (ioString, inIndentation + 1) ;
  ioString << ", " ;
//  mAttribute_acc_5F_apps->description (ioString, inIndentation + 1) ;
  ioString << ", " ;
//  mAttribute_type->description (ioString, inIndentation + 1) ;
  ioString << ", " ;
//  mAttribute_unit->description (ioString, inIndentation + 1) ;
  ioString << ">" ;
}

//---------------------------------------------------------------------------*

GALGAS_counter_5F_obj::~GALGAS_counter_5F_obj (void) {
}

//---------------------------------------------------------------------------*

void GALGASap_counter_5F_obj::insulate (LOCATION_ARGS) {
  if (isValid () && (ptr (HERE)->retainCount () > 1)) {
    GALGASap_counter_5F_obj p = constructor_new (ptr (HERE)->mAttribute_desc, ptr (HERE)->mAttribute_max_5F_allowed_5F_value, ptr (HERE)->mAttribute_ticks_5F_per_5F_base, ptr (HERE)->mAttribute_min_5F_cycle, ptr (HERE)->mAttribute_source, ptr (HERE)->mAttribute_acc_5F_apps, ptr (HERE)->mAttribute_type, ptr (HERE)->mAttribute_unit COMMA_THERE) ;
    *this = p ;
  }
}

//---------------------------------------------------------------------------*

GALGASap_basic_5F_type GALGAS_counter_5F_obj::reader_max_5F_allowed_5F_value (UNUSED_LOCATION_ARGS) const {
  return mAttribute_max_5F_allowed_5F_value ;
}

//---------------------------------------------------------------------------*

GALGASap_basic_5F_type GALGAS_counter_5F_obj::reader_ticks_5F_per_5F_base (UNUSED_LOCATION_ARGS) const {
  return mAttribute_ticks_5F_per_5F_base ;
}

//---------------------------------------------------------------------------*

GALGASap_basic_5F_type GALGAS_counter_5F_obj::reader_min_5F_cycle (UNUSED_LOCATION_ARGS) const {
  return mAttribute_min_5F_cycle ;
}

//---------------------------------------------------------------------------*

GALGASap_lstring GALGAS_counter_5F_obj::reader_source (UNUSED_LOCATION_ARGS) const {
  return mAttribute_source ;
}

//---------------------------------------------------------------------------*

GALGASap_lstringlist GALGAS_counter_5F_obj::reader_acc_5F_apps (UNUSED_LOCATION_ARGS) const {
  return mAttribute_acc_5F_apps ;
}

//---------------------------------------------------------------------------*

GALGASap_counter_5F_type GALGAS_counter_5F_obj::reader_type (UNUSED_LOCATION_ARGS) const {
  return mAttribute_type ;
}

//---------------------------------------------------------------------------*

GALGASap_lstring GALGAS_counter_5F_obj::reader_unit (UNUSED_LOCATION_ARGS) const {
  return mAttribute_unit ;
}

//---------------------------------------------------------------------------*

void GALGAS_counter_5F_obj::modifier_setDesc (GALGASap_lstring inValue
                                              COMMA_UNUSED_LOCATION_ARGS) {
  mAttribute_desc = inValue ;
}

//---------------------------------------------------------------------------*

void GALGAS_counter_5F_obj::modifier_setMax_5F_allowed_5F_value (GALGASap_basic_5F_type inValue
                                                                 COMMA_UNUSED_LOCATION_ARGS) {
  mAttribute_max_5F_allowed_5F_value = inValue ;
}

//---------------------------------------------------------------------------*

void GALGAS_counter_5F_obj::modifier_setTicks_5F_per_5F_base (GALGASap_basic_5F_type inValue
                                                              COMMA_UNUSED_LOCATION_ARGS) {
  mAttribute_ticks_5F_per_5F_base = inValue ;
}

//---------------------------------------------------------------------------*

void GALGAS_counter_5F_obj::modifier_setMin_5F_cycle (GALGASap_basic_5F_type inValue
                                                      COMMA_UNUSED_LOCATION_ARGS) {
  mAttribute_min_5F_cycle = inValue ;
}

//---------------------------------------------------------------------------*

void GALGAS_counter_5F_obj::modifier_setSource (GALGASap_lstring inValue
                                                COMMA_UNUSED_LOCATION_ARGS) {
  mAttribute_source = inValue ;
}

//---------------------------------------------------------------------------*

void GALGAS_counter_5F_obj::modifier_setAcc_5F_apps (GALGASap_lstringlist inValue
                                                     COMMA_UNUSED_LOCATION_ARGS) {
  mAttribute_acc_5F_apps = inValue ;
}

//---------------------------------------------------------------------------*

void GALGAS_counter_5F_obj::modifier_setType (GALGASap_counter_5F_type inValue
                                              COMMA_UNUSED_LOCATION_ARGS) {
  mAttribute_type = inValue ;
}

//---------------------------------------------------------------------------*

void GALGAS_counter_5F_obj::modifier_setUnit (GALGASap_lstring inValue
                                              COMMA_UNUSED_LOCATION_ARGS) {
  mAttribute_unit = inValue ;
}

//---------------------------------------------------------------------------*
//                                                                           *
//                          @counter_obj class type                          *
//                                                                           *
//---------------------------------------------------------------------------*

const C_galgas_type_descriptor
kTypeDescriptor_GALGAS_counter_5F_obj ("counter_obj",
                                       & kTypeDescriptor_GALGAS_oil_5F_obj) ;


//---------------------------------------------------------------------------*

const C_galgas_type_descriptor * GALGAS_counter_5F_obj::typeDescriptor (void) const {
  return & kTypeDescriptor_GALGAS_counter_5F_obj ;
}
//---------------------------------------------------------------------------*

void GALGASap_counter_5F_obj::modifierCall_setAcc_5F_apps (GALGASap_lstringlist inArgument0
                                                           COMMA_LOCATION_ARGS) {
//--- Release 'output' arguments
//---
  if (isValid ()) {
    insulate (THERE) ;
    ptr (HERE)->modifier_setAcc_5F_apps (inArgument0 COMMA_THERE) ;
  }
}

//---------------------------------------------------------------------------*

void GALGASap_counter_5F_obj::modifierCall_setDesc (GALGASap_lstring inArgument0
                                                    COMMA_LOCATION_ARGS) {
//--- Release 'output' arguments
//---
  if (isValid ()) {
    insulate (THERE) ;
    ptr (HERE)->modifier_setDesc (inArgument0 COMMA_THERE) ;
  }
}

//---------------------------------------------------------------------------*

void GALGASap_counter_5F_obj::modifierCall_setMax_5F_allowed_5F_value (GALGASap_basic_5F_type inArgument0
                                                                       COMMA_LOCATION_ARGS) {
//--- Release 'output' arguments
//---
  if (isValid ()) {
    insulate (THERE) ;
    ptr (HERE)->modifier_setMax_5F_allowed_5F_value (inArgument0 COMMA_THERE) ;
  }
}

//---------------------------------------------------------------------------*

void GALGASap_counter_5F_obj::modifierCall_setMin_5F_cycle (GALGASap_basic_5F_type inArgument0
                                                            COMMA_LOCATION_ARGS) {
//--- Release 'output' arguments
//---
  if (isValid ()) {
    insulate (THERE) ;
    ptr (HERE)->modifier_setMin_5F_cycle (inArgument0 COMMA_THERE) ;
  }
}

//---------------------------------------------------------------------------*

void GALGASap_counter_5F_obj::modifierCall_setSource (GALGASap_lstring inArgument0
                                                      COMMA_LOCATION_ARGS) {
//--- Release 'output' arguments
//---
  if (isValid ()) {
    insulate (THERE) ;
    ptr (HERE)->modifier_setSource (inArgument0 COMMA_THERE) ;
  }
}

//---------------------------------------------------------------------------*

void GALGASap_counter_5F_obj::modifierCall_setTicks_5F_per_5F_base (GALGASap_basic_5F_type inArgument0
                                                                    COMMA_LOCATION_ARGS) {
//--- Release 'output' arguments
//---
  if (isValid ()) {
    insulate (THERE) ;
    ptr (HERE)->modifier_setTicks_5F_per_5F_base (inArgument0 COMMA_THERE) ;
  }
}

//---------------------------------------------------------------------------*

void GALGASap_counter_5F_obj::modifierCall_setType (GALGASap_counter_5F_type inArgument0
                                                    COMMA_LOCATION_ARGS) {
//--- Release 'output' arguments
//---
  if (isValid ()) {
    insulate (THERE) ;
    ptr (HERE)->modifier_setType (inArgument0 COMMA_THERE) ;
  }
}

//---------------------------------------------------------------------------*

void GALGASap_counter_5F_obj::modifierCall_setUnit (GALGASap_lstring inArgument0
                                                    COMMA_LOCATION_ARGS) {
//--- Release 'output' arguments
//---
  if (isValid ()) {
    insulate (THERE) ;
    ptr (HERE)->modifier_setUnit (inArgument0 COMMA_THERE) ;
  }
}

//---------------------------------------------------------------------------*
//                                                                           *
//                        @counter_map auto ptr type                         *
//                                                                           *
//---------------------------------------------------------------------------*

GALGASap_counter_5F_map::GALGASap_counter_5F_map (const GALGASap_counter_5F_map & inSource) :
GALGASap_map (inSource) {
}

//---------------------------------------------------------------------------*

GALGASap_counter_5F_map::GALGASap_counter_5F_map (const GALGASap_object & inSource) :
GALGASap_map (inSource) {
  macroNullOrValidObject (mPtr, GALGAS_counter_5F_map) ;
}

//---------------------------------------------------------------------------*

GALGASap_counter_5F_map & GALGASap_counter_5F_map::operator = (const GALGASap_counter_5F_map & inSource) {
  macroAssignObject (mPtr, inSource.mPtr) ;
  return * this ;
}

//---------------------------------------------------------------------------*

GALGASap_counter_5F_obj GALGASap_counter_5F_map::readerCall_counterForKey (const GALGASap_string & inOperand_0,
                                                                           C_Compiler * inCompiler
                                                                           COMMA_LOCATION_ARGS) const {
  GALGASap_counter_5F_obj result ;
  if (isValid ()) {
    result = ptr (HERE)->reader_counterForKey (inOperand_0, inCompiler COMMA_THERE) ;
  }
  return result ;
}

//---------------------------------------------------------------------------*

GALGASap_counter_5F_map GALGASap_counter_5F_map::readerCall_overriddenMap (LOCATION_ARGS) const {
  GALGASap_counter_5F_map result ;
  if (isValid ()) {
    result = ptr (HERE)->reader_overriddenMap (THERE) ;
  }
  return result ;
}

//---------------------------------------------------------------------------*

#ifndef DO_NOT_GENERATE_CHECKINGS
  GALGAS_counter_5F_map * GALGASap_counter_5F_map::ptr (LOCATION_ARGS) {
    macroValidObjectThere (mPtr, GALGAS_counter_5F_map) ;
    return (GALGAS_counter_5F_map *) mPtr ;
  }
#endif

//---------------------------------------------------------------------------*

#ifndef DO_NOT_GENERATE_CHECKINGS
  const GALGAS_counter_5F_map * GALGASap_counter_5F_map::ptr (LOCATION_ARGS) const {
    macroValidObjectThere (mPtr, const GALGAS_counter_5F_map) ;
    return (const GALGAS_counter_5F_map *) mPtr ;
  }
#endif

//---------------------------------------------------------------------------*

GALGASap_counter_5F_map::GALGASap_counter_5F_map (const GALGAS_counter_5F_map * inSourcePtr) :
GALGASap_map (inSourcePtr) {
}

//---------------------------------------------------------------------------*

GALGASap_counter_5F_map & GALGASap_counter_5F_map::operator = (GALGAS_counter_5F_map * inSourcePtr) {
  macroAssignObject (mPtr, inSourcePtr) ;
  return *this ;
}

//---------------------------------------------------------------------------*
//                                                                           *
//                Class for element of '@counter_5F_map' map                 *
//                                                                           *
//---------------------------------------------------------------------------*

cCollectionElement_counter_5F_map::cCollectionElement_counter_5F_map (const GALGASap_lstring & inKey,
                                                                      const GALGASap_counter_5F_obj & in_counter
                                                                      COMMA_LOCATION_ARGS) :
cCollectionElementForMap (inKey COMMA_THERE),
mAttribute_counter (in_counter) {
}

//---------------------------------------------------------------------------*

bool cCollectionElement_counter_5F_map::isValid (void) const {
  return mAttribute_lkey.isValid () && mAttribute_counter.isValid () ;
}

//---------------------------------------------------------------------------*

cCollectionElement * cCollectionElement_counter_5F_map::copy (void) {
  cCollectionElement * result = NULL ;
  macroMyNew (result, cCollectionElement_counter_5F_map (mAttribute_lkey, mAttribute_counter COMMA_HERE)) ;
  return result ;
}

//---------------------------------------------------------------------------*

void cCollectionElement_counter_5F_map::description (C_String & /* ioString */, const PMSInt32 /* inIndentation */) const {
// mAttribute_counter.description (ioString, inIndentation) ;
}

//---------------------------------------------------------------------------*

enumComparisonResult cCollectionElement_counter_5F_map::compare (const cCollectionElement * inOperand) {
  cCollectionElement_counter_5F_map * operand = (cCollectionElement_counter_5F_map *) inOperand ;
  enumComparisonResult result = GALGASap_lstring::objectCompare (mAttribute_lkey, operand->mAttribute_lkey) ;
  if (kOperandEqual == result) {
    result = GALGASap_counter_5F_obj::objectCompare (mAttribute_counter, operand->mAttribute_counter) ;
  }
  return result ;
}

//---------------------------------------------------------------------------*

GALGAS_counter_5F_map::GALGAS_counter_5F_map (LOCATION_ARGS) :
GALGAS_map (THERE) {
}

//---------------------------------------------------------------------------*

GALGASap_counter_5F_map GALGASap_counter_5F_map::constructor_emptyMap (LOCATION_ARGS) {
  GALGAS_counter_5F_map * result = NULL ;
  macroMyNew (result, GALGAS_counter_5F_map (THERE)) ;
  return result ;
}

//---------------------------------------------------------------------------*

GALGASap_counter_5F_map GALGASap_counter_5F_map::constructor_mapWithMapToOverride (GALGASap_counter_5F_map & inMapToOverride
                                                                                   COMMA_LOCATION_ARGS) {
  GALGASap_counter_5F_map result ;
  if (inMapToOverride.isValid ()) {
    result = constructor_emptyMap (THERE) ;
    result.ptr (HERE)->mOverridenMap = inMapToOverride ;
  }
  return result ;
}

//---------------------------------------------------------------------------*

void GALGASap_counter_5F_map::insulate (LOCATION_ARGS) {
  if (ptr (HERE)->retainCount () > 1) {
    GALGASap_counter_5F_map newMap (constructor_emptyMap (THERE)) ;
    newMap.ptr (HERE)->copyFrom (ptr(HERE)) ;
    *this = newMap ;
  }
}

//---------------------------------------------------------------------------*

GALGASap_counter_5F_map GALGAS_counter_5F_map::reader_overriddenMap (LOCATION_ARGS) const {
  GALGASap_counter_5F_map result = mOverridenMap ;
  if (! result.isValid ()) {
    result = GALGASap_counter_5F_map::constructor_emptyMap (THERE) ;
  }
  return result ;
}

//---------------------------------------------------------------------------*

void GALGAS_counter_5F_map::modifier_put (GALGASap_lstring inKey,
                                          GALGASap_counter_5F_obj inArgument0,
                                          C_Compiler * inCompiler
                                          COMMA_LOCATION_ARGS) {
  cCollectionElement_counter_5F_map * p = NULL ;
  macroMyNew (p, cCollectionElement_counter_5F_map (inKey, inArgument0 COMMA_HERE)) ;
  capCollectionElement attributes (p) ;
  const utf32 kInsertErrorMessage [31] = {
    TO_UNICODE ('C'),
    TO_UNICODE ('o'),
    TO_UNICODE ('u'),
    TO_UNICODE ('n'),
    TO_UNICODE ('t'),
    TO_UNICODE ('e'),
    TO_UNICODE ('r'),
    TO_UNICODE (' '),
    TO_UNICODE ('%'),
    TO_UNICODE ('K'),
    TO_UNICODE (' '),
    TO_UNICODE ('i'),
    TO_UNICODE ('s'),
    TO_UNICODE (' '),
    TO_UNICODE ('d'),
    TO_UNICODE ('u'),
    TO_UNICODE ('p'),
    TO_UNICODE ('l'),
    TO_UNICODE ('i'),
    TO_UNICODE ('c'),
    TO_UNICODE ('a'),
    TO_UNICODE ('t'),
    TO_UNICODE ('e'),
    TO_UNICODE ('d'),
    TO_UNICODE (' '),
    TO_UNICODE ('i'),
    TO_UNICODE ('n'),
    TO_UNICODE (' '),
    TO_UNICODE ('%'),
    TO_UNICODE ('L'),
    TO_UNICODE (0)
  } ;
  const utf32 kShadowErrorMessage [1] = {
    TO_UNICODE (0)
  } ;
  performInsert (attributes, inCompiler, kInsertErrorMessage, kShadowErrorMessage COMMA_THERE) ;
}

//---------------------------------------------------------------------------*

static const utf32 kSearchErrorMessage_counter_5F_map_getCounter [26] = {
  TO_UNICODE ('C'),
  TO_UNICODE ('o'),
  TO_UNICODE ('u'),
  TO_UNICODE ('n'),
  TO_UNICODE ('t'),
  TO_UNICODE ('e'),
  TO_UNICODE ('r'),
  TO_UNICODE (' '),
  TO_UNICODE ('%'),
  TO_UNICODE ('K'),
  TO_UNICODE (' '),
  TO_UNICODE ('i'),
  TO_UNICODE ('s'),
  TO_UNICODE (' '),
  TO_UNICODE ('n'),
  TO_UNICODE ('o'),
  TO_UNICODE ('t'),
  TO_UNICODE (' '),
  TO_UNICODE ('d'),
  TO_UNICODE ('e'),
  TO_UNICODE ('f'),
  TO_UNICODE ('i'),
  TO_UNICODE ('n'),
  TO_UNICODE ('e'),
  TO_UNICODE ('d'),
  TO_UNICODE (0)
} ;

//---------------------------------------------------------------------------*

void GALGAS_counter_5F_map::method_getCounter (GALGASap_lstring inKey,
                                               GALGASap_counter_5F_obj & outArgument0,
                                               C_Compiler * inCompiler
                                               COMMA_LOCATION_ARGS) {
  capCollectionElement attributes = performSearch (inKey, inCompiler, kSearchErrorMessage_counter_5F_map_getCounter COMMA_THERE) ;
  cCollectionElement_counter_5F_map * p = (cCollectionElement_counter_5F_map *) attributes.ptrNoVerif () ;
  if (NULL != p) {
    macroValidObject (p, cCollectionElement_counter_5F_map) ;
    outArgument0 = p->mAttribute_counter ;
  }
}

//---------------------------------------------------------------------------*

void GALGAS_counter_5F_map::modifier_del (GALGASap_lstring inKey,
                                          GALGASap_counter_5F_obj & outArgument0,
                                          C_Compiler * inCompiler
                                          COMMA_LOCATION_ARGS) {
  const utf32 kRemoveErrorMessage [26] = {
    TO_UNICODE ('C'),
    TO_UNICODE ('o'),
    TO_UNICODE ('u'),
    TO_UNICODE ('n'),
    TO_UNICODE ('t'),
    TO_UNICODE ('e'),
    TO_UNICODE ('r'),
    TO_UNICODE (' '),
    TO_UNICODE ('%'),
    TO_UNICODE ('K'),
    TO_UNICODE (' '),
    TO_UNICODE ('i'),
    TO_UNICODE ('s'),
    TO_UNICODE (' '),
    TO_UNICODE ('n'),
    TO_UNICODE ('o'),
    TO_UNICODE ('t'),
    TO_UNICODE (' '),
    TO_UNICODE ('d'),
    TO_UNICODE ('e'),
    TO_UNICODE ('f'),
    TO_UNICODE ('i'),
    TO_UNICODE ('n'),
    TO_UNICODE ('e'),
    TO_UNICODE ('d'),
    TO_UNICODE (0)
  } ;
  capCollectionElement attributes ;
  performRemove (inKey, attributes, inCompiler, kRemoveErrorMessage COMMA_THERE) ;
  cCollectionElement_counter_5F_map * p = (cCollectionElement_counter_5F_map *) attributes.ptrNoVerif () ;
  if (NULL != p) {
    macroValidObject (p, cCollectionElement_counter_5F_map) ;
    outArgument0 = p->mAttribute_counter ;
  }
}

//---------------------------------------------------------------------------*

GALGASap_counter_5F_obj GALGAS_counter_5F_map::reader_counterForKey (const GALGASap_string & inKey,
                                                                     C_Compiler * inCompiler
                                                                     COMMA_LOCATION_ARGS) const {
  capCollectionElement attributes = searchForReadingAttribute (inKey, inCompiler COMMA_THERE) ;
  cCollectionElement_counter_5F_map * p = (cCollectionElement_counter_5F_map *) attributes.ptrNoVerif () ;
  GALGASap_counter_5F_obj result ;
  if (NULL != p) {
    macroValidObject (p, cCollectionElement_counter_5F_map) ;
    result = p->mAttribute_counter ;
  }
  return result ;
}

//---------------------------------------------------------------------------*

void GALGAS_counter_5F_map::modifier_setCounterForKey (GALGASap_counter_5F_obj inAttributeValue,
                                                       GALGASap_string inKey,
                                                       C_Compiler * inCompiler
                                                       COMMA_LOCATION_ARGS) {
  cCollectionElement_counter_5F_map * p = (cCollectionElement_counter_5F_map *) searchForReadWriteAttribute (inKey, inCompiler COMMA_THERE) ;
  if (NULL != p) {
    MF_Assert (dynamic_cast <cCollectionElement_counter_5F_map *> (p) != NULL, "p is not an instance of cCollectionElement_counter_5F_map *", 0, 0) ;
    p->mAttribute_counter = inAttributeValue ;
  }
}

//---------------------------------------------------------------------------*

cCollectionElement * readWriteAccessForWithInstruction_getCounter (C_Compiler * inCompiler,
                                                                   GALGASap_counter_5F_map & ioMap,
                                                                   GALGASap_lstring & inKey
                                                                   COMMA_LOCATION_ARGS) {
  cCollectionElement * result = NULL ;
  if (ioMap.isValid () && inKey.isValid ()) {
    ioMap.insulate (THERE) ;
    result = ioMap.ptr (HERE)->searchForReadWriteAttribute (inKey, inCompiler, kSearchErrorMessage_counter_5F_map_getCounter COMMA_THERE) ;
  }
  return result ;
}

//---------------------------------------------------------------------------*

cCollectionElement * readWriteAccessForWithInstruction_hasKey (C_Compiler * inCompiler,
                                                               GALGASap_counter_5F_map & ioMap,
                                                               GALGASap_string & inKey
                                                               COMMA_LOCATION_ARGS) {
  cCollectionElement * result = NULL ;
  if (ioMap.isValid () && inKey.isValid ()) {
    ioMap.insulate (THERE) ;
    result = ioMap.ptr (HERE)->searchForReadWriteAttribute (inKey, inCompiler COMMA_THERE) ;
  }
  return result ;
}

//---------------------------------------------------------------------------*
//                                                                           *
//                           @counter_map map type                           *
//                                                                           *
//---------------------------------------------------------------------------*

const C_galgas_type_descriptor
kTypeDescriptor_GALGAS_counter_5F_map ("counter_map",
                                       & kTypeDescriptor_GALGAS_map) ;


//---------------------------------------------------------------------------*

const C_galgas_type_descriptor * GALGAS_counter_5F_map::typeDescriptor (void) const {
  return & kTypeDescriptor_GALGAS_counter_5F_map ;
}
//---------------------------------------------------------------------------*

void GALGASap_counter_5F_map::modifierCall_del (GALGASap_lstring constinArgument0,
                                                GALGASap_counter_5F_obj & outArgument1,
                                                C_Compiler * inCompiler
                                                COMMA_LOCATION_ARGS) {
//--- Release 'output' arguments
  outArgument1.drop () ;
//---
  if (isValid ()) {
    insulate (THERE) ;
    ptr (HERE)->modifier_del (constinArgument0, outArgument1, inCompiler COMMA_THERE) ;
  }
}

//---------------------------------------------------------------------------*

void GALGASap_counter_5F_map::modifierCall_put (GALGASap_lstring constinArgument0,
                                                GALGASap_counter_5F_obj constinArgument1,
                                                C_Compiler * inCompiler
                                                COMMA_LOCATION_ARGS) {
//--- Release 'output' arguments
//---
  if (isValid ()) {
    insulate (THERE) ;
    ptr (HERE)->modifier_put (constinArgument0, constinArgument1, inCompiler COMMA_THERE) ;
  }
}

//---------------------------------------------------------------------------*

void GALGASap_counter_5F_map::modifierCall_setCounterForKey (GALGASap_counter_5F_obj constinArgument0,
                                                             GALGASap_string constinArgument1,
                                                             C_Compiler * inCompiler
                                                             COMMA_LOCATION_ARGS) {
//--- Release 'output' arguments
//---
  if (isValid ()) {
    insulate (THERE) ;
    ptr (HERE)->modifier_setCounterForKey (constinArgument0, constinArgument1, inCompiler COMMA_THERE) ;
  }
}

//---------------------------------------------------------------------------*

void GALGASap_counter_5F_map::instanceMethodCall_getCounter (GALGASap_lstring constinArgument0,
                                                             GALGASap_counter_5F_obj & outArgument1,
                                                             C_Compiler * inCompiler
                                                             COMMA_LOCATION_ARGS) {
//--- Release 'output' arguments
  outArgument1.drop () ;
//---
  if (isValid ()) {
    ptr (HERE)->method_getCounter (constinArgument0, outArgument1, inCompiler COMMA_THERE) ;
  }
}

//---------------------------------------------------------------------------*
//                       @counter_map map enumeration                        *
//---------------------------------------------------------------------------*

GALGAS_counter_5F_map::cEnumerator::cEnumerator (const GALGASap_counter_5F_map & inEnumeratedObject,
                                                 const bool inAscending) :
AC_GALGAS_Enumerator (inEnumeratedObject.ptrNoVerif (), inAscending),
attribute_lkey (),
attribute_counter () {
}

//---------------------------------------------------------------------------*

void GALGAS_counter_5F_map::cEnumerator::updateAttributeProxies (void) {
  capCollectionElement object = currentObject () ;
  cCollectionElement_counter_5F_map * p = (cCollectionElement_counter_5F_map *) object.ptrNoVerif () ;
  macroValidObject (p, cCollectionElement_counter_5F_map) ;
  attribute_lkey = p->mAttribute_lkey ;
  attribute_counter = p->mAttribute_counter ;
}

//---------------------------------------------------------------------------*
//                                                                           *
//                     @counter_by_source auto ptr type                      *
//                                                                           *
//---------------------------------------------------------------------------*

GALGASap_counter_5F_by_5F_source::GALGASap_counter_5F_by_5F_source (const GALGASap_counter_5F_by_5F_source & inSource) :
GALGASap_sortedlist (inSource) {
}

//---------------------------------------------------------------------------*

GALGASap_counter_5F_by_5F_source::GALGASap_counter_5F_by_5F_source (const GALGASap_object & inSource) :
GALGASap_sortedlist (inSource) {
  macroNullOrValidObject (mPtr, GALGAS_counter_5F_by_5F_source) ;
}

//---------------------------------------------------------------------------*

GALGASap_counter_5F_by_5F_source & GALGASap_counter_5F_by_5F_source::operator = (const GALGASap_counter_5F_by_5F_source & inSource) {
  macroAssignObject (mPtr, inSource.mPtr) ;
  return * this ;
}

//---------------------------------------------------------------------------*

#ifndef DO_NOT_GENERATE_CHECKINGS
  GALGAS_counter_5F_by_5F_source * GALGASap_counter_5F_by_5F_source::ptr (LOCATION_ARGS) {
    macroValidObjectThere (mPtr, GALGAS_counter_5F_by_5F_source) ;
    return (GALGAS_counter_5F_by_5F_source *) mPtr ;
  }
#endif

//---------------------------------------------------------------------------*

#ifndef DO_NOT_GENERATE_CHECKINGS
  const GALGAS_counter_5F_by_5F_source * GALGASap_counter_5F_by_5F_source::ptr (LOCATION_ARGS) const {
    macroValidObjectThere (mPtr, const GALGAS_counter_5F_by_5F_source) ;
    return (const GALGAS_counter_5F_by_5F_source *) mPtr ;
  }
#endif

//---------------------------------------------------------------------------*

GALGASap_counter_5F_by_5F_source::GALGASap_counter_5F_by_5F_source (const GALGAS_counter_5F_by_5F_source * inSourcePtr) :
GALGASap_sortedlist (inSourcePtr) {
}

//---------------------------------------------------------------------------*

GALGASap_counter_5F_by_5F_source & GALGASap_counter_5F_by_5F_source::operator = (GALGAS_counter_5F_by_5F_source * inSourcePtr) {
  macroAssignObject (mPtr, inSourcePtr) ;
  return *this ;
}

//---------------------------------------------------------------------------*
//                                                                           *
//           Class for element of '@counter_5F_by_5F_source' list            *
//                                                                           *
//---------------------------------------------------------------------------*

class cCollectionElement_counter_5F_by_5F_source : public cCollectionElement {
//--- List attributes
  public : GALGASap_string mAttribute_source ;
  public : GALGASap_lstring mAttribute_name ;
  public : GALGASap_counter_5F_obj mAttribute_counter ;

//--- Constructor
  public : cCollectionElement_counter_5F_by_5F_source (const GALGASap_string & in_source,
                                                       const GALGASap_lstring & in_name,
                                                       const GALGASap_counter_5F_obj & in_counter
                                                       COMMA_LOCATION_ARGS) ;

//--- Virtual method for comparing elements
  public : virtual enumComparisonResult compare (const cCollectionElement * inOperand) ;

//--- Virtual method that checks that all attributes are valid
  public : virtual bool isValid (void) const ;

//--- Virtual method that returns a copy of current object
  public : virtual cCollectionElement * copy (void) ;

//--- Description
 public : virtual void description (C_String & ioString, const PMSInt32 inIndentation) const ;
} ;

//---------------------------------------------------------------------------*

cCollectionElement_counter_5F_by_5F_source::cCollectionElement_counter_5F_by_5F_source (const GALGASap_string & in_source,
                                                                                        const GALGASap_lstring & in_name,
                                                                                        const GALGASap_counter_5F_obj & in_counter
                                                                                        COMMA_LOCATION_ARGS) :
cCollectionElement (THERE),
mAttribute_source (in_source),
mAttribute_name (in_name),
mAttribute_counter (in_counter) {
}

//---------------------------------------------------------------------------*

bool cCollectionElement_counter_5F_by_5F_source::isValid (void) const {
  return mAttribute_source.isValid () && mAttribute_name.isValid () && mAttribute_counter.isValid () ;
}

//---------------------------------------------------------------------------*

cCollectionElement * cCollectionElement_counter_5F_by_5F_source::copy (void) {
  cCollectionElement * result = NULL ;
  macroMyNew (result, cCollectionElement_counter_5F_by_5F_source (mAttribute_source, mAttribute_name, mAttribute_counter COMMA_HERE)) ;
  return result ;
}

//---------------------------------------------------------------------------*

void cCollectionElement_counter_5F_by_5F_source::description (C_String & /* ioString */, const PMSInt32 /* inIndentation */) const {
// mAttribute_source.description (ioString, inIndentation) ;
// mAttribute_name.description (ioString, inIndentation) ;
// mAttribute_counter.description (ioString, inIndentation) ;
}

//---------------------------------------------------------------------------*

enumComparisonResult cCollectionElement_counter_5F_by_5F_source::compare (const cCollectionElement * inOperand) {
  cCollectionElement_counter_5F_by_5F_source * operand = (cCollectionElement_counter_5F_by_5F_source *) inOperand ;
  enumComparisonResult result = kOperandEqual ;
  if (kOperandEqual == result) {
    result = GALGASap_string::objectCompare (mAttribute_source, operand->mAttribute_source) ;
  }
  if (kOperandEqual == result) {
    result = GALGASap_lstring::objectCompare (mAttribute_name, operand->mAttribute_name) ;
  }
  if (kOperandEqual == result) {
    result = GALGASap_counter_5F_obj::objectCompare (mAttribute_counter, operand->mAttribute_counter) ;
  }
  return result ;
}

//---------------------------------------------------------------------------*

static const C_galgas_type_descriptor * kFieldList_counter_5F_by_5F_source [3] = {
  & kTypeDescriptor_GALGAS_string,
  & kTypeDescriptor_GALGAS_lstring,
  & kTypeDescriptor_GALGAS_counter_5F_obj
} ;

//---------------------------------------------------------------------------*

GALGAS_counter_5F_by_5F_source::GALGAS_counter_5F_by_5F_source (LOCATION_ARGS) :
GALGAS_sortedlist (kFieldList_counter_5F_by_5F_source COMMA_THERE) {
}

//---------------------------------------------------------------------------*

enumComparisonResult GALGAS_counter_5F_by_5F_source::compareSortedListElements (const capCollectionElement & inLeftAttributeList,
                                                                                const capCollectionElement & inRightAttributeList) const {
  enumComparisonResult result = kOperandEqual ;
  const cCollectionElement_counter_5F_by_5F_source * p1 = (const cCollectionElement_counter_5F_by_5F_source *) inLeftAttributeList.ptrNoVerif () ;
  macroValidObject (p1, const cCollectionElement_counter_5F_by_5F_source) ;
  const cCollectionElement_counter_5F_by_5F_source * p2 = (const cCollectionElement_counter_5F_by_5F_source *) inRightAttributeList.ptrNoVerif () ;
  macroValidObject (p2, const cCollectionElement_counter_5F_by_5F_source) ;
  if (result == kOperandEqual) {
    result = complementComparison (GALGASap_string::objectCompare (p1->mAttribute_source, p2->mAttribute_source)) ;
  }
  return result ;
}

//---------------------------------------------------------------------------*

void GALGASap_counter_5F_by_5F_source::insulate (LOCATION_ARGS) {
  if (isValid () && (ptr (HERE)->retainCount () > 1)) {
    GALGASap_counter_5F_by_5F_source p (constructor_emptySortedList (THERE)) ;
    p.ptr (HERE)->copyFrom (ptr (HERE)) ;
    *this = p ;
  }
}

//---------------------------------------------------------------------------*

GALGASap_counter_5F_by_5F_source GALGASap_counter_5F_by_5F_source::constructor_emptySortedList (LOCATION_ARGS) {
  GALGAS_counter_5F_by_5F_source * p = NULL ;
  macroMyNew (p, GALGAS_counter_5F_by_5F_source (THERE)) ;
  return GALGASap_counter_5F_by_5F_source (p) ;
}

//---------------------------------------------------------------------------*

GALGASap_counter_5F_by_5F_source GALGASap_counter_5F_by_5F_source::constructor_sortedListWithValue (GALGASap_string & inOperand0,
                                                                                                    GALGASap_lstring & inOperand1,
                                                                                                    GALGASap_counter_5F_obj & inOperand2
                                                                                                    COMMA_LOCATION_ARGS) {
  GALGASap_counter_5F_by_5F_source result = constructor_emptySortedList (THERE) ;
  cCollectionElement * p = NULL ;
  macroMyNew (p, cCollectionElement_counter_5F_by_5F_source (inOperand0, inOperand1, inOperand2 COMMA_THERE)) ;
  capCollectionElement attributes (p) ;
  result.ptr (HERE)->addObject (attributes) ;
  return result ;
}

//---------------------------------------------------------------------------*

void GALGASap_counter_5F_by_5F_source::addAssign_operation (const GALGASap_string inOperand0,
                                                            const GALGASap_lstring inOperand1,
                                                            const GALGASap_counter_5F_obj inOperand2
                                                            COMMA_LOCATION_ARGS) {
  if (isValid ()) {
    insulate (HERE) ;
    cCollectionElement * p = NULL ;
    macroMyNew (p, cCollectionElement_counter_5F_by_5F_source (inOperand0, inOperand1, inOperand2 COMMA_THERE)) ;
    capCollectionElement attributes (p) ;
    ptr (HERE)->addObject (attributes) ;
  }
}

//---------------------------------------------------------------------------*

void GALGASap_counter_5F_by_5F_source::dotAssign_operation (const GALGASap_counter_5F_by_5F_source inOperand
                                                            COMMA_LOCATION_ARGS) {
  if (isValid () && inOperand.isValid ()) {
    insulate (THERE) ;
    ptr (HERE)->appendSortedList (inOperand.ptr (HERE)) ;
  }
}

//---------------------------------------------------------------------------*

GALGASap_counter_5F_by_5F_source GALGASap_counter_5F_by_5F_source::operator_concat (const GALGASap_counter_5F_by_5F_source & inOperand
                                                                                    COMMA_LOCATION_ARGS) const {
  GALGASap_counter_5F_by_5F_source result ;
  if (isValid () && inOperand.isValid ()) {
    result = constructor_emptySortedList (THERE) ;
    result.ptr (HERE)->appendSortedList (ptr (HERE)) ;
    result.ptr (HERE)->appendSortedList (inOperand.ptr (HERE)) ;
  }
  return result ;
}

//---------------------------------------------------------------------------*

void GALGAS_counter_5F_by_5F_source::modifier_popSmallest (GALGASap_string & outOperand0,
                                                           GALGASap_lstring & outOperand1,
                                                           GALGASap_counter_5F_obj & outOperand2,
                                                           C_Compiler * inCompiler
                                                           COMMA_LOCATION_ARGS) {
  capCollectionElement attributes ;
  removeSmallestObject (attributes, inCompiler COMMA_THERE) ;
  cCollectionElement_counter_5F_by_5F_source * p = (cCollectionElement_counter_5F_by_5F_source *) attributes.ptrNoVerif () ;
  if (NULL == p) {
    outOperand0.drop () ;
    outOperand1.drop () ;
    outOperand2.drop () ;
  }else{
    macroValidObject (p, cCollectionElement_counter_5F_by_5F_source) ;
    outOperand0 = p->mAttribute_source ;
    outOperand1 = p->mAttribute_name ;
    outOperand2 = p->mAttribute_counter ;
  }
}

//---------------------------------------------------------------------------*

void GALGAS_counter_5F_by_5F_source::modifier_popGreatest (GALGASap_string & outOperand0,
                                                           GALGASap_lstring & outOperand1,
                                                           GALGASap_counter_5F_obj & outOperand2,
                                                           C_Compiler * inCompiler
                                                           COMMA_LOCATION_ARGS) {
  capCollectionElement attributes ;
  removeGreatestObject (attributes, inCompiler COMMA_THERE) ;
  cCollectionElement_counter_5F_by_5F_source * p = (cCollectionElement_counter_5F_by_5F_source *) attributes.ptrNoVerif () ;
  if (NULL == p) {
    outOperand0.drop () ;
    outOperand1.drop () ;
    outOperand2.drop () ;
  }else{
    macroValidObject (p, cCollectionElement_counter_5F_by_5F_source) ;
    outOperand0 = p->mAttribute_source ;
    outOperand1 = p->mAttribute_name ;
    outOperand2 = p->mAttribute_counter ;
  }
}

//---------------------------------------------------------------------------*

void GALGAS_counter_5F_by_5F_source::method_smallest (GALGASap_string & outOperand0,
                                                      GALGASap_lstring & outOperand1,
                                                      GALGASap_counter_5F_obj & outOperand2,
                                                      C_Compiler * inCompiler
                                                      COMMA_LOCATION_ARGS) {
  capCollectionElement attributes ;
  smallestObjectAttributeList (attributes, inCompiler COMMA_THERE) ;
  cCollectionElement_counter_5F_by_5F_source * p = (cCollectionElement_counter_5F_by_5F_source *) attributes.ptrNoVerif () ;
  if (NULL == p) {
    outOperand0.drop () ;
    outOperand1.drop () ;
    outOperand2.drop () ;
  }else{
    macroValidObject (p, cCollectionElement_counter_5F_by_5F_source) ;
    outOperand0 = p->mAttribute_source ;
    outOperand1 = p->mAttribute_name ;
    outOperand2 = p->mAttribute_counter ;
  }
}

//---------------------------------------------------------------------------*

void GALGAS_counter_5F_by_5F_source::method_greatest (GALGASap_string & outOperand0,
                                                      GALGASap_lstring & outOperand1,
                                                      GALGASap_counter_5F_obj & outOperand2,
                                                      C_Compiler * inCompiler
                                                      COMMA_LOCATION_ARGS) {
  capCollectionElement attributes ;
  greatestObjectAttributeList (attributes, inCompiler COMMA_THERE) ;
  cCollectionElement_counter_5F_by_5F_source * p = (cCollectionElement_counter_5F_by_5F_source *) attributes.ptrNoVerif () ;
  if (NULL == p) {
    outOperand0.drop () ;
    outOperand1.drop () ;
    outOperand2.drop () ;
  }else{
    macroValidObject (p, cCollectionElement_counter_5F_by_5F_source) ;
    outOperand0 = p->mAttribute_source ;
    outOperand1 = p->mAttribute_name ;
    outOperand2 = p->mAttribute_counter ;
  }
}

//---------------------------------------------------------------------------*
//                                                                           *
//                    @counter_by_source sorted list type                    *
//                                                                           *
//---------------------------------------------------------------------------*

const C_galgas_type_descriptor
kTypeDescriptor_GALGAS_counter_5F_by_5F_source ("counter_by_source",
                                                & kTypeDescriptor_GALGAS_sortedlist) ;


//---------------------------------------------------------------------------*

const C_galgas_type_descriptor * GALGAS_counter_5F_by_5F_source::typeDescriptor (void) const {
  return & kTypeDescriptor_GALGAS_counter_5F_by_5F_source ;
}
//---------------------------------------------------------------------------*

void GALGASap_counter_5F_by_5F_source::modifierCall_popGreatest (GALGASap_string & outArgument0,
                                                                 GALGASap_lstring & outArgument1,
                                                                 GALGASap_counter_5F_obj & outArgument2,
                                                                 C_Compiler * inCompiler
                                                                 COMMA_LOCATION_ARGS) {
//--- Release 'output' arguments
  outArgument0.drop () ;
  outArgument1.drop () ;
  outArgument2.drop () ;
//---
  if (isValid ()) {
    insulate (THERE) ;
    ptr (HERE)->modifier_popGreatest (outArgument0, outArgument1, outArgument2, inCompiler COMMA_THERE) ;
  }
}

//---------------------------------------------------------------------------*

void GALGASap_counter_5F_by_5F_source::modifierCall_popSmallest (GALGASap_string & outArgument0,
                                                                 GALGASap_lstring & outArgument1,
                                                                 GALGASap_counter_5F_obj & outArgument2,
                                                                 C_Compiler * inCompiler
                                                                 COMMA_LOCATION_ARGS) {
//--- Release 'output' arguments
  outArgument0.drop () ;
  outArgument1.drop () ;
  outArgument2.drop () ;
//---
  if (isValid ()) {
    insulate (THERE) ;
    ptr (HERE)->modifier_popSmallest (outArgument0, outArgument1, outArgument2, inCompiler COMMA_THERE) ;
  }
}

//---------------------------------------------------------------------------*

void GALGASap_counter_5F_by_5F_source::instanceMethodCall_greatest (GALGASap_string & outArgument0,
                                                                    GALGASap_lstring & outArgument1,
                                                                    GALGASap_counter_5F_obj & outArgument2,
                                                                    C_Compiler * inCompiler
                                                                    COMMA_LOCATION_ARGS) {
//--- Release 'output' arguments
  outArgument0.drop () ;
  outArgument1.drop () ;
  outArgument2.drop () ;
//---
  if (isValid ()) {
    ptr (HERE)->method_greatest (outArgument0, outArgument1, outArgument2, inCompiler COMMA_THERE) ;
  }
}

//---------------------------------------------------------------------------*

void GALGASap_counter_5F_by_5F_source::instanceMethodCall_smallest (GALGASap_string & outArgument0,
                                                                    GALGASap_lstring & outArgument1,
                                                                    GALGASap_counter_5F_obj & outArgument2,
                                                                    C_Compiler * inCompiler
                                                                    COMMA_LOCATION_ARGS) {
//--- Release 'output' arguments
  outArgument0.drop () ;
  outArgument1.drop () ;
  outArgument2.drop () ;
//---
  if (isValid ()) {
    ptr (HERE)->method_smallest (outArgument0, outArgument1, outArgument2, inCompiler COMMA_THERE) ;
  }
}

//---------------------------------------------------------------------------*
//                @counter_by_source sorted list enumeration                 *
//---------------------------------------------------------------------------*

GALGAS_counter_5F_by_5F_source::cEnumerator::cEnumerator (const GALGASap_counter_5F_by_5F_source & inEnumeratedObject,
                                                          const bool inAscending) :
AC_GALGAS_Enumerator (inEnumeratedObject.ptrNoVerif (), inAscending),
attribute_source (),
attribute_name (),
attribute_counter () {
}

//---------------------------------------------------------------------------*

void GALGAS_counter_5F_by_5F_source::cEnumerator::updateAttributeProxies (void) {
  capCollectionElement object = currentObject () ;
  cCollectionElement_counter_5F_by_5F_source * p = (cCollectionElement_counter_5F_by_5F_source *) object.ptrNoVerif () ;
  macroValidObject (p, cCollectionElement_counter_5F_by_5F_source) ;
  attribute_source = p->mAttribute_source ;
  attribute_name = p->mAttribute_name ;
  attribute_counter = p->mAttribute_counter ;
}

//---------------------------------------------------------------------------*
//                                                                           *
//                        Function 'maxAllowedValue'                         *
//                                                                           *
//---------------------------------------------------------------------------*

GALGASap_uint_36__34_ function_maxAllowedValue (GALGASap_counter_5F_obj & constinArgument_counter,
                                                C_Compiler * inCompiler
                                                COMMA_UNUSED_LOCATION_ARGS) {
  GALGASap_uint_36__34_ result_uint_36__34_ ; // Returned variable
  //-------- @assignmentInstructionForGeneration
  //--- @literalUInt64ExpressionForGeneration
  GALGASap_uint_36__34_ temp_0 ((PMUInt64) 0ULL COMMA_SOURCE_FILE_AT_LINE (69)) ;
  result_uint_36__34_ = temp_0 ;
  //-------- @structuredCastInstructionForGeneration
  //--- @readerCallExpressionForGeneration
  GALGASap_basic_5F_type temp_1 (constinArgument_counter.readerCall_max_5F_allowed_5F_value (SOURCE_FILE_AT_LINE (70))) ;
  if (temp_1.isValid ()) {
    if (temp_1.ptr (HERE)->typeDescriptor () == & kTypeDescriptor_GALGAS_uint_33__32__5F_class) {
    GALGASap_uint_33__32__5F_class cast_1606_max = temp_1 ;
      //-------- @assignmentInstructionForGeneration
      //--- @readerCallExpressionForGeneration
      //--- @readerCallExpressionForGeneration
      GALGASap_uint temp_2 (cast_1606_max.readerCall_value (SOURCE_FILE_AT_LINE (71))) ;
      GALGASap_uint_36__34_ temp_3 (temp_2.readerCall_uint_36__34_ (SOURCE_FILE_AT_LINE (71))) ;
      result_uint_36__34_ = temp_3 ;
    }else{
      //-------- @errorInstructionForGeneration
      //--- @readerCallExpressionForGeneration
      //--- @readerCallExpressionForGeneration
      GALGASap_basic_5F_type temp_4 (constinArgument_counter.readerCall_max_5F_allowed_5F_value (SOURCE_FILE_AT_LINE (72))) ;
      GALGASap_location temp_5 (temp_4.readerCall_location (SOURCE_FILE_AT_LINE (72))) ;
      //--- @literalStringExpressionForGeneration
      GALGASap_string temp_6 ("internal, wrong type for MAXALLOWEDVALUE" COMMA_SOURCE_FILE_AT_LINE (72)) ;
      inCompiler->emitSemanticError (temp_5, temp_6 COMMA_SOURCE_FILE_AT_LINE (72)) ;
    }
  }
//---
  return result_uint_36__34_ ;
}


//---------------------------------------------------------------------------*
//  Introspection                                                            *
//---------------------------------------------------------------------------*

static const C_galgas_type_descriptor * functionArgs_maxAllowedValue [2] = {
  & kTypeDescriptor_GALGAS_counter_5F_obj,
  NULL
} ;

//---------------------------------------------------------------------------*

static GALGASap_object functionWithGenericHeader_maxAllowedValue (C_Compiler * inCompiler,
                                                                  cRootObjectArray & inEffectiveParameterArray,
                                                                  const GALGASap_location & inErrorLocation
                                                                  COMMA_LOCATION_ARGS) {
  const bool ok = inCompiler->checkFunctionCallArguments ("maxAllowedValue",
                                                          1,
                                                          functionArgs_maxAllowedValue,
                                                          inEffectiveParameterArray,
                                                          inErrorLocation
                                                          COMMA_THERE) ;
  GALGASap_object result ;
  if (ok) {
    GALGASap_counter_5F_obj operand0 = inEffectiveParameterArray.objectAtIndex (0 COMMA_THERE) ;
    result = function_maxAllowedValue (operand0, inCompiler COMMA_THERE).embedObject () ;
  }
  return result ;
}

//---------------------------------------------------------------------------*

C_galgas_function_descriptor functionDescriptor_maxAllowedValue ("maxAllowedValue",
                                                                 functionWithGenericHeader_maxAllowedValue,
                                                                 & kTypeDescriptor_GALGAS_uint_36__34_,
                                                                 1,
                                                                 functionArgs_maxAllowedValue) ;


//---------------------------------------------------------------------------*
//                                                                           *
//                            Function 'minCycle'                            *
//                                                                           *
//---------------------------------------------------------------------------*

GALGASap_uint_36__34_ function_minCycle (GALGASap_counter_5F_obj & constinArgument_counter,
                                         C_Compiler * inCompiler
                                         COMMA_UNUSED_LOCATION_ARGS) {
  GALGASap_uint_36__34_ result_uint_36__34_ ; // Returned variable
  //-------- @assignmentInstructionForGeneration
  //--- @literalUInt64ExpressionForGeneration
  GALGASap_uint_36__34_ temp_0 ((PMUInt64) 0ULL COMMA_SOURCE_FILE_AT_LINE (77)) ;
  result_uint_36__34_ = temp_0 ;
  //-------- @structuredCastInstructionForGeneration
  //--- @readerCallExpressionForGeneration
  GALGASap_basic_5F_type temp_1 (constinArgument_counter.readerCall_min_5F_cycle (SOURCE_FILE_AT_LINE (78))) ;
  if (temp_1.isValid ()) {
    if (temp_1.ptr (HERE)->typeDescriptor () == & kTypeDescriptor_GALGAS_uint_33__32__5F_class) {
    GALGASap_uint_33__32__5F_class cast_1896_min = temp_1 ;
      //-------- @assignmentInstructionForGeneration
      //--- @readerCallExpressionForGeneration
      //--- @readerCallExpressionForGeneration
      GALGASap_uint temp_2 (cast_1896_min.readerCall_value (SOURCE_FILE_AT_LINE (79))) ;
      GALGASap_uint_36__34_ temp_3 (temp_2.readerCall_uint_36__34_ (SOURCE_FILE_AT_LINE (79))) ;
      result_uint_36__34_ = temp_3 ;
    }else{
      //-------- @errorInstructionForGeneration
      //--- @readerCallExpressionForGeneration
      //--- @readerCallExpressionForGeneration
      GALGASap_basic_5F_type temp_4 (constinArgument_counter.readerCall_min_5F_cycle (SOURCE_FILE_AT_LINE (80))) ;
      GALGASap_location temp_5 (temp_4.readerCall_location (SOURCE_FILE_AT_LINE (80))) ;
      //--- @literalStringExpressionForGeneration
      GALGASap_string temp_6 ("internal, wrong type for MINCYCLE" COMMA_SOURCE_FILE_AT_LINE (80)) ;
      inCompiler->emitSemanticError (temp_5, temp_6 COMMA_SOURCE_FILE_AT_LINE (80)) ;
    }
  }
//---
  return result_uint_36__34_ ;
}


//---------------------------------------------------------------------------*
//  Introspection                                                            *
//---------------------------------------------------------------------------*

static const C_galgas_type_descriptor * functionArgs_minCycle [2] = {
  & kTypeDescriptor_GALGAS_counter_5F_obj,
  NULL
} ;

//---------------------------------------------------------------------------*

static GALGASap_object functionWithGenericHeader_minCycle (C_Compiler * inCompiler,
                                                           cRootObjectArray & inEffectiveParameterArray,
                                                           const GALGASap_location & inErrorLocation
                                                           COMMA_LOCATION_ARGS) {
  const bool ok = inCompiler->checkFunctionCallArguments ("minCycle",
                                                          1,
                                                          functionArgs_minCycle,
                                                          inEffectiveParameterArray,
                                                          inErrorLocation
                                                          COMMA_THERE) ;
  GALGASap_object result ;
  if (ok) {
    GALGASap_counter_5F_obj operand0 = inEffectiveParameterArray.objectAtIndex (0 COMMA_THERE) ;
    result = function_minCycle (operand0, inCompiler COMMA_THERE).embedObject () ;
  }
  return result ;
}

//---------------------------------------------------------------------------*

C_galgas_function_descriptor functionDescriptor_minCycle ("minCycle",
                                                          functionWithGenericHeader_minCycle,
                                                          & kTypeDescriptor_GALGAS_uint_36__34_,
                                                          1,
                                                          functionArgs_minCycle) ;


//---------------------------------------------------------------------------*
//                                                                           *
//                          Function 'ticksPerBase'                          *
//                                                                           *
//---------------------------------------------------------------------------*

GALGASap_uint_36__34_ function_ticksPerBase (GALGASap_counter_5F_obj & constinArgument_counter,
                                             C_Compiler * inCompiler
                                             COMMA_UNUSED_LOCATION_ARGS) {
  GALGASap_uint_36__34_ result_uint_36__34_ ; // Returned variable
  //-------- @assignmentInstructionForGeneration
  //--- @literalUInt64ExpressionForGeneration
  GALGASap_uint_36__34_ temp_0 ((PMUInt64) 0ULL COMMA_SOURCE_FILE_AT_LINE (85)) ;
  result_uint_36__34_ = temp_0 ;
  //-------- @structuredCastInstructionForGeneration
  //--- @readerCallExpressionForGeneration
  GALGASap_basic_5F_type temp_1 (constinArgument_counter.readerCall_ticks_5F_per_5F_base (SOURCE_FILE_AT_LINE (86))) ;
  if (temp_1.isValid ()) {
    if (temp_1.ptr (HERE)->typeDescriptor () == & kTypeDescriptor_GALGAS_uint_33__32__5F_class) {
    GALGASap_uint_33__32__5F_class cast_2182_ticks = temp_1 ;
      //-------- @assignmentInstructionForGeneration
      //--- @readerCallExpressionForGeneration
      //--- @readerCallExpressionForGeneration
      GALGASap_uint temp_2 (cast_2182_ticks.readerCall_value (SOURCE_FILE_AT_LINE (87))) ;
      GALGASap_uint_36__34_ temp_3 (temp_2.readerCall_uint_36__34_ (SOURCE_FILE_AT_LINE (87))) ;
      result_uint_36__34_ = temp_3 ;
    }else{
      //-------- @errorInstructionForGeneration
      //--- @readerCallExpressionForGeneration
      //--- @readerCallExpressionForGeneration
      GALGASap_basic_5F_type temp_4 (constinArgument_counter.readerCall_ticks_5F_per_5F_base (SOURCE_FILE_AT_LINE (88))) ;
      GALGASap_location temp_5 (temp_4.readerCall_location (SOURCE_FILE_AT_LINE (88))) ;
      //--- @literalStringExpressionForGeneration
      GALGASap_string temp_6 ("internal, wrong type for TICKSPERBASE" COMMA_SOURCE_FILE_AT_LINE (88)) ;
      inCompiler->emitSemanticError (temp_5, temp_6 COMMA_SOURCE_FILE_AT_LINE (88)) ;
    }
  }
//---
  return result_uint_36__34_ ;
}


//---------------------------------------------------------------------------*
//  Introspection                                                            *
//---------------------------------------------------------------------------*

static const C_galgas_type_descriptor * functionArgs_ticksPerBase [2] = {
  & kTypeDescriptor_GALGAS_counter_5F_obj,
  NULL
} ;

//---------------------------------------------------------------------------*

static GALGASap_object functionWithGenericHeader_ticksPerBase (C_Compiler * inCompiler,
                                                               cRootObjectArray & inEffectiveParameterArray,
                                                               const GALGASap_location & inErrorLocation
                                                               COMMA_LOCATION_ARGS) {
  const bool ok = inCompiler->checkFunctionCallArguments ("ticksPerBase",
                                                          1,
                                                          functionArgs_ticksPerBase,
                                                          inEffectiveParameterArray,
                                                          inErrorLocation
                                                          COMMA_THERE) ;
  GALGASap_object result ;
  if (ok) {
    GALGASap_counter_5F_obj operand0 = inEffectiveParameterArray.objectAtIndex (0 COMMA_THERE) ;
    result = function_ticksPerBase (operand0, inCompiler COMMA_THERE).embedObject () ;
  }
  return result ;
}

//---------------------------------------------------------------------------*

C_galgas_function_descriptor functionDescriptor_ticksPerBase ("ticksPerBase",
                                                              functionWithGenericHeader_ticksPerBase,
                                                              & kTypeDescriptor_GALGAS_uint_36__34_,
                                                              1,
                                                              functionArgs_ticksPerBase) ;


//--- START OF USER ZONE 2


//--- END OF USER ZONE 2


