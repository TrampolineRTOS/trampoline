//---------------------------------------------------------------------------*
//                                                                           *
//                           File 'cfg_types.cpp'                            *
//                    Generated by version version 2.1.4                     *
//                     january 10th, 2011, at 14h35'28"                      *
//                                                                           *
//---------------------------------------------------------------------------*

//--- START OF USER ZONE 1


//--- END OF USER ZONE 1

#include "version_libpm.h"
#if CURRENT_LIBPM_VERSION != 926
  #error "This file has been compiled with a version of GALGAS that uses libpm version 926, different than the current version (CURRENT_LIBPM_VERSION) of libpm"
#endif

//---------------------------------------------------------------------------*

#include "cfg_types.h"
#include "galgas2/C_Compiler.h"
#include "galgas2/C_galgas_CLI_Options.h"

//---------------------------------------------------------------------------*


//---------------------------------------------------------------------------*

#ifndef DO_NOT_GENERATE_CHECKINGS
  #define SOURCE_FILE_AT_LINE(line) "cfg_types.gSemantics", line
  #define COMMA_SOURCE_FILE_AT_LINE(line) , SOURCE_FILE_AT_LINE(line)
#else
  #define SOURCE_FILE_AT_LINE(line) 
  #define COMMA_SOURCE_FILE_AT_LINE(line) 
#endif

//---------------------------------------------------------------------------*

cMapElement_config::cMapElement_config (const GALGAS_lstring & inKey,
                                        const GALGAS_basic_5F_type & in_value
                                        COMMA_LOCATION_ARGS) :
cMapElement (inKey COMMA_THERE),
mAttribute_value (in_value) {
}

//---------------------------------------------------------------------------*

bool cMapElement_config::isValid (void) const {
  return mAttribute_lkey.isValid () && mAttribute_value.isValid () ;
}

//---------------------------------------------------------------------------*

cMapElement * cMapElement_config::copy (void) {
  cMapElement * result = NULL ;
  macroMyNew (result, cMapElement_config (mAttribute_lkey, mAttribute_value COMMA_HERE)) ;
  return result ;
}

//---------------------------------------------------------------------------*

void cMapElement_config::description (C_String & ioString, const PMSInt32 inIndentation) const {
  ioString << "\n" ;
  ioString.writeStringMultiple ("| ", inIndentation) ;
  ioString << "value" ":" ;
  mAttribute_value.description (ioString, inIndentation) ;
}

//---------------------------------------------------------------------------*

enumComparisonResult cMapElement_config::compare (const cCollectionElement * inOperand) const {
  cMapElement_config * operand = (cMapElement_config *) inOperand ;
  enumComparisonResult result = mAttribute_lkey.objectCompare (operand->mAttribute_lkey) ;
  if (kOperandEqual == result) {
    result = mAttribute_value.objectCompare (operand->mAttribute_value) ;
  }
  return result ;
}

//---------------------------------------------------------------------------*

GALGAS_config::GALGAS_config (void) :
AC_GALGAS_map () {
}

//---------------------------------------------------------------------------*

GALGAS_config::GALGAS_config (const GALGAS_config & inSource) :
AC_GALGAS_map (inSource) {
}

//---------------------------------------------------------------------------*

GALGAS_config & GALGAS_config::operator = (const GALGAS_config & inSource) {
  * ((AC_GALGAS_map *) this) = inSource ;
  return * this ;
}

//---------------------------------------------------------------------------*

GALGAS_config GALGAS_config::constructor_emptyMap (LOCATION_ARGS) {
  GALGAS_config result ;
  result.makeNewEmptyMap (THERE) ;
  return result ;
}

//---------------------------------------------------------------------------*

GALGAS_config GALGAS_config::constructor_mapWithMapToOverride (const GALGAS_config & inMapToOverride
                                                               COMMA_LOCATION_ARGS) {
  GALGAS_config result ;
  result.makeNewEmptyMapWithMapToOverride (inMapToOverride COMMA_THERE) ;
  return result ;
}

//---------------------------------------------------------------------------*

GALGAS_config GALGAS_config::reader_overriddenMap (UNUSED_LOCATION_ARGS) const {
  GALGAS_config result ;
  getOverridenMap (result) ;
  return result ;
}
//---------------------------------------------------------------------------*

void GALGAS_config::modifier_put (GALGAS_lstring inKey,
                                  GALGAS_basic_5F_type inArgument0,
                                  C_Compiler * inCompiler
                                  COMMA_LOCATION_ARGS) {
  cMapElement_config * p = NULL ;
  macroMyNew (p, cMapElement_config (inKey, inArgument0 COMMA_HERE)) ;
  capCollectionElement attributes ;
  attributes.setPointer (p) ;
  macroDetachSharedObject (p) ;
  const char * kInsertErrorMessage = "Key %K is duplicated in %L" ;
  const char * kShadowErrorMessage = "" ;
  performInsert (attributes, inCompiler, kInsertErrorMessage, kShadowErrorMessage COMMA_THERE) ;
}

//---------------------------------------------------------------------------*

const char * kSearchErrorMessage_config_get = "Key %K is not defined" ;

//---------------------------------------------------------------------------*

void GALGAS_config::method_get (GALGAS_lstring inKey,
                                GALGAS_basic_5F_type & outArgument0,
                                C_Compiler * inCompiler
                                COMMA_LOCATION_ARGS) const {
  const cMapElement_config * p = (const cMapElement_config *) performSearch (inKey,
                                                                               inCompiler,
                                                                               kSearchErrorMessage_config_get
                                                                               COMMA_THERE) ;
  if (NULL == p) {
    outArgument0.drop () ;
  }else{
    macroValidSharedObject (p, const cMapElement_config) ;
    outArgument0 = p->mAttribute_value ;
  }
}

//---------------------------------------------------------------------------*

void GALGAS_config::modifier_del (GALGAS_lstring inKey,
                                  GALGAS_basic_5F_type & outArgument0,
                                  C_Compiler * inCompiler
                                  COMMA_LOCATION_ARGS) {
  const char * kRemoveErrorMessage = "Key %K is not defined" ;
  capCollectionElement attributes ;
  performRemove (inKey, attributes, inCompiler, kRemoveErrorMessage COMMA_THERE) ;
  cMapElement_config * p = (cMapElement_config *) attributes.ptr () ;
  if (NULL != p) {
    macroValidSharedObject (p, cMapElement_config) ;
    outArgument0 = p->mAttribute_value ;
  }
}

//---------------------------------------------------------------------------*

GALGAS_basic_5F_type GALGAS_config::reader_valueForKey (const GALGAS_string & inKey,
                                                        C_Compiler * inCompiler
                                                        COMMA_LOCATION_ARGS) const {
  const cCollectionElement * attributes = searchForReadingAttribute (inKey, inCompiler COMMA_THERE) ;
  const cMapElement_config * p = (const cMapElement_config *) attributes ;
  GALGAS_basic_5F_type result ;
  if (NULL != p) {
    macroValidSharedObject (p, const cMapElement_config) ;
    result = p->mAttribute_value ;
  }
  return result ;
}

//---------------------------------------------------------------------------*

void GALGAS_config::modifier_setValueForKey (GALGAS_basic_5F_type inAttributeValue,
                                             GALGAS_string inKey,
                                             C_Compiler * inCompiler
                                             COMMA_LOCATION_ARGS) {
  cCollectionElement * attributes = searchForReadWriteAttribute (inKey, inCompiler COMMA_THERE) ;
  cMapElement_config * p = (cMapElement_config *) attributes ;
  if (NULL != p) {
    macroValidSharedObject (p, cMapElement_config) ;
    p->mAttribute_value = inAttributeValue ;
  }
}

//---------------------------------------------------------------------------*

cMapElement_config * GALGAS_config::readWriteAccessForWithInstruction_get (C_Compiler * inCompiler,
                                                                           const GALGAS_lstring & inKey
                                                                           COMMA_LOCATION_ARGS) {
  cMapElement * p = searchForReadWriteAttribute (inKey, inCompiler, kSearchErrorMessage_config_get COMMA_THERE) ;
  cMapElement_config * result = (cMapElement_config *) p ;
  macroNullOrValidSharedObject (result, cMapElement_config) ;
  return result ;
}

//---------------------------------------------------------------------------*

cMapElement_config * GALGAS_config::readWriteAccessForWithInstruction_hasKey (C_Compiler * inCompiler,
                                                                              const GALGAS_string & inKey
                                                                              COMMA_LOCATION_ARGS) {
  cMapElement * p = searchForReadWriteAttribute (inKey, inCompiler COMMA_THERE) ;
  cMapElement_config * result = (cMapElement_config *) p ;
  macroNullOrValidSharedObject (result, cMapElement_config) ;
  return result ;
}

//---------------------------------------------------------------------------*

cEnumerator_config::cEnumerator_config (const GALGAS_config & inEnumeratedObject,
                                        const bool inAscending) :
cGenericAbstractEnumerator () {
  inEnumeratedObject.populateEnumerationArray (mEnumerationArray, inAscending) ;
}

//---------------------------------------------------------------------------*

GALGAS_lstring cEnumerator_config::current_lkey (LOCATION_ARGS) const {
  const cMapElement * p = (const cMapElement *) currentObjectPtr (THERE) ;
  macroValidSharedObject (p, const cMapElement) ;
  return p->mAttribute_lkey ;
}

//---------------------------------------------------------------------------*

GALGAS_basic_5F_type cEnumerator_config::current_value (LOCATION_ARGS) const {
  const cMapElement_config * p = (const cMapElement_config *) currentObjectPtr (THERE) ;
  macroValidSharedObject (p, const cMapElement_config) ;
  return p->mAttribute_value ;
}



//---------------------------------------------------------------------------*
//                                                                           *
//                               @config type                                *
//                                                                           *
//---------------------------------------------------------------------------*

const C_galgas_type_descriptor
kTypeDescriptor_GALGAS_config ("config",
                               NULL) ;

//---------------------------------------------------------------------------*

const C_galgas_type_descriptor * GALGAS_config::staticTypeDescriptor (void) const {
  return & kTypeDescriptor_GALGAS_config ;
}

//---------------------------------------------------------------------------*

AC_GALGAS_root * GALGAS_config::clonedObject (void) const {
  AC_GALGAS_root * result = NULL ;
  if (isValid ()) {
    macroMyNew (result, GALGAS_config (*this)) ;
  }
  return result ;
}

//---------------------------------------------------------------------------*

GALGAS_config GALGAS_config::extractObject (const GALGAS_object & inObject,
                                            C_Compiler * inCompiler,
                                            const GALGAS_location & inErrorLocation
                                            COMMA_LOCATION_ARGS) {
  GALGAS_config result ;
  const GALGAS_config * p = (const GALGAS_config *) inObject.embeddedObject () ;
  if (NULL != p) {
    if (NULL != dynamic_cast <const GALGAS_config *> (p)) {
      result = *p ;
    }else{
      inCompiler->extractObjectError (inErrorLocation, "config", p->dynamicTypeDescriptor () COMMA_THERE) ;
    }  
  }
  return result ;
}

//---------------------------------------------------------------------------*

cMapElement_cfg_5F_attrs::cMapElement_cfg_5F_attrs (const GALGAS_lstring & inKey,
                                                    const GALGAS_lstring & in_tpl_5F_attr
                                                    COMMA_LOCATION_ARGS) :
cMapElement (inKey COMMA_THERE),
mAttribute_tpl_5F_attr (in_tpl_5F_attr) {
}

//---------------------------------------------------------------------------*

bool cMapElement_cfg_5F_attrs::isValid (void) const {
  return mAttribute_lkey.isValid () && mAttribute_tpl_5F_attr.isValid () ;
}

//---------------------------------------------------------------------------*

cMapElement * cMapElement_cfg_5F_attrs::copy (void) {
  cMapElement * result = NULL ;
  macroMyNew (result, cMapElement_cfg_5F_attrs (mAttribute_lkey, mAttribute_tpl_5F_attr COMMA_HERE)) ;
  return result ;
}

//---------------------------------------------------------------------------*

void cMapElement_cfg_5F_attrs::description (C_String & ioString, const PMSInt32 inIndentation) const {
  ioString << "\n" ;
  ioString.writeStringMultiple ("| ", inIndentation) ;
  ioString << "tpl_attr" ":" ;
  mAttribute_tpl_5F_attr.description (ioString, inIndentation) ;
}

//---------------------------------------------------------------------------*

enumComparisonResult cMapElement_cfg_5F_attrs::compare (const cCollectionElement * inOperand) const {
  cMapElement_cfg_5F_attrs * operand = (cMapElement_cfg_5F_attrs *) inOperand ;
  enumComparisonResult result = mAttribute_lkey.objectCompare (operand->mAttribute_lkey) ;
  if (kOperandEqual == result) {
    result = mAttribute_tpl_5F_attr.objectCompare (operand->mAttribute_tpl_5F_attr) ;
  }
  return result ;
}

//---------------------------------------------------------------------------*

GALGAS_cfg_5F_attrs::GALGAS_cfg_5F_attrs (void) :
AC_GALGAS_map () {
}

//---------------------------------------------------------------------------*

GALGAS_cfg_5F_attrs::GALGAS_cfg_5F_attrs (const GALGAS_cfg_5F_attrs & inSource) :
AC_GALGAS_map (inSource) {
}

//---------------------------------------------------------------------------*

GALGAS_cfg_5F_attrs & GALGAS_cfg_5F_attrs::operator = (const GALGAS_cfg_5F_attrs & inSource) {
  * ((AC_GALGAS_map *) this) = inSource ;
  return * this ;
}

//---------------------------------------------------------------------------*

GALGAS_cfg_5F_attrs GALGAS_cfg_5F_attrs::constructor_emptyMap (LOCATION_ARGS) {
  GALGAS_cfg_5F_attrs result ;
  result.makeNewEmptyMap (THERE) ;
  return result ;
}

//---------------------------------------------------------------------------*

GALGAS_cfg_5F_attrs GALGAS_cfg_5F_attrs::constructor_mapWithMapToOverride (const GALGAS_cfg_5F_attrs & inMapToOverride
                                                                           COMMA_LOCATION_ARGS) {
  GALGAS_cfg_5F_attrs result ;
  result.makeNewEmptyMapWithMapToOverride (inMapToOverride COMMA_THERE) ;
  return result ;
}

//---------------------------------------------------------------------------*

GALGAS_cfg_5F_attrs GALGAS_cfg_5F_attrs::reader_overriddenMap (UNUSED_LOCATION_ARGS) const {
  GALGAS_cfg_5F_attrs result ;
  getOverridenMap (result) ;
  return result ;
}
//---------------------------------------------------------------------------*

void GALGAS_cfg_5F_attrs::modifier_put (GALGAS_lstring inKey,
                                        GALGAS_lstring inArgument0,
                                        C_Compiler * inCompiler
                                        COMMA_LOCATION_ARGS) {
  cMapElement_cfg_5F_attrs * p = NULL ;
  macroMyNew (p, cMapElement_cfg_5F_attrs (inKey, inArgument0 COMMA_HERE)) ;
  capCollectionElement attributes ;
  attributes.setPointer (p) ;
  macroDetachSharedObject (p) ;
  const char * kInsertErrorMessage = "Attribute %K redefined in %L" ;
  const char * kShadowErrorMessage = "" ;
  performInsert (attributes, inCompiler, kInsertErrorMessage, kShadowErrorMessage COMMA_THERE) ;
}

//---------------------------------------------------------------------------*

const char * kSearchErrorMessage_cfg_5F_attrs_get = "Attribute %K is not defined" ;

//---------------------------------------------------------------------------*

void GALGAS_cfg_5F_attrs::method_get (GALGAS_lstring inKey,
                                      GALGAS_lstring & outArgument0,
                                      C_Compiler * inCompiler
                                      COMMA_LOCATION_ARGS) const {
  const cMapElement_cfg_5F_attrs * p = (const cMapElement_cfg_5F_attrs *) performSearch (inKey,
                                                                                           inCompiler,
                                                                                           kSearchErrorMessage_cfg_5F_attrs_get
                                                                                           COMMA_THERE) ;
  if (NULL == p) {
    outArgument0.drop () ;
  }else{
    macroValidSharedObject (p, const cMapElement_cfg_5F_attrs) ;
    outArgument0 = p->mAttribute_tpl_5F_attr ;
  }
}

//---------------------------------------------------------------------------*

void GALGAS_cfg_5F_attrs::modifier_del (GALGAS_lstring inKey,
                                        GALGAS_lstring & outArgument0,
                                        C_Compiler * inCompiler
                                        COMMA_LOCATION_ARGS) {
  const char * kRemoveErrorMessage = "Attribute %K is not defined" ;
  capCollectionElement attributes ;
  performRemove (inKey, attributes, inCompiler, kRemoveErrorMessage COMMA_THERE) ;
  cMapElement_cfg_5F_attrs * p = (cMapElement_cfg_5F_attrs *) attributes.ptr () ;
  if (NULL != p) {
    macroValidSharedObject (p, cMapElement_cfg_5F_attrs) ;
    outArgument0 = p->mAttribute_tpl_5F_attr ;
  }
}

//---------------------------------------------------------------------------*

GALGAS_lstring GALGAS_cfg_5F_attrs::reader_tpl_5F_attrForKey (const GALGAS_string & inKey,
                                                              C_Compiler * inCompiler
                                                              COMMA_LOCATION_ARGS) const {
  const cCollectionElement * attributes = searchForReadingAttribute (inKey, inCompiler COMMA_THERE) ;
  const cMapElement_cfg_5F_attrs * p = (const cMapElement_cfg_5F_attrs *) attributes ;
  GALGAS_lstring result ;
  if (NULL != p) {
    macroValidSharedObject (p, const cMapElement_cfg_5F_attrs) ;
    result = p->mAttribute_tpl_5F_attr ;
  }
  return result ;
}

//---------------------------------------------------------------------------*

void GALGAS_cfg_5F_attrs::modifier_setTpl_5F_attrForKey (GALGAS_lstring inAttributeValue,
                                                         GALGAS_string inKey,
                                                         C_Compiler * inCompiler
                                                         COMMA_LOCATION_ARGS) {
  cCollectionElement * attributes = searchForReadWriteAttribute (inKey, inCompiler COMMA_THERE) ;
  cMapElement_cfg_5F_attrs * p = (cMapElement_cfg_5F_attrs *) attributes ;
  if (NULL != p) {
    macroValidSharedObject (p, cMapElement_cfg_5F_attrs) ;
    p->mAttribute_tpl_5F_attr = inAttributeValue ;
  }
}

//---------------------------------------------------------------------------*

cMapElement_cfg_5F_attrs * GALGAS_cfg_5F_attrs::readWriteAccessForWithInstruction_get (C_Compiler * inCompiler,
                                                                                       const GALGAS_lstring & inKey
                                                                                       COMMA_LOCATION_ARGS) {
  cMapElement * p = searchForReadWriteAttribute (inKey, inCompiler, kSearchErrorMessage_cfg_5F_attrs_get COMMA_THERE) ;
  cMapElement_cfg_5F_attrs * result = (cMapElement_cfg_5F_attrs *) p ;
  macroNullOrValidSharedObject (result, cMapElement_cfg_5F_attrs) ;
  return result ;
}

//---------------------------------------------------------------------------*

cMapElement_cfg_5F_attrs * GALGAS_cfg_5F_attrs::readWriteAccessForWithInstruction_hasKey (C_Compiler * inCompiler,
                                                                                          const GALGAS_string & inKey
                                                                                          COMMA_LOCATION_ARGS) {
  cMapElement * p = searchForReadWriteAttribute (inKey, inCompiler COMMA_THERE) ;
  cMapElement_cfg_5F_attrs * result = (cMapElement_cfg_5F_attrs *) p ;
  macroNullOrValidSharedObject (result, cMapElement_cfg_5F_attrs) ;
  return result ;
}

//---------------------------------------------------------------------------*

cEnumerator_cfg_5F_attrs::cEnumerator_cfg_5F_attrs (const GALGAS_cfg_5F_attrs & inEnumeratedObject,
                                                    const bool inAscending) :
cGenericAbstractEnumerator () {
  inEnumeratedObject.populateEnumerationArray (mEnumerationArray, inAscending) ;
}

//---------------------------------------------------------------------------*

GALGAS_lstring cEnumerator_cfg_5F_attrs::current_lkey (LOCATION_ARGS) const {
  const cMapElement * p = (const cMapElement *) currentObjectPtr (THERE) ;
  macroValidSharedObject (p, const cMapElement) ;
  return p->mAttribute_lkey ;
}

//---------------------------------------------------------------------------*

GALGAS_lstring cEnumerator_cfg_5F_attrs::current_tpl_5F_attr (LOCATION_ARGS) const {
  const cMapElement_cfg_5F_attrs * p = (const cMapElement_cfg_5F_attrs *) currentObjectPtr (THERE) ;
  macroValidSharedObject (p, const cMapElement_cfg_5F_attrs) ;
  return p->mAttribute_tpl_5F_attr ;
}



//---------------------------------------------------------------------------*
//                                                                           *
//                              @cfg_attrs type                              *
//                                                                           *
//---------------------------------------------------------------------------*

const C_galgas_type_descriptor
kTypeDescriptor_GALGAS_cfg_5F_attrs ("cfg_attrs",
                                     NULL) ;

//---------------------------------------------------------------------------*

const C_galgas_type_descriptor * GALGAS_cfg_5F_attrs::staticTypeDescriptor (void) const {
  return & kTypeDescriptor_GALGAS_cfg_5F_attrs ;
}

//---------------------------------------------------------------------------*

AC_GALGAS_root * GALGAS_cfg_5F_attrs::clonedObject (void) const {
  AC_GALGAS_root * result = NULL ;
  if (isValid ()) {
    macroMyNew (result, GALGAS_cfg_5F_attrs (*this)) ;
  }
  return result ;
}

//---------------------------------------------------------------------------*

GALGAS_cfg_5F_attrs GALGAS_cfg_5F_attrs::extractObject (const GALGAS_object & inObject,
                                                        C_Compiler * inCompiler,
                                                        const GALGAS_location & inErrorLocation
                                                        COMMA_LOCATION_ARGS) {
  GALGAS_cfg_5F_attrs result ;
  const GALGAS_cfg_5F_attrs * p = (const GALGAS_cfg_5F_attrs *) inObject.embeddedObject () ;
  if (NULL != p) {
    if (NULL != dynamic_cast <const GALGAS_cfg_5F_attrs *> (p)) {
      result = *p ;
    }else{
      inCompiler->extractObjectError (inErrorLocation, "cfg_attrs", p->dynamicTypeDescriptor () COMMA_THERE) ;
    }  
  }
  return result ;
}

//---------------------------------------------------------------------------*

enumComparisonResult GALGAS_attrs::objectCompare (const GALGAS_attrs & inOperand) const {
  enumComparisonResult result = GALGAS_basic_5F_type::objectCompare (inOperand) ;
  const cPtr_attrs * p = (const cPtr_attrs *) mObjectPtr ;
  macroNullOrValidSharedObject (p, const cPtr_attrs) ;
  const cPtr_attrs * q = (const cPtr_attrs *) inOperand.mObjectPtr ;
  macroNullOrValidSharedObject (q, const cPtr_attrs) ;
  if (kOperandEqual == result) {
    result = p->mAttribute_attrs.objectCompare (q->mAttribute_attrs) ;
  }
  return result ;
}


//---------------------------------------------------------------------------*

GALGAS_attrs::GALGAS_attrs (void) :
GALGAS_basic_5F_type () {
}

//---------------------------------------------------------------------------*

GALGAS_attrs::GALGAS_attrs (const cPtr_attrs * inSourcePtr) :
GALGAS_basic_5F_type (inSourcePtr) {
  macroNullOrValidSharedObject (inSourcePtr, const cPtr_attrs) ;
}

//---------------------------------------------------------------------------*

GALGAS_attrs GALGAS_attrs::constructor_new (const GALGAS_location & inAttribute_location,
                                            const GALGAS_cfg_5F_attrs & inAttribute_attrs
                                            COMMA_LOCATION_ARGS) {
  GALGAS_attrs result ;
  if (inAttribute_location.isValid () && inAttribute_attrs.isValid ()) {
    macroMyNew (result.mObjectPtr, cPtr_attrs (inAttribute_location, inAttribute_attrs COMMA_THERE)) ;
  }
  return result ;
}

//---------------------------------------------------------------------------*

void GALGAS_attrs::insulate (LOCATION_ARGS) {
  if (isValid () && (mObjectPtr->retainCount () > 1)) {
    cPtr_attrs * p = (cPtr_attrs *) mObjectPtr ;
    macroValidSharedObject (p, cPtr_attrs) ;
    cPtr_attrs * r = NULL ;
    macroMyNew (r, cPtr_attrs (p->mAttribute_location, p->mAttribute_attrs COMMA_THERE)) ;
    macroAssignSharedObject (mObjectPtr, r) ;
    macroDetachSharedObject (r) ;
  }
}

//---------------------------------------------------------------------------*

GALGAS_cfg_5F_attrs GALGAS_attrs::reader_attrs (UNUSED_LOCATION_ARGS) const {
  GALGAS_cfg_5F_attrs result ;
  if (NULL != mObjectPtr) {
    const cPtr_attrs * p = (const cPtr_attrs *) mObjectPtr ;
    macroValidSharedObject (p, const cPtr_attrs) ;
    result = p->mAttribute_attrs ;
  }
  return result ;
}

//---------------------------------------------------------------------------*
//                      Pointer class for @attrs class                       *
//---------------------------------------------------------------------------*

cPtr_attrs::cPtr_attrs (const GALGAS_location & in_location,
                        const GALGAS_cfg_5F_attrs & in_attrs
                        COMMA_LOCATION_ARGS) :
cPtr_basic_5F_type (in_location COMMA_THERE),
mAttribute_attrs (in_attrs) {
}

//---------------------------------------------------------------------------*

const C_galgas_type_descriptor * cPtr_attrs::classDescriptor (void) const {
  return & kTypeDescriptor_GALGAS_attrs ;
}

void cPtr_attrs::description (C_String & ioString,
                              const PMSInt32 inIndentation) const {
  ioString << "[@attrs:" ;
  mAttribute_location.description (ioString, inIndentation+1) ;
  ioString << ", " ;
  mAttribute_attrs.description (ioString, inIndentation+1) ;
  ioString << "]" ;
}



//---------------------------------------------------------------------------*
//                                                                           *
//                                @attrs type                                *
//                                                                           *
//---------------------------------------------------------------------------*

const C_galgas_type_descriptor
kTypeDescriptor_GALGAS_attrs ("attrs",
                              & kTypeDescriptor_GALGAS_basic_5F_type) ;

//---------------------------------------------------------------------------*

const C_galgas_type_descriptor * GALGAS_attrs::staticTypeDescriptor (void) const {
  return & kTypeDescriptor_GALGAS_attrs ;
}

//---------------------------------------------------------------------------*

AC_GALGAS_root * GALGAS_attrs::clonedObject (void) const {
  AC_GALGAS_root * result = NULL ;
  if (isValid ()) {
    macroMyNew (result, GALGAS_attrs (*this)) ;
  }
  return result ;
}

//---------------------------------------------------------------------------*

GALGAS_attrs GALGAS_attrs::extractObject (const GALGAS_object & inObject,
                                          C_Compiler * inCompiler,
                                          const GALGAS_location & inErrorLocation
                                          COMMA_LOCATION_ARGS) {
  GALGAS_attrs result ;
  const GALGAS_attrs * p = (const GALGAS_attrs *) inObject.embeddedObject () ;
  if (NULL != p) {
    if (NULL != dynamic_cast <const GALGAS_attrs *> (p)) {
      result = *p ;
    }else{
      inCompiler->extractObjectError (inErrorLocation, "attrs", p->dynamicTypeDescriptor () COMMA_THERE) ;
    }  
  }
  return result ;
}

//---------------------------------------------------------------------------*

enumComparisonResult GALGAS_interrupts::objectCompare (const GALGAS_interrupts & inOperand) const {
  enumComparisonResult result = GALGAS_basic_5F_type::objectCompare (inOperand) ;
  const cPtr_interrupts * p = (const cPtr_interrupts *) mObjectPtr ;
  macroNullOrValidSharedObject (p, const cPtr_interrupts) ;
  const cPtr_interrupts * q = (const cPtr_interrupts *) inOperand.mObjectPtr ;
  macroNullOrValidSharedObject (q, const cPtr_interrupts) ;
  if (kOperandEqual == result) {
    result = p->mAttribute_it_5F_count.objectCompare (q->mAttribute_it_5F_count) ;
  }
  if (kOperandEqual == result) {
    result = p->mAttribute_it_5F_sources.objectCompare (q->mAttribute_it_5F_sources) ;
  }
  return result ;
}


//---------------------------------------------------------------------------*

GALGAS_interrupts::GALGAS_interrupts (void) :
GALGAS_basic_5F_type () {
}

//---------------------------------------------------------------------------*

GALGAS_interrupts::GALGAS_interrupts (const cPtr_interrupts * inSourcePtr) :
GALGAS_basic_5F_type (inSourcePtr) {
  macroNullOrValidSharedObject (inSourcePtr, const cPtr_interrupts) ;
}

//---------------------------------------------------------------------------*

GALGAS_interrupts GALGAS_interrupts::constructor_new (const GALGAS_location & inAttribute_location,
                                                      const GALGAS_luint_36__34_ & inAttribute_it_5F_count,
                                                      const GALGAS_ident_5F_map & inAttribute_it_5F_sources
                                                      COMMA_LOCATION_ARGS) {
  GALGAS_interrupts result ;
  if (inAttribute_location.isValid () && inAttribute_it_5F_count.isValid () && inAttribute_it_5F_sources.isValid ()) {
    macroMyNew (result.mObjectPtr, cPtr_interrupts (inAttribute_location, inAttribute_it_5F_count, inAttribute_it_5F_sources COMMA_THERE)) ;
  }
  return result ;
}

//---------------------------------------------------------------------------*

void GALGAS_interrupts::insulate (LOCATION_ARGS) {
  if (isValid () && (mObjectPtr->retainCount () > 1)) {
    cPtr_interrupts * p = (cPtr_interrupts *) mObjectPtr ;
    macroValidSharedObject (p, cPtr_interrupts) ;
    cPtr_interrupts * r = NULL ;
    macroMyNew (r, cPtr_interrupts (p->mAttribute_location, p->mAttribute_it_5F_count, p->mAttribute_it_5F_sources COMMA_THERE)) ;
    macroAssignSharedObject (mObjectPtr, r) ;
    macroDetachSharedObject (r) ;
  }
}

//---------------------------------------------------------------------------*

GALGAS_luint_36__34_ GALGAS_interrupts::reader_it_5F_count (UNUSED_LOCATION_ARGS) const {
  GALGAS_luint_36__34_ result ;
  if (NULL != mObjectPtr) {
    const cPtr_interrupts * p = (const cPtr_interrupts *) mObjectPtr ;
    macroValidSharedObject (p, const cPtr_interrupts) ;
    result = p->mAttribute_it_5F_count ;
  }
  return result ;
}

//---------------------------------------------------------------------------*

GALGAS_ident_5F_map GALGAS_interrupts::reader_it_5F_sources (UNUSED_LOCATION_ARGS) const {
  GALGAS_ident_5F_map result ;
  if (NULL != mObjectPtr) {
    const cPtr_interrupts * p = (const cPtr_interrupts *) mObjectPtr ;
    macroValidSharedObject (p, const cPtr_interrupts) ;
    result = p->mAttribute_it_5F_sources ;
  }
  return result ;
}

//---------------------------------------------------------------------------*
//                    Pointer class for @interrupts class                    *
//---------------------------------------------------------------------------*

cPtr_interrupts::cPtr_interrupts (const GALGAS_location & in_location,
                                  const GALGAS_luint_36__34_ & in_it_5F_count,
                                  const GALGAS_ident_5F_map & in_it_5F_sources
                                  COMMA_LOCATION_ARGS) :
cPtr_basic_5F_type (in_location COMMA_THERE),
mAttribute_it_5F_count (in_it_5F_count),
mAttribute_it_5F_sources (in_it_5F_sources) {
}

//---------------------------------------------------------------------------*

const C_galgas_type_descriptor * cPtr_interrupts::classDescriptor (void) const {
  return & kTypeDescriptor_GALGAS_interrupts ;
}

void cPtr_interrupts::description (C_String & ioString,
                                   const PMSInt32 inIndentation) const {
  ioString << "[@interrupts:" ;
  mAttribute_location.description (ioString, inIndentation+1) ;
  ioString << ", " ;
  mAttribute_it_5F_count.description (ioString, inIndentation+1) ;
  ioString << ", " ;
  mAttribute_it_5F_sources.description (ioString, inIndentation+1) ;
  ioString << "]" ;
}



//---------------------------------------------------------------------------*
//                                                                           *
//                             @interrupts type                              *
//                                                                           *
//---------------------------------------------------------------------------*

const C_galgas_type_descriptor
kTypeDescriptor_GALGAS_interrupts ("interrupts",
                                   & kTypeDescriptor_GALGAS_basic_5F_type) ;

//---------------------------------------------------------------------------*

const C_galgas_type_descriptor * GALGAS_interrupts::staticTypeDescriptor (void) const {
  return & kTypeDescriptor_GALGAS_interrupts ;
}

//---------------------------------------------------------------------------*

AC_GALGAS_root * GALGAS_interrupts::clonedObject (void) const {
  AC_GALGAS_root * result = NULL ;
  if (isValid ()) {
    macroMyNew (result, GALGAS_interrupts (*this)) ;
  }
  return result ;
}

//---------------------------------------------------------------------------*

GALGAS_interrupts GALGAS_interrupts::extractObject (const GALGAS_object & inObject,
                                                    C_Compiler * inCompiler,
                                                    const GALGAS_location & inErrorLocation
                                                    COMMA_LOCATION_ARGS) {
  GALGAS_interrupts result ;
  const GALGAS_interrupts * p = (const GALGAS_interrupts *) inObject.embeddedObject () ;
  if (NULL != p) {
    if (NULL != dynamic_cast <const GALGAS_interrupts *> (p)) {
      result = *p ;
    }else{
      inCompiler->extractObjectError (inErrorLocation, "interrupts", p->dynamicTypeDescriptor () COMMA_THERE) ;
    }  
  }
  return result ;
}

//--- START OF USER ZONE 2


//--- END OF USER ZONE 2


