//---------------------------------------------------------------------------*
//                                                                           *
//                      File 'it_table_generation.cpp'                       *
//                        Generated by version 1.9.5                         *
//                     november 23th, 2009, at 12h7'24"                      *
//                                                                           *
//---------------------------------------------------------------------------*

//--- START OF USER ZONE 1


//--- END OF USER ZONE 1

//---------------------------------------------------------------------------*

#include "version_libpm.h"
#if LIBPM_VERSION != 614
  #error "This file has been compiled with a version of GALGAS different than the version of libpm"
#endif

//---------------------------------------------------------------------------*

#include <typeinfo>
#include "utilities/MF_MemoryControl.h"
#include "files/C_TextFileWrite.h"
#include "galgas/C_galgas_CLI_Options.h"
#include "it_table_generation.h"

//---------------------------------------------------------------------------*

#ifndef DO_NOT_GENERATE_CHECKINGS
  #define SOURCE_FILE_AT_LINE(line) "it_table_generation.ggs", line
  #define COMMA_SOURCE_FILE_AT_LINE(line) , SOURCE_FILE_AT_LINE(line)
#else
  #define SOURCE_FILE_AT_LINE(line) 
  #define COMMA_SOURCE_FILE_AT_LINE(line) 
#endif


//--- START OF USER ZONE 2


//--- END OF USER ZONE 2

//---------------------------------------------------------------------------*
//                                                                           *
//                       Element of list '@it_table'                         *
//                                                                           *
//---------------------------------------------------------------------------*

elementOf_GGS_it_table::
elementOf_GGS_it_table (const GGS_string& argument_0,
                                const GGS_string& argument_1
                                COMMA_LOCATION_ARGS) :
AC_galgas_list::cListElement (THERE),
fct (argument_0),
param (argument_1) {
}

//---------------------------------------------------------------------------*

bool elementOf_GGS_it_table::
isEqualToObject (const cListElement * inOperand) const {
  bool equal = inOperand == this ;
  if (! equal) {
    const elementOf_GGS_it_table * ptr = dynamic_cast <const elementOf_GGS_it_table *> (inOperand) ;
    macroValidPointer (ptr) ;
    equal = fct.operator_isEqual (ptr->fct).boolValue ()
         && param.operator_isEqual (ptr->param).boolValue () ;
  }
  return equal ;
}

//---------------------------------------------------------------------------*

void elementOf_GGS_it_table::
appendForDescription (C_String & ioString,
                      const PMSInt32 inIndentation) const {
  ioString << "\n" ;
  ioString.writeStringMultiple ("| ", inIndentation) ;
  ioString << "|-" ;
  ioString << fct.reader_description (inIndentation) ;
  ioString << "\n" ;
  ioString.writeStringMultiple ("| ", inIndentation) ;
  ioString << "|-" ;
  ioString << param.reader_description (inIndentation) ;
}

//---------------------------------------------------------------------------*
//                                                                           *
//                             List '@it_table'                              *
//                                                                           *
//---------------------------------------------------------------------------*

const C_galgas_type_descriptor kTypeDescriptor_GGS_it_table ("it_table", false, NULL) ;

//---------------------------------------------------------------------------*

void GGS_it_table::
internalAppendValues (const GGS_string& argument_0,
                    const GGS_string& argument_1
                    COMMA_LOCATION_ARGS) {
  cElement * nouvelElement = (cElement *) NULL ;
  macroMyNew (nouvelElement, cElement (argument_0,
                                argument_1
                                COMMA_THERE)) ;
  _internalAppendItem (nouvelElement) ;
}

//---------------------------------------------------------------------------*

void GGS_it_table::
internalPrependValues (const GGS_string& argument_0,
                    const GGS_string& argument_1
                    COMMA_LOCATION_ARGS) {
  cElement * nouvelElement = (cElement *) NULL ;
  macroMyNew (nouvelElement, cElement (argument_0,
                                argument_1
                                COMMA_THERE)) ;
  _internalPrependItem (nouvelElement) ;
}

//---------------------------------------------------------------------------*

void GGS_it_table::
addAssign_operation (const GGS_string& argument_0,
                                const GGS_string& argument_1) {
  if (isBuilt ()&& argument_0.isBuilt ()&& argument_1.isBuilt ()) {
    insulateList () ;
    internalAppendValues (argument_0,
                                argument_1
                                COMMA_HERE) ;
  }
}

//---------------------------------------------------------------------------*

GGS_it_table GGS_it_table::
operator_concat (const GGS_it_table & inOperand) const {
  GGS_it_table result = * this ;
  result.dotAssign_operation (inOperand) ;
  return result ;
}

//---------------------------------------------------------------------------*

void GGS_it_table::
dotAssign_operation (const GGS_it_table inOperand) {
  if (isBuilt () && inOperand.isBuilt ()) {
    if (count () == 0) {
      * this = inOperand ;
    }else{
      if (inOperand.count () > 0) {
        insulateList () ;
        elementOf_GGS_it_table * p = inOperand.firstObject () ;
        while (p != NULL) {
          macroValidPointer (p) ;
          GGS_string p_0 = p->fct ;
          GGS_string p_1 = p->param ;
          internalAppendValues (p_0, p_1 COMMA_HERE) ;
          p = p->nextObject () ;
        }
      }
    }
  }
}

//---------------------------------------------------------------------------*

void GGS_it_table::
modifier_prependValue (C_Compiler & /* inLexique */,
                     const GGS_string& argument_0,
                     const GGS_string& argument_1
                     COMMA_UNUSED_LOCATION_ARGS) {
  if (isBuilt ()) {
    insulateList () ;
    internalPrependValues (argument_0,
                                argument_1
                                COMMA_HERE) ;
  }
}

//---------------------------------------------------------------------------*

void GGS_it_table::
insulateList (void) {
  if (_shared ()) {
    cElement * ptr = firstObject () ;
    alloc () ;
    while (ptr != NULL) {
      macroValidPointer (ptr) ;
      internalAppendValues (ptr->fct,
                                ptr->param
                                COMMA_HERE) ;
      ptr = ptr->nextObject () ;
    }
  }
}

//---------------------------------------------------------------------------*

GGS_it_table  GGS_it_table::
constructor_emptyList (void) {
  GGS_it_table result ;
  result.alloc () ;
  return result ;
}

//---------------------------------------------------------------------------*

GGS_it_table  GGS_it_table::
constructor_listWithValue (const GGS_string& argument_0,
                                const GGS_string& argument_1) {
  GGS_it_table result ;
  result.alloc () ;
  result.addAssign_operation (argument_0, argument_1) ;
  return result ;
}

//---------------------------------------------------------------------------*

void GGS_it_table::
internalSubListWithRange (GGS_it_table & ioList,
                          const PMSInt32 inFirstIndex,
                          const PMSInt32 inCount) const {
  ioList.alloc () ;
  if (inCount > 0) {
    cElement * ptr = firstObject () ;
    for (PMSInt32 i=0 ; i<inFirstIndex ; i++) {
      macroValidPointer (ptr) ;
      ptr = ptr->nextObject () ;
    }
    for (PMSInt32 i=0 ; i<inCount ; i++) {
      macroValidPointer (ptr) ;
      ioList.addAssign_operation (ptr->fct, ptr->param) ;
      ptr = ptr->nextObject () ;
    }
  }
}

//---------------------------------------------------------------------------*

GGS_it_table GGS_it_table::
reader_subListWithRange (C_Compiler & inLexique,
                         const GGS_uint & inFirstIndex,
                         const GGS_uint & inCount
                         COMMA_LOCATION_ARGS) const {
  GGS_it_table result ;
  if (isBuilt () && inFirstIndex.isBuilt () && inCount.isBuilt ()) {
    const PMSInt32 firstIndex = (PMSInt32) inFirstIndex.uintValue () ;
    const PMSInt32 rangeCount = (PMSInt32) inCount.uintValue () ;
    if ((firstIndex + rangeCount) > count ()) {
      inLexique.onTheFlyRunTimeError ("'subListWithRange' method invoked with upper bound greater than list object count" COMMA_THERE) ;
    }else{
      internalSubListWithRange (result, firstIndex, rangeCount) ;
    }
  }
  return result ;
}

//---------------------------------------------------------------------------*

GGS_it_table GGS_it_table::
reader_subListFromIndex (C_Compiler & inLexique,
                         const GGS_uint & inIndex
                         COMMA_LOCATION_ARGS) const {
  GGS_it_table result ;
  if (isBuilt () && inIndex.isBuilt ()) {
    const PMSInt32 startIndex = (PMSInt32) inIndex.uintValue () ;
    if (startIndex > count ()) {
      inLexique.onTheFlyRunTimeError ("'subListFromIndex' method invoked with start index greater than list object count" COMMA_THERE) ;
    }else{
      internalSubListWithRange (result, startIndex, count () - startIndex) ;
    }
  }
  return result ;
}

//---------------------------------------------------------------------------*

GGS_string GGS_it_table::
reader_description (const PMSInt32 inIndentation) const {
  return performDescription ("@it_table", inIndentation) ;
}

//---------------------------------------------------------------------------*

void GGS_it_table::
method_first (C_Compiler & inLexique,
              GGS_string& _out_0,
              GGS_string& _out_1
              COMMA_LOCATION_ARGS) const {
  cElement * ptr = NULL ;
  if (isBuilt ()) {
    ptr = firstObject () ;
    if (ptr == NULL) {
      inLexique.onTheFlyRunTimeError ("'first' method invoked on an empty list" COMMA_THERE) ;
    }
  }
  if (ptr != NULL) {
    _out_0 = ptr->fct ;
    _out_1 = ptr->param ;
  }else{
    _out_0.drop () ;
    _out_1.drop () ;
  }
}

//---------------------------------------------------------------------------*

void GGS_it_table::
method_last (C_Compiler & inLexique,
             GGS_string& _out_0,
             GGS_string& _out_1
             COMMA_LOCATION_ARGS) const {
  cElement * ptr = NULL ;
  if (isBuilt ()) {
    ptr = lastObject () ;
    if (ptr == NULL) {
      inLexique.onTheFlyRunTimeError ("'last' method invoked on an empty list" COMMA_THERE) ;
    }
  }
  if (ptr != NULL) {
    _out_0 = ptr->fct ;
    _out_1 = ptr->param ;
  }else{
    _out_0.drop () ;
    _out_1.drop () ;
  }
}

//---------------------------------------------------------------------------*

void GGS_it_table::
modifier_popFirst (C_Compiler & inLexique,
                 GGS_string& _out_0,
                 GGS_string& _out_1
                 COMMA_LOCATION_ARGS) {
  cElement * ptr = NULL ;
  if (isBuilt ()) {
    ptr = firstObject () ;
    if (ptr == NULL) {
      inLexique.onTheFlyRunTimeError ("'popFirst' modifier invoked on an empty list" COMMA_THERE) ;
    }
  }
  if (ptr != NULL) {
    _out_0 = ptr->fct ;
    _out_1 = ptr->param ;
    insulateList () ;
    _internalRemoveFirst () ;
  }else{
    _out_0.drop () ;
    _out_1.drop () ;
  }
}

//---------------------------------------------------------------------------*

void GGS_it_table::
modifier_popLast (C_Compiler & inLexique,
                GGS_string& _out_0,
                GGS_string& _out_1
                COMMA_LOCATION_ARGS) {
  cElement * ptr = NULL ;
  if (isBuilt ()) {
    ptr = lastObject () ;
    if (ptr == NULL) {
      inLexique.onTheFlyRunTimeError ("'popLast' modifier invoked on an empty list" COMMA_THERE) ;
    }
  }
  if (ptr != NULL) {
    _out_0 = ptr->fct ;
    _out_1 = ptr->param ;
    insulateList () ;
    _internalRemoveLast () ;
  }else{
    _out_0.drop () ;
    _out_1.drop () ;
  }
}

//---------------------------------------------------------------------------*

GGS_string GGS_it_table::
reader_fctAtIndex (C_Compiler & inLexique, const GGS_uint & inIndex COMMA_LOCATION_ARGS) const {
  GGS_string result ;
  if (isBuilt () && inIndex.isBuilt ()) {
    cElement * object = (cElement *) objectAtIndex (inLexique, inIndex.uintValue () COMMA_THERE) ;
    if (object != NULL) {
      result = object->fct ;
    }
  }
  return result ;
}

//---------------------------------------------------------------------------*

GGS_string GGS_it_table::
reader_paramAtIndex (C_Compiler & inLexique, const GGS_uint & inIndex COMMA_LOCATION_ARGS) const {
  GGS_string result ;
  if (isBuilt () && inIndex.isBuilt ()) {
    cElement * object = (cElement *) objectAtIndex (inLexique, inIndex.uintValue () COMMA_THERE) ;
    if (object != NULL) {
      result = object->param ;
    }
  }
  return result ;
}

//---------------------------------------------------------------------------*

void GGS_it_table::
modifier_setFctAtIndex (C_Compiler & inLexique,
                              const GGS_string & inObject,
                              const GGS_uint & inIndex
                              COMMA_LOCATION_ARGS) const {
  if (isBuilt () && inIndex.isBuilt ()) {
    cElement * object = (cElement *) objectAtIndex (inLexique, inIndex.uintValue () COMMA_THERE) ;
    if (object != NULL) {
      object->fct = inObject ;
    }
  }
}

//---------------------------------------------------------------------------*

void GGS_it_table::
modifier_setParamAtIndex (C_Compiler & inLexique,
                              const GGS_string & inObject,
                              const GGS_uint & inIndex
                              COMMA_LOCATION_ARGS) const {
  if (isBuilt () && inIndex.isBuilt ()) {
    cElement * object = (cElement *) objectAtIndex (inLexique, inIndex.uintValue () COMMA_THERE) ;
    if (object != NULL) {
      object->param = inObject ;
    }
  }
}

//---------------------------------------------------------------------------*

/* const */ GGS_string & GGS_it_table::cEnumerator::_fct (LOCATION_ARGS) const {
  macroValidPointerThere (mCurrentEnumeratedObject) ;
  return ((/* const */ cElement *) mCurrentEnumeratedObject)->fct ;
}

//---------------------------------------------------------------------------*

/* const */ GGS_string & GGS_it_table::cEnumerator::_param (LOCATION_ARGS) const {
  macroValidPointerThere (mCurrentEnumeratedObject) ;
  return ((/* const */ cElement *) mCurrentEnumeratedObject)->param ;
}

//---------------------------------------------------------------------------*

GGS_object GGS_it_table::reader_object (void) const {
  GGS_object result ;
  if (isBuilt ()) {
    GGS_it_table * p = NULL ;
    macroMyNew (p, GGS_it_table (*this)) ;
    result = GGS_object (p) ;
  }
  return result ;
}

//---------------------------------------------------------------------------*

GGS_it_table GGS_it_table::castFromObject (C_Compiler & inLexique,
                                   const GGS_object & inObject,
                                   const GGS_location & inErrorLocation
                                   COMMA_LOCATION_ARGS) {
  GGS_it_table result ;
  const GGS__root * embeddedObject = inObject.embeddedObject () ;
  if (NULL != embeddedObject) {
    const GGS_it_table * p = dynamic_cast <const GGS_it_table *> (embeddedObject) ;
    if (NULL != p) {
      result = * p ;
    }else{
      castFromObjectErrorSignaling (inLexique, inErrorLocation, & kTypeDescriptor_GGS_it_table, embeddedObject COMMA_THERE) ;
    }
  }
  return result ;
}

//---------------------------------------------------------------------------*

const C_galgas_type_descriptor * GGS_it_table::typeDescriptor (void) const {
  return & kTypeDescriptor_GGS_it_table ;
}

//---------------------------------------------------------------------------*
//                                                                           *
//              Implementation of routine "generate_it_table"                *
//                                                                           *
//---------------------------------------------------------------------------*

void routine_generate_it_table (C_Compiler & inLexique,
                                const GGS_config   var_cas_cfg,
                                const GGS_os_config   var_cas_gen_cfg,
                                const GGS_root_obj   var_cas_cpu,
                                GGS_string & var_cas_imp COMMA_UNUSED_LOCATION_ARGS) {
  #ifdef DEBUG_TRACE_ENABLED
    printf ("ENTER routine_generate_it_table at %s:%d\n", __FILE__, __LINE__) ;
  #endif
  const GGS_bool cond_4896 = gOption_goil_5F_options_posix_5F_it.value () ;
  if (cond_4896.isBuiltAndTrue ()) {
    const GGS_bool cond_4886 = var_cas_cfg.reader_hasKey (GGS_string ("it_sources")) ;
    if (cond_4886.isBuiltAndTrue ()) {
      GGS_basic_type  var_cas_interrupt_srcs ;
      const GGS_config  temp_991 = var_cas_cfg ;
      if (temp_991.isBuilt ()) {
        temp_991 (HERE)->method_get (inLexique, GGS_lstring ::constructor_new (inLexique, GGS_string ("it_sources"), GGS_location (inLexique) COMMA_HERE), var_cas_interrupt_srcs COMMA_SOURCE_FILE_AT_LINE (48)) ;
      }
      { const GGS_basic_type _var_4870 = var_cas_interrupt_srcs ; // CAST instruction
        if (_var_4870.getPtr () != NULL) {
          macroValidPointer (_var_4870.getPtr ()) ;
          if (typeid (cPtr_interrupts) == typeid (* (_var_4870.getPtr ()))) {
            const GGS_interrupts var_cas_i (_var_4870.getPtr ()) ;
            GGS_it_table  var_cas_tbl = GGS_it_table ::constructor_emptyList () ;
            GGS_uint64  var_cas_it_count = var_cas_i.reader_it_count (inLexique COMMA_SOURCE_FILE_AT_LINE (52)).reader_uint64 (inLexique COMMA_SOURCE_FILE_AT_LINE (52)) ;
            GGS_uint  var_cas_n = var_cas_it_count.reader_uint (inLexique COMMA_SOURCE_FILE_AT_LINE (54)) ;
            GGS_uint _variant_1329 = GGS_uint (32U) ;
            GGS_bool _condition_1329 (_variant_1329.isBuilt (), true) ;
            while (_condition_1329.isBuiltAndTrue ()) {
              _condition_1329 = (var_cas_n).operator_strictSup (GGS_uint (0U)) ;
              if (_condition_1329.isBuiltAndTrue ()) {
                if (_variant_1329.uintValue () == 0) {
                  inLexique.onTheFlyRunTimeError ("loop variant error" COMMA_SOURCE_FILE_AT_LINE (58)) ;
                  _condition_1329 = GGS_bool (false) ;
                }else{
                  _variant_1329.decrement_operation (inLexique COMMA_HERE) ;
                  var_cas_tbl.addAssign_operation (GGS_string ("tpl_null_it"), GGS_string ("NULL")) ;
                  var_cas_n.decrement_operation (inLexique COMMA_SOURCE_FILE_AT_LINE (57)) ;
                }
              }
            }
            GGS_uint  var_cas_isr_base_id = var_cas_cpu.reader_tasks (inLexique COMMA_SOURCE_FILE_AT_LINE (62)).reader_count () ;
            {
                GGS_uint var_cas_isr_id (true, 0) ;
              GGS_isr_map::cEnumerator enumerator_1426 (var_cas_cpu.reader_isrs (inLexique COMMA_SOURCE_FILE_AT_LINE (63)), true) ;
              const GGS_isr_map::cElement * operand_1426 = NULL ;
              while (((operand_1426 = enumerator_1426.nextObject ()))) {
                macroValidPointer (operand_1426) ;
                const GGS_bool cond_2486 = operand_1426->mInfo.isr.reader_other_fields (inLexique COMMA_SOURCE_FILE_AT_LINE (64)).reader_hasKey (GGS_string ("SOURCE")) ;
                if (cond_2486.isBuiltAndTrue ()) {
                  GGS_basic_type  var_cas_val ;
                  const GGS_ident_map  temp_1571 = operand_1426->mInfo.isr.reader_other_fields (inLexique COMMA_SOURCE_FILE_AT_LINE (66)) ;
                  if (temp_1571.isBuilt ()) {
                    temp_1571 (HERE)->method_get (inLexique, GGS_lstring ::constructor_new (inLexique, GGS_string ("SOURCE"), GGS_location (inLexique) COMMA_HERE), var_cas_val COMMA_SOURCE_FILE_AT_LINE (66)) ;
                  }
                  { const GGS_basic_type _var_2465 = var_cas_val ; // CAST instruction
                    if (_var_2465.getPtr () != NULL) {
                      macroValidPointer (_var_2465.getPtr ()) ;
                      if (typeid (cPtr_string_class) == typeid (* (_var_2465.getPtr ()))) {
                        const GGS_string_class var_cas_s (_var_2465.getPtr ()) ;
                        const GGS_bool cond_2248 = var_cas_i.reader_it_sources (inLexique COMMA_SOURCE_FILE_AT_LINE (69)).reader_hasKey (var_cas_s.reader_value (inLexique COMMA_SOURCE_FILE_AT_LINE (69))) ;
                        if (cond_2248.isBuiltAndTrue ()) {
                          GGS_basic_type  var_cas_it_id ;
                          const GGS_ident_map  temp_1794 = var_cas_i.reader_it_sources (inLexique COMMA_SOURCE_FILE_AT_LINE (71)) ;
                          if (temp_1794.isBuilt ()) {
                            temp_1794 (HERE)->method_get (inLexique, GGS_lstring ::constructor_new (inLexique, var_cas_s.reader_value (inLexique COMMA_SOURCE_FILE_AT_LINE (71)), GGS_location (inLexique) COMMA_HERE), var_cas_it_id COMMA_SOURCE_FILE_AT_LINE (71)) ;
                          }
                          { const GGS_basic_type _var_2223 = var_cas_it_id ; // CAST instruction
                            if (_var_2223.getPtr () != NULL) {
                              macroValidPointer (_var_2223.getPtr ()) ;
                              if (typeid (cPtr_uint64_class) == typeid (* (_var_2223.getPtr ()))) {
                                const GGS_uint64_class var_cas_it_id (_var_2223.getPtr ()) ;
                                var_cas_tbl.modifier_setFctAtIndex (inLexique, GGS_string ("tpl_central_interrupt_handler_2"), var_cas_it_id.reader_value (inLexique COMMA_SOURCE_FILE_AT_LINE (74)).reader_uint (inLexique COMMA_SOURCE_FILE_AT_LINE (74)) COMMA_SOURCE_FILE_AT_LINE (74)) ;
                                var_cas_tbl.modifier_setParamAtIndex (inLexique, var_cas_isr_id.add_operation (inLexique, var_cas_isr_base_id COMMA_SOURCE_FILE_AT_LINE (75)).reader_string (inLexique COMMA_SOURCE_FILE_AT_LINE (75)), var_cas_it_id.reader_value (inLexique COMMA_SOURCE_FILE_AT_LINE (75)).reader_uint (inLexique COMMA_SOURCE_FILE_AT_LINE (75)) COMMA_SOURCE_FILE_AT_LINE (75)) ;
                              }else{
                                var_cas_it_id.reader_location (inLexique COMMA_SOURCE_FILE_AT_LINE (77)).reader_location (inLexique COMMA_HERE).signalGGSSemanticError (inLexique, GGS_string ("Internal error, this should be an integer") COMMA_SOURCE_FILE_AT_LINE (78)) ;
                              }
                            }
                          }
                        }else if (cond_2248.isBuiltAndFalse ()) {
                          var_cas_s.reader_location (inLexique COMMA_SOURCE_FILE_AT_LINE (80)).reader_location (inLexique COMMA_HERE).signalGGSSemanticError (inLexique, ((GGS_string ("SOURCE ")).operator_concat (var_cas_s.reader_value (inLexique COMMA_SOURCE_FILE_AT_LINE (80)))).operator_concat (GGS_string (" is not available for the target")) COMMA_SOURCE_FILE_AT_LINE (81)) ;
                        }
                      }else{
                        var_cas_val.reader_location (inLexique COMMA_SOURCE_FILE_AT_LINE (83)).reader_location (inLexique COMMA_HERE).signalGGSSemanticError (inLexique, GGS_string ("SOURCE should be an identifier") COMMA_SOURCE_FILE_AT_LINE (84)) ;
                      }
                    }
                  }
                }else if (cond_2486.isBuiltAndFalse ()) {
                  operand_1426->mKey.reader_location (inLexique COMMA_HERE).signalGGSSemanticError (inLexique, GGS_string ("No SOURCE specified for ISR") COMMA_SOURCE_FILE_AT_LINE (87)) ;
                }
                var_cas_isr_id.mValue ++ ;
              }
            }
            GGS_stringset  var_cas_counter_it_set = GGS_stringset ::constructor_emptySet () ;
            {
              GGS_counter_map::cEnumerator enumerator_2671 (var_cas_cpu.reader_counters (inLexique COMMA_SOURCE_FILE_AT_LINE (91)), true) ;
              const GGS_counter_map::cElement * operand_2671 = NULL ;
              while (((operand_2671 = enumerator_2671.nextObject ()))) {
                macroValidPointer (operand_2671) ;
                GGS_lstring  var_cas_src = operand_2671->mInfo.counter.reader_source (inLexique COMMA_SOURCE_FILE_AT_LINE (92)) ;
                const GGS_bool cond_3232 = (var_cas_src.reader_string (inLexique COMMA_SOURCE_FILE_AT_LINE (93))).operator_isNotEqual (GGS_string ("")) ;
                if (cond_3232.isBuiltAndTrue ()) {
                  GGS_bool var_cas_counter_ok = GGS_bool (true) ;
                  const GGS_bool cond_3115 = gOption_goil_5F_options_autosar_5F_on.value () ;
                  if (cond_3115.isBuiltAndTrue ()) {
                    { const GGS_counter_type _var_3093 = operand_2671->mInfo.counter.reader_type (inLexique COMMA_SOURCE_FILE_AT_LINE (96)) ; // CAST instruction
                      if (_var_3093.getPtr () != NULL) {
                        macroValidPointer (_var_3093.getPtr ()) ;
                        if (typeid (cPtr_software_counter) == typeid (* (_var_3093.getPtr ()))) {
                          operand_2671->mKey.reader_location (inLexique COMMA_HERE).signalGGSSemanticWarning (inLexique, GGS_string ("A SOFTWARE COUNTER should not have an interrupt SOURCE. Ignored") COMMA_SOURCE_FILE_AT_LINE (98)) ;
                          var_cas_counter_ok = GGS_bool (false) ;
                        }else{
                        }
                      }
                    }
                  }
                  const GGS_bool cond_3213 = var_cas_counter_ok ;
                  if (cond_3213.isBuiltAndTrue ()) {
                    var_cas_counter_it_set.addAssign_operation (var_cas_src.reader_string (inLexique COMMA_SOURCE_FILE_AT_LINE (103))) ;
                  }
                }else if (cond_3232.isBuiltAndFalse ()) {
                  const GGS_bool cond_3485 = gOption_goil_5F_options_autosar_5F_on.value () ;
                  if (cond_3485.isBuiltAndTrue ()) {
                    { const GGS_counter_type _var_3462 = operand_2671->mInfo.counter.reader_type (inLexique COMMA_SOURCE_FILE_AT_LINE (107)) ; // CAST instruction
                      if (_var_3462.getPtr () != NULL) {
                        macroValidPointer (_var_3462.getPtr ()) ;
                        if (typeid (cPtr_hardware_counter) == typeid (* (_var_3462.getPtr ()))) {
                          operand_2671->mKey.reader_location (inLexique COMMA_HERE).signalGGSSemanticError (inLexique, (GGS_string ("No SOURCE specified for COUNTER ")).operator_concat (operand_2671->mKey.reader_string (inLexique COMMA_SOURCE_FILE_AT_LINE (109))) COMMA_SOURCE_FILE_AT_LINE (110)) ;
                        }else{
                        }
                      }
                    }
                  }else if (cond_3485.isBuiltAndFalse ()) {
                    operand_2671->mKey.reader_location (inLexique COMMA_HERE).signalGGSSemanticError (inLexique, (GGS_string ("No SOURCE specified for COUNTER ")).operator_concat (operand_2671->mKey.reader_string (inLexique COMMA_SOURCE_FILE_AT_LINE (112))) COMMA_SOURCE_FILE_AT_LINE (113)) ;
                  }
                }
                {
                  GGS_stringset::cEnumerator enumerator_3630 (var_cas_counter_it_set, true) ;
                  while (enumerator_3630.hasCurrentObject ()) {
                    const GGS_bool cond_4167 = var_cas_i.reader_it_sources (inLexique COMMA_SOURCE_FILE_AT_LINE (116)).reader_hasKey (enumerator_3630._key (HERE)) ;
                    if (cond_4167.isBuiltAndTrue ()) {
                      GGS_basic_type  var_cas_it_id ;
                      const GGS_ident_map  temp_3769 = var_cas_i.reader_it_sources (inLexique COMMA_SOURCE_FILE_AT_LINE (118)) ;
                      if (temp_3769.isBuilt ()) {
                        temp_3769 (HERE)->method_get (inLexique, GGS_lstring ::constructor_new (inLexique, enumerator_3630._key (HERE), GGS_location (inLexique) COMMA_HERE), var_cas_it_id COMMA_SOURCE_FILE_AT_LINE (118)) ;
                      }
                      { const GGS_basic_type _var_4145 = var_cas_it_id ; // CAST instruction
                        if (_var_4145.getPtr () != NULL) {
                          macroValidPointer (_var_4145.getPtr ()) ;
                          if (typeid (cPtr_uint64_class) == typeid (* (_var_4145.getPtr ()))) {
                            const GGS_uint64_class var_cas_it_id (_var_4145.getPtr ()) ;
                            var_cas_tbl.modifier_setFctAtIndex (inLexique, (GGS_string ("tpl_tick_")).operator_concat (enumerator_3630._key (HERE)), var_cas_it_id.reader_value (inLexique COMMA_SOURCE_FILE_AT_LINE (121)).reader_uint (inLexique COMMA_SOURCE_FILE_AT_LINE (121)) COMMA_SOURCE_FILE_AT_LINE (121)) ;
                            var_cas_tbl.modifier_setParamAtIndex (inLexique, GGS_string ("NULL"), var_cas_it_id.reader_value (inLexique COMMA_SOURCE_FILE_AT_LINE (122)).reader_uint (inLexique COMMA_SOURCE_FILE_AT_LINE (122)) COMMA_SOURCE_FILE_AT_LINE (122)) ;
                          }else{
                            var_cas_it_id.reader_location (inLexique COMMA_SOURCE_FILE_AT_LINE (124)).reader_location (inLexique COMMA_HERE).signalGGSSemanticError (inLexique, GGS_string ("Internal error, this should be an integer") COMMA_SOURCE_FILE_AT_LINE (125)) ;
                          }
                        }
                      }
                    }
                    enumerator_3630.next () ;
                  }
                }
              }
            }
            const GGS_bool cond_4440 = var_cas_gen_cfg.reader_with_timingprotection (inLexique COMMA_SOURCE_FILE_AT_LINE (130)) ;
            if (cond_4440.isBuiltAndTrue ()) {
              var_cas_tbl.modifier_setFctAtIndex (inLexique, GGS_string ("tpl_watchdog_expiration"), var_cas_it_count.reader_uint (inLexique COMMA_SOURCE_FILE_AT_LINE (131)).substract_operation (inLexique, GGS_uint (1U) COMMA_SOURCE_FILE_AT_LINE (131)) COMMA_SOURCE_FILE_AT_LINE (131)) ;
              var_cas_tbl.modifier_setParamAtIndex (inLexique, GGS_string ("NULL"), var_cas_it_count.reader_uint (inLexique COMMA_SOURCE_FILE_AT_LINE (132)).substract_operation (inLexique, GGS_uint (1U) COMMA_SOURCE_FILE_AT_LINE (132)) COMMA_SOURCE_FILE_AT_LINE (132)) ;
            }
            GGS_string var_cas_its = ((GGS_string ("CONST(tpl_it_vector_entry, OS_CONST) tpl_it_vector[")).operator_concat (var_cas_it_count.reader_string (inLexique COMMA_SOURCE_FILE_AT_LINE (135)))).operator_concat (GGS_string ("] = {\n")) ;
            {
              GGS_it_table::cEnumerator enumerator_4573 (var_cas_tbl, true) ;
              const GGS_it_table::cElement * operand_4573 = enumerator_4573.nextObject () ;
              if ((operand_4573 != NULL)) {
                bool _foreach_loop_4573 ;
                do{
                  macroValidPointer (operand_4573) ;
                  var_cas_its.appendCString ("  { ") ;
                  var_cas_its.dotAssign_operation (operand_4573->fct) ;
                  var_cas_its.appendCString (", (void *)") ;
                  var_cas_its.dotAssign_operation (operand_4573->param) ;
                  var_cas_its.appendCString (" }") ;
                  operand_4573 = enumerator_4573.nextObject () ;
                  _foreach_loop_4573 = ((operand_4573 != NULL)) ;
                  if (_foreach_loop_4573) {
                    var_cas_its.appendCString (",\n") ;
                  }
                }while (_foreach_loop_4573) ;
                var_cas_its.appendCString ("\n") ;
              }
            }
            var_cas_its.appendCString ("};\n") ;
            ::routine_doReplace (inLexique,  var_cas_imp,  GGS_string ("$IT_TABLE$"),  var_cas_its COMMA_SOURCE_FILE_AT_LINE (142)) ;
          }else{
            GGS_location (inLexique).reader_location (inLexique COMMA_HERE).signalGGSSemanticError (inLexique, GGS_string ("No interrupt source id defined for the target") COMMA_SOURCE_FILE_AT_LINE (145)) ;
          }
        }
      }
    }
  }
  #ifdef DEBUG_TRACE_ENABLED
    printf ("LEAVE routine_generate_it_table\n") ;
  #endif
}

//---------------------------------------------------------------------------*

