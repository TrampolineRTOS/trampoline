AUTOSAR XML (schema 4-0-1)
package /Os
  module definition OsImplementation  # Fixes the default Stacksize
    container TASK  # Fixes TASKS' default STACKSIZE
      integer stacksize: default-value=300
    container ISR  # Fixes ISRS' default STACKSIZE
      integer stacksize: default-value=200
package /CPU
  ecuc value collection blink: ecuc-values=config
  module config config: definition=Os
    OsOS: OsPostTaskHook=true, OsPreTaskHook=true, OsStatus=EXTENDED, OsPaint_Stack=true, OsPaint_Registers=true, OsSystem_Call=true
      true (OsBuild):
        OsTrampoline_Base_Path = ../../../../../..
        OsApp_Src = blink.c
        OsApp_Name = blink_exe
        OsCompiler = arm-none-eabi-gcc
        OsAssembler = arm-none-eabi-as
        OsLinker = arm-none-eabi-ld
        OsCopier = arm-none-eabi-objcopy
        OsSystem = PYTHON
      true (OsMemmap): OsCompiler=gcc, OsAssembler=gnu_as, OsMemory_Protection=false
        gnu_ld (OsLinker): OsScript=script.ld
    OsAppMode
    blink_blink (OsAlarm): OsAlarmCounterRef=SystemCounter
      ACTIVATETASK (OsAlarmAction): OsAlarmTaskRef=blink
      true (OsAlarmAutostart): OsAlarmAppModeRef=OsAppMode, OsAlarmAlarmtime=250, OsAlarmCycletime=250
    read_button (OsTask): OsTaskPriority=2, OsTaskActivation=1, OsTaskAutostart=false, OsTaskSchedule=FULL
    blink (OsTask): OsTaskPriority=1, OsTaskActivation=1, OsTaskAutostart=false, OsTaskSchedule=FULL
    isr_button (OsIsr): OsIsrSourceRef=EXTI0_IRQ, OsCounterTicksPerBase=1, OsCounterMaxAllowedValue=65535, OsCounterMinCycle=1
