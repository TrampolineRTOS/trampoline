AUTOSAR XML (schema 4-0-1)
package /Os
  module definition OsImplementation  # Fixes the default Stacksize
    container TASK  # Fixes TASKS' default STACKSIZE
      integer stacksize: default-value=300
    container ISR  # Fixes ISRS' default STACKSIZE
      integer stacksize: default-value=200
package /CPU
  ecuc value collection blink: ecuc-values=config
  module config config: definition=Os
    OsOS: OsPostTaskHook=true, OsPreTaskHook=true, OsStatus=EXTENDED, OsPaint_Stack=true, OsPaint_Registers=true, OsSystem_Call=true
      true (OsBuild):
        OsTrampoline_Base_Path = ../../../../../..
        OsApp_Src = blink.c
        OsApp_Name = blink_exe
        OsCompiler = arm-none-eabi-gcc
        OsAssembler = arm-none-eabi-as
        OsLinker = arm-none-eabi-ld
        OsCopier = arm-none-eabi-objcopy
        OsSystem = PYTHON
      true (OsMemmap): OsCompiler=gcc, OsAssembler=gnu_as, OsMemory_Protection=false
        gnu_ld (OsLinker): OsScript=script.ld
    OsAppMode
    blink_alarm (OsAlarm): OsAlarmCounterRef=SystemCounter
      ACTIVATETASK (OsAlarmAction): OsAlarmTaskRef=blink
      true (OsAlarmAutostart): OsAlarmAppModeRef=OsAppMode, OsAlarmAlarmtime=100, OsAlarmCycletime=100
    blink (OsTask): OsTaskPriority=1, OsTaskActivation=1, OsTaskAutostart=false, OsTaskSchedule=FULL
    isr_timer (OsIsr): OsIsrSource=TIM2_IRQ, OsIsrCategory=2, OsIsrPriority=1
