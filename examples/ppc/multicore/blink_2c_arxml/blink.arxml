AUTOSAR XML (schema 4-0-1)
package /Os
  module definition OsImplementation  # Fixes the default Stacksize
    container TASK  # Fixes TASKS' default STACKSIZE
      integer stacksize: default-value=800
    container ISR  # Fixes ISRS' default STACKSIZE
      integer stacksize: default-value=800
package /CPU
  ecuc value collection blink: ecuc-values=config
  module config config: definition=Os
    OsOS:
      OsNumber_Of_Cores = 2
      OsScalabilityClass = (unset)
      OsStackMonitoring = false
      OsStatus = STANDARD
      OsUseVle = true
      OsUseGetServiceID = false
      OsUseParameterAccess = false
      OsUseResScheduler = true
      OsErrorHook = false
      OsPostTaskHook = false
      OsPreTaskHook = false
      OsProtectionHook = false
      OsShutdownHook = false
      OsStartupHook = false
      OsSystem_Call = true
      OsDebug = true
      true (OsMemmap): OsCompiler=cosmic, OsAssembler=cosmic_as, OsMemory_Protection=false
        cosmic_ld (OsLinker): OsScript=script.lkf
      true (OsBuild):
        OsTrampoline_Base_Path = ../../../..
        OsApp_Src = blink.c
        OsApp_Name = blink_exe
        OsCompiler = ../../tools/cxvle_auto.py
        OsAssembler = ../../tools/cxvle_auto.py
        OsLinker = ../../tools/clnk_auto.py
        OsCopier = undefcop
        OsSystem = PYTHON
    OsAppMode
    application1 (OsApplication): OsApplicationTaskRef=t1_app1, OsApplicationCounterRef=Core0_counter0, OsApplicationAlarmRef=alarm_t1_app1, OsApplicationCore=0
    application2 (OsApplication): OsApplicationTaskRef=t1_app2, OsApplicationCounterRef=Core1_counter0, OsApplicationAlarmRef=alarm_t1_app2, OsApplicationCore=1
    Core0_counter0 (OsCounter): OsCounterSourceRef=pit_ch0, OsCounterTicksPerBase=1, OsCounterMaxAllowedValue=65535, OsCounterMinCycle=1, OsCounterHandler=tick
    Core1_counter0 (OsCounter): OsCounterSourceRef=pit_ch0, OsCounterTicksPerBase=1, OsCounterMaxAllowedValue=65535, OsCounterMinCycle=1, OsCounterHandler=tick
    alarm_t1_app1 (OsAlarm): OsAlarmCounterRef=Core0_counter0
      ACTIVATETASK (OsAlarmAction): OsAlarmTaskRef=t1_app2
      true (OsAlarmAutostart): OsAlarmAppModeRef=OsAppMode, OsAlarmAlarmtime=200, OsAlarmCycletime=100
    alarm_t1_app2 (OsAlarm): OsAlarmCounterRef=Core1_counter0
      ACTIVATETASK (OsAlarmAction): OsAlarmTaskRef=t1_app1
      true (OsAlarmAutostart): OsAlarmAppModeRef=OsAppMode, OsAlarmAlarmtime=200, OsAlarmCycletime=200
    t1_app1 (OsTask): OsTaskAccessing_ApplicationRef=application1, OsTaskActivation=1, OsTaskPriority=5, OsTaskAutostart=FALSE, OsTaskUsefloat=FALSE, OsTaskSchedule=FULL
    t1_app2 (OsTask): OsTaskAccessing_ApplicationRef=application1, OsTaskActivation=1, OsTaskPriority=5, OsTaskAutostart=FALSE, OsTaskUsefloat=FALSE, OsTaskSchedule=FULL
