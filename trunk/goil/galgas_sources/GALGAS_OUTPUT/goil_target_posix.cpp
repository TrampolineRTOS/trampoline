//---------------------------------------------------------------------------*
//                                                                           *
//                       File 'goil_target_posix.cpp'                        *
//                        Generated by version 1.8.3                         *
//                       may 29th, 2009, at 11h49'44"                        *
//                                                                           *
//---------------------------------------------------------------------------*

//--- START OF USER ZONE 1


//--- END OF USER ZONE 1

//---------------------------------------------------------------------------*

#include "version_libpm.h"
#if LIBPM_VERSION != 491
  #error "This file has been compiled with a version of GALGAS different than the version of libpm"
#endif

//---------------------------------------------------------------------------*

#include <typeinfo>
#include "utilities/MF_MemoryControl.h"
#include "files/C_TextFileWrite.h"
#include "goil_target_posix.h"

//---------------------------------------------------------------------------*

#ifndef DO_NOT_GENERATE_CHECKINGS
  #define SOURCE_FILE_AT_LINE(line) "goil_target_posix.ggs", line
  #define COMMA_SOURCE_FILE_AT_LINE(line) , SOURCE_FILE_AT_LINE(line)
#else
  #define SOURCE_FILE_AT_LINE(line) 
  #define COMMA_SOURCE_FILE_AT_LINE(line) 
#endif


//--- START OF USER ZONE 2


//--- END OF USER ZONE 2

//---------------------------------------------------------------------------*
//                                                                           *
//            Implementation of routine "generate_target_posix"              *
//                                                                           *
//---------------------------------------------------------------------------*

void routine_generate_target_posix (C_Compiler & _inLexique,
                                GGS_lstring   var_cas_name,
                                GGS_ident_map   var_cas_others,
                                GGS_oil_obj   var_cas_exe,
                                GGS_string & var_cas_result COMMA_UNUSED_LOCATION_ARGS) {
  #ifdef DEBUG_TRACE_ENABLED
    printf ("ENTER routine_generate_target_posix at %s:%d\n", __FILE__, __LINE__) ;
  #endif
  ::routine_doReplace (_inLexique,  var_cas_result,  GGS_string ("$STACK_ZONE$"),  (var_cas_name.reader_string (_inLexique COMMA_SOURCE_FILE_AT_LINE (15)))._operator_concat (GGS_string ("_stack_zone")) COMMA_SOURCE_FILE_AT_LINE (15)) ;
  ::routine_doReplace (_inLexique,  var_cas_result,  GGS_string ("$STACK$"),  (var_cas_name.reader_string (_inLexique COMMA_SOURCE_FILE_AT_LINE (16)))._operator_concat (GGS_string ("_stack")) COMMA_SOURCE_FILE_AT_LINE (16)) ;
  ::routine_doReplace (_inLexique,  var_cas_result,  GGS_string ("$EXEC_ALL_CONTEXT$"),  (var_cas_name.reader_string (_inLexique COMMA_SOURCE_FILE_AT_LINE (17)))._operator_concat (GGS_string ("_int_context")) COMMA_SOURCE_FILE_AT_LINE (17)) ;
  GGS_uint  var_cas_stack_size ;
  ::routine_additional_int_key_required (_inLexique,  GGS_string ("STACKSIZE"),  var_cas_others,  var_cas_name,  var_cas_stack_size COMMA_SOURCE_FILE_AT_LINE (20)) ;
  ::routine_doReplace (_inLexique,  var_cas_result,  GGS_string ("$STACK_SIZE$"),  var_cas_stack_size.reader_string (_inLexique COMMA_SOURCE_FILE_AT_LINE (21)) COMMA_SOURCE_FILE_AT_LINE (21)) ;
  { const GGS_oil_obj _var_980 = var_cas_exe ; // CAST instruction
    if (_var_980.getPtr () != NULL) {
      macroValidPointer (_var_980.getPtr ()) ;
      if (typeid (cPtr_isr_obj) == typeid (* (_var_980.getPtr ()))) {
        GGS_string var_cas_sig ;
        ::routine_additional_string_key_required (_inLexique,  GGS_string ("SOURCE"),  var_cas_others,  var_cas_name,  var_cas_sig COMMA_SOURCE_FILE_AT_LINE (28)) ;
      }else{
      }
    }
  }
  #ifdef DEBUG_TRACE_ENABLED
    printf ("LEAVE routine_generate_target_posix\n") ;
  #endif
}

//---------------------------------------------------------------------------*
//                                                                           *
//              Implementation of routine "generate_isr_posix"               *
//                                                                           *
//---------------------------------------------------------------------------*

void routine_generate_isr_posix (C_Compiler & _inLexique,
                                const GGS_isr_map   var_cas_isrs,
                                GGS_string & var_cas_code COMMA_UNUSED_LOCATION_ARGS) {
  #ifdef DEBUG_TRACE_ENABLED
    printf ("ENTER routine_generate_isr_posix at %s:%d\n", __FILE__, __LINE__) ;
  #endif
  GGS_string var_cas_result ;
  var_cas_result = GGS_string ("") ;
  GGS_bool var_cas_first ;
  var_cas_first = GGS_bool (true) ;
  GGS_isr_list  var_cas_list_isr ;
  var_cas_list_isr = GGS_isr_list ::constructor_emptySortedList () ;
  if (((GGS_bool (_inLexique.boolOptionValueFromKeys ("goil_options", "posix_it" COMMA_SOURCE_FILE_AT_LINE (41))))._operator_not ()).isBuiltAndTrue ()) {
    {
      GGS_isr_map::cEnumerator enumerator_1238 (var_cas_isrs, true) ;
      const GGS_isr_map::cElement * operand_1238 = NULL ;
      while (((operand_1238 = enumerator_1238.nextObject ()))) {
        macroValidPointer (operand_1238) ;
        var_cas_list_isr._addAssign_operation (operand_1238->mKey, operand_1238->mKey.reader_string (_inLexique COMMA_SOURCE_FILE_AT_LINE (43))) ;
      }
    }
    {
      GGS_isr_list::cEnumerator enumerator_1356 (var_cas_list_isr, true) ;
      const GGS_isr_list::cElement * operand_1356 = NULL ;
      while (((operand_1356 = enumerator_1356.nextObject ()))) {
        macroValidPointer (operand_1356) ;
        GGS_isr_obj  var_cas_isr ;
        const GGS_isr_map  _temp_1417 = var_cas_isrs ;
        if (_temp_1417.isBuilt ()) {
          _temp_1417 (HERE)->method_get (_inLexique, operand_1356->key, var_cas_isr COMMA_SOURCE_FILE_AT_LINE (48)) ;
        }
        if (((var_cas_first)._operator_not ()).isBuiltAndTrue ()) {
          var_cas_result.appendCString (",\n") ;
        }
        var_cas_first = GGS_bool (false) ;
        GGS_string var_cas_key ;
        var_cas_key = GGS_string ("SOURCE") ;
        GGS_ident_map  var_cas_others ;
        var_cas_others = var_cas_isr.reader_other_fields (_inLexique COMMA_SOURCE_FILE_AT_LINE (53)) ;
        if ((var_cas_others.reader_hasKey (_inLexique, var_cas_key COMMA_SOURCE_FILE_AT_LINE (54))).isBuiltAndTrue ()) {
          GGS_basic_type  var_cas_value ;
          const GGS_ident_map  _temp_1682 = var_cas_others ;
          if (_temp_1682.isBuilt ()) {
            _temp_1682 (HERE)->method_get (_inLexique, GGS_lstring ::constructor_new (_inLexique, var_cas_key, GGS_location (_inLexique) COMMA_HERE), var_cas_value COMMA_SOURCE_FILE_AT_LINE (57)) ;
          }
          { const GGS_basic_type _var_1915 = var_cas_value ; // CAST instruction
            if (_var_1915.getPtr () != NULL) {
              macroValidPointer (_var_1915.getPtr ()) ;
              if (typeid (cPtr_string_class) == typeid (* (_var_1915.getPtr ()))) {
                const GGS_string_class var_cas_s (_var_1915.getPtr ()) ;
                var_cas_result = ((var_cas_result)._operator_concat (GGS_string ("\t")))._operator_concat (var_cas_s.reader_value (_inLexique COMMA_SOURCE_FILE_AT_LINE (60))) ;
              }else{
                operand_1356->key.reader_location (_inLexique COMMA_HERE).signalGGSSemanticError (_inLexique, (var_cas_key)._operator_concat (GGS_string (" should be a string")) COMMA_SOURCE_FILE_AT_LINE (63)) ;
              }
            }
          }
        }else{
          operand_1356->key.reader_location (_inLexique COMMA_HERE).signalGGSSemanticError (_inLexique, ((GGS_string ("no "))._operator_concat (var_cas_key))._operator_concat (GGS_string (" specified")) COMMA_SOURCE_FILE_AT_LINE (66)) ;
        }
      }
    }
  }
  var_cas_code = var_cas_code.reader_stringByReplacingStringByString (_inLexique, GGS_string ("$ISR_SIGNAL_LIST$"), var_cas_result COMMA_SOURCE_FILE_AT_LINE (69)) ;
  #ifdef DEBUG_TRACE_ENABLED
    printf ("LEAVE routine_generate_isr_posix\n") ;
  #endif
}

//---------------------------------------------------------------------------*
//                                                                           *
//            Implementation of routine "generate_counter_posix"             *
//                                                                           *
//---------------------------------------------------------------------------*

void routine_generate_counter_posix (C_Compiler & _inLexique,
                                const GGS_counter_map   var_cas_counters,
                                GGS_string & var_cas_code COMMA_UNUSED_LOCATION_ARGS) {
  #ifdef DEBUG_TRACE_ENABLED
    printf ("ENTER routine_generate_counter_posix at %s:%d\n", __FILE__, __LINE__) ;
  #endif
  GGS_string var_cas_result ;
  var_cas_result = GGS_string ("") ;
  {
    GGS_counter_map::cEnumerator enumerator_2242 (var_cas_counters, true) ;
    const GGS_counter_map::cElement * operand_2242 = NULL ;
    while (((operand_2242 = enumerator_2242.nextObject ()))) {
      macroValidPointer (operand_2242) ;
      { const GGS_counter_type _var_2542 = operand_2242->mInfo.counter.reader_type (_inLexique COMMA_SOURCE_FILE_AT_LINE (78)) ; // CAST instruction
        if (_var_2542.getPtr () != NULL) {
          macroValidPointer (_var_2542.getPtr ()) ;
          if (typeid (cPtr_software_counter) == typeid (* (_var_2542.getPtr ()))) {
          }else{
            GGS_string var_cas_tmp ;
            ::routine_retrieveTemplateString (_inLexique,  var_cas_tmp,  GGS_string ("counter_list_specific") COMMA_SOURCE_FILE_AT_LINE (82)) ;
            ::routine_doReplace (_inLexique,  var_cas_tmp,  GGS_string ("$COUNTER$"),  (operand_2242->mKey.reader_string (_inLexique COMMA_SOURCE_FILE_AT_LINE (83)))._operator_concat (GGS_string ("_counter_desc")) COMMA_SOURCE_FILE_AT_LINE (83)) ;
            var_cas_result._dotAssign_operation (var_cas_tmp) ;
          }
        }
      }
    }
  }
  ::routine_doReplace (_inLexique,  var_cas_code,  GGS_string ("$COUNTER_LIST$"),  var_cas_result COMMA_SOURCE_FILE_AT_LINE (88)) ;
  #ifdef DEBUG_TRACE_ENABLED
    printf ("LEAVE routine_generate_counter_posix\n") ;
  #endif
}

//---------------------------------------------------------------------------*

