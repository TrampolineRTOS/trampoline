//---------------------------------------------------------------------------*
//                                                                           *
//                         File 'goil_targets.cpp'                           *
//                        Generated by version 1.9.5                         *
//                     november 23th, 2009, at 12h7'26"                      *
//                                                                           *
//---------------------------------------------------------------------------*

//--- START OF USER ZONE 1


//--- END OF USER ZONE 1

//---------------------------------------------------------------------------*

#include "version_libpm.h"
#if LIBPM_VERSION != 614
  #error "This file has been compiled with a version of GALGAS different than the version of libpm"
#endif

//---------------------------------------------------------------------------*

#include <typeinfo>
#include "utilities/MF_MemoryControl.h"
#include "files/C_TextFileWrite.h"
#include "galgas/C_galgas_CLI_Options.h"
#include "goil_targets.h"

//---------------------------------------------------------------------------*

#ifndef DO_NOT_GENERATE_CHECKINGS
  #define SOURCE_FILE_AT_LINE(line) "goil_targets.ggs", line
  #define COMMA_SOURCE_FILE_AT_LINE(line) , SOURCE_FILE_AT_LINE(line)
#else
  #define SOURCE_FILE_AT_LINE(line) 
  #define COMMA_SOURCE_FILE_AT_LINE(line) 
#endif


//--- START OF USER ZONE 2


//--- END OF USER ZONE 2

//---------------------------------------------------------------------------*
//                                                                           *
//          Implementation of routine "generate_context_and_stack"           *
//                                                                           *
//---------------------------------------------------------------------------*

void routine_generate_context_and_stack (C_Compiler & inLexique,
                                GGS_config   var_cas_cfg,
                                GGS_lstring   var_cas_name,
                                GGS_oil_obj   var_cas_exe,
                                GGS_string & var_cas_result COMMA_UNUSED_LOCATION_ARGS) {
  #ifdef DEBUG_TRACE_ENABLED
    printf ("ENTER routine_generate_context_and_stack at %s:%d\n", __FILE__, __LINE__) ;
  #endif
  GGS_string var_cas_tpl_context_and_stack = GGS_string ("") ;
  GGS_string var_cas_context_and_stack = GGS_string ("") ;
  GGS_ident_map  var_cas_idents = GGS_ident_map ::constructor_emptyMap (inLexique COMMA_HERE) ;
  GGS_attrs  var_cas_attrs = GGS_attrs ::constructor_new (inLexique, GGS_location (inLexique), GGS_cfg_attrs ::constructor_emptyMap (inLexique COMMA_HERE) COMMA_HERE) ;
  GGS_string var_cas_target = function_arch (inLexique COMMA_SOURCE_FILE_AT_LINE (62)) ;
  { const GGS_oil_obj _var_3248 = var_cas_exe ; // CAST instruction
    if (_var_3248.getPtr () != NULL) {
      macroValidPointer (_var_3248.getPtr ()) ;
      if (typeid (cPtr_task_obj) == typeid (* (_var_3248.getPtr ()))) {
        const GGS_task_obj var_cas_tk (_var_3248.getPtr ()) ;
        var_cas_tpl_context_and_stack = function_template_string (inLexique, GGS_string ("code"), GGS_string ("each_task_specific") COMMA_SOURCE_FILE_AT_LINE (66)) ;
        var_cas_context_and_stack = var_cas_tpl_context_and_stack ;
        var_cas_idents = var_cas_tk.reader_others (inLexique COMMA_SOURCE_FILE_AT_LINE (68)) ;
        GGS_basic_type  var_cas_b_attrs ;
        const GGS_config  temp_2527 = var_cas_cfg ;
        if (temp_2527.isBuilt ()) {
          temp_2527 (HERE)->method_get (inLexique, GGS_lstring ::constructor_new (inLexique, GGS_string ("task_attrs"), GGS_location (inLexique) COMMA_HERE), var_cas_b_attrs COMMA_SOURCE_FILE_AT_LINE (70)) ;
        }
        { const GGS_basic_type _var_2727 = var_cas_b_attrs ; // CAST instruction
          if (_var_2727.getPtr () != NULL) {
            macroValidPointer (_var_2727.getPtr ()) ;
            if (typeid (cPtr_attrs) == typeid (* (_var_2727.getPtr ()))) {
              const GGS_attrs var_cas_at (_var_2727.getPtr ()) ;
              var_cas_attrs = var_cas_at ;
            }else{
              GGS_location (inLexique).reader_location (inLexique COMMA_HERE).signalGGSSemanticError (inLexique, GGS_string ("Internal error, unknown config task attributes") COMMA_SOURCE_FILE_AT_LINE (74)) ;
            }
          }
        }
      }else if (typeid (cPtr_isr_obj) == typeid (* (_var_3248.getPtr ()))) {
        const GGS_isr_obj var_cas_isr (_var_3248.getPtr ()) ;
        var_cas_tpl_context_and_stack = function_template_string (inLexique, GGS_string ("code"), GGS_string ("each_isr_specific") COMMA_SOURCE_FILE_AT_LINE (76)) ;
        var_cas_context_and_stack = var_cas_tpl_context_and_stack ;
        var_cas_idents = var_cas_isr.reader_other_fields (inLexique COMMA_SOURCE_FILE_AT_LINE (78)) ;
        GGS_basic_type  var_cas_b_attrs ;
        const GGS_config  temp_2977 = var_cas_cfg ;
        if (temp_2977.isBuilt ()) {
          temp_2977 (HERE)->method_get (inLexique, GGS_lstring ::constructor_new (inLexique, GGS_string ("isr_attrs"), GGS_location (inLexique) COMMA_HERE), var_cas_b_attrs COMMA_SOURCE_FILE_AT_LINE (80)) ;
        }
        { const GGS_basic_type _var_3175 = var_cas_b_attrs ; // CAST instruction
          if (_var_3175.getPtr () != NULL) {
            macroValidPointer (_var_3175.getPtr ()) ;
            if (typeid (cPtr_attrs) == typeid (* (_var_3175.getPtr ()))) {
              const GGS_attrs var_cas_at (_var_3175.getPtr ()) ;
              var_cas_attrs = var_cas_at ;
            }else{
              GGS_location (inLexique).reader_location (inLexique COMMA_HERE).signalGGSSemanticError (inLexique, GGS_string ("Internal error, unknown config isr attributes") COMMA_SOURCE_FILE_AT_LINE (84)) ;
            }
          }
        }
      }else{
        var_cas_name.reader_location (inLexique COMMA_HERE).signalGGSSemanticError (inLexique, GGS_string ("Unknown executable object") COMMA_SOURCE_FILE_AT_LINE (87)) ;
      }
    }
  }
  const GGS_bool cond_3364 = (var_cas_target).operator_isEqual (GGS_string ("c166")) ;
  if (cond_3364.isBuiltAndTrue ()) {
    ::routine_generate_target_c166 (inLexique,  var_cas_name,  var_cas_idents,  var_cas_exe,  var_cas_context_and_stack COMMA_SOURCE_FILE_AT_LINE (90)) ;
  }else if (cond_3364.isBuiltAndFalse ()) {
    const GGS_bool cond_3467 = (var_cas_target).operator_isEqual (GGS_string ("libpcl")) ;
    if (cond_3467.isBuiltAndTrue ()) {
      ::routine_generate_target_libpcl (inLexique,  var_cas_name,  var_cas_idents,  var_cas_exe,  var_cas_context_and_stack COMMA_SOURCE_FILE_AT_LINE (92)) ;
    }else if (cond_3467.isBuiltAndFalse ()) {
      const GGS_bool cond_3568 = (var_cas_target).operator_isEqual (GGS_string ("posix")) ;
      if (cond_3568.isBuiltAndTrue ()) {
        ::routine_generate_target_posix (inLexique,  var_cas_name,  var_cas_idents,  var_cas_exe,  var_cas_context_and_stack COMMA_SOURCE_FILE_AT_LINE (94)) ;
      }else if (cond_3568.isBuiltAndFalse ()) {
        const GGS_bool cond_3677 = (var_cas_target).operator_isEqual (GGS_string ("posix_vp2")) ;
        if (cond_3677.isBuiltAndTrue ()) {
          ::routine_generate_target_posix_vp2 (inLexique,  var_cas_name,  var_cas_idents,  var_cas_exe,  var_cas_context_and_stack COMMA_SOURCE_FILE_AT_LINE (96)) ;
        }else if (cond_3677.isBuiltAndFalse ()) {
          const GGS_bool cond_3779 = (var_cas_target).operator_isEqual (GGS_string ("hcs12")) ;
          if (cond_3779.isBuiltAndTrue ()) {
            ::routine_generate_target_hcs12 (inLexique,  var_cas_name,  var_cas_idents,  var_cas_exe,  var_cas_context_and_stack COMMA_SOURCE_FILE_AT_LINE (98)) ;
          }else if (cond_3779.isBuiltAndFalse ()) {
            const GGS_bool cond_3877 = (var_cas_target).operator_isEqual (GGS_string ("ppc")) ;
            if (cond_3877.isBuiltAndTrue ()) {
              ::routine_generate_target_ppc (inLexique,  var_cas_name,  var_cas_idents,  var_cas_exe,  var_cas_context_and_stack COMMA_SOURCE_FILE_AT_LINE (100)) ;
            }else if (cond_3877.isBuiltAndFalse ()) {
              const GGS_bool cond_3979 = (var_cas_target).operator_isEqual (GGS_string ("v850e")) ;
              if (cond_3979.isBuiltAndTrue ()) {
                ::routine_generate_target_v850e (inLexique,  var_cas_name,  var_cas_idents,  var_cas_exe,  var_cas_context_and_stack COMMA_SOURCE_FILE_AT_LINE (102)) ;
              }else if (cond_3979.isBuiltAndFalse ()) {
                const GGS_bool cond_4083 = (var_cas_target).operator_isEqual (GGS_string ("h8300h")) ;
                if (cond_4083.isBuiltAndTrue ()) {
                  ::routine_generate_target_h8300h (inLexique,  var_cas_name,  var_cas_idents,  var_cas_exe,  var_cas_context_and_stack COMMA_SOURCE_FILE_AT_LINE (104)) ;
                }else if (cond_4083.isBuiltAndFalse ()) {
                  const GGS_bool cond_4182 = (var_cas_target).operator_isEqual (GGS_string ("arm")) ;
                  if (cond_4182.isBuiltAndTrue ()) {
                    ::routine_generate_target_arm7 (inLexique,  var_cas_name,  var_cas_idents,  var_cas_exe,  var_cas_context_and_stack COMMA_SOURCE_FILE_AT_LINE (106)) ;
                  }else if (cond_4182.isBuiltAndFalse ()) {
                    const GGS_bool cond_4279 = (var_cas_target).operator_isEqual (GGS_string ("avr")) ;
                    if (cond_4279.isBuiltAndTrue ()) {
                      ::routine_generate_target_avr (inLexique,  var_cas_name,  var_cas_idents,  var_cas_exe,  var_cas_context_and_stack COMMA_SOURCE_FILE_AT_LINE (108)) ;
                    }else if (cond_4279.isBuiltAndFalse ()) {
                      GGS_location (inLexique).reader_location (inLexique COMMA_HERE).signalGGSSemanticError (inLexique, (GGS_string ("unknown target: ")).operator_concat (var_cas_target) COMMA_SOURCE_FILE_AT_LINE (111)) ;
                    }
                  }
                }
              }
            }
          }
        }
      }
    }
  }
  var_cas_result = (var_cas_result).operator_concat (var_cas_context_and_stack) ;
  #ifdef DEBUG_TRACE_ENABLED
    printf ("LEAVE routine_generate_context_and_stack\n") ;
  #endif
}

//---------------------------------------------------------------------------*
//                                                                           *
//            Implementation of routine "generate_isr_specific"              *
//                                                                           *
//---------------------------------------------------------------------------*

void routine_generate_isr_specific (C_Compiler & inLexique,
                                const GGS_isr_map   var_cas_isrs,
                                GGS_string & var_cas_code COMMA_UNUSED_LOCATION_ARGS) {
  #ifdef DEBUG_TRACE_ENABLED
    printf ("ENTER routine_generate_isr_specific at %s:%d\n", __FILE__, __LINE__) ;
  #endif
  GGS_string var_cas_target = function_arch (inLexique COMMA_SOURCE_FILE_AT_LINE (120)) ;
  var_cas_code = function_template_string (inLexique, GGS_string ("code"), GGS_string ("isr_specific") COMMA_SOURCE_FILE_AT_LINE (122)) ;
  const GGS_bool cond_4652 = (var_cas_target).operator_isEqual (GGS_string ("c166")) ;
  if (cond_4652.isBuiltAndTrue ()) {
    ::routine_generate_isr_c166 (inLexique,  var_cas_isrs,  var_cas_code COMMA_SOURCE_FILE_AT_LINE (125)) ;
  }else if (cond_4652.isBuiltAndFalse ()) {
    const GGS_bool cond_4726 = (var_cas_target).operator_isEqual (GGS_string ("libpcl")) ;
    if (cond_4726.isBuiltAndTrue ()) {
      ::routine_generate_isr_libpcl (inLexique,  var_cas_isrs,  var_cas_code COMMA_SOURCE_FILE_AT_LINE (127)) ;
    }else if (cond_4726.isBuiltAndFalse ()) {
      const GGS_bool cond_4798 = (var_cas_target).operator_isEqual (GGS_string ("posix")) ;
      if (cond_4798.isBuiltAndTrue ()) {
        ::routine_generate_isr_posix (inLexique,  var_cas_isrs,  var_cas_code COMMA_SOURCE_FILE_AT_LINE (129)) ;
      }else if (cond_4798.isBuiltAndFalse ()) {
        const GGS_bool cond_4878 = (var_cas_target).operator_isEqual (GGS_string ("posix_vp2")) ;
        if (cond_4878.isBuiltAndTrue ()) {
          ::routine_generate_isr_posix_vp2 (inLexique,  var_cas_isrs,  var_cas_code COMMA_SOURCE_FILE_AT_LINE (131)) ;
        }else if (cond_4878.isBuiltAndFalse ()) {
          const GGS_bool cond_4951 = (var_cas_target).operator_isEqual (GGS_string ("hcs12")) ;
          if (cond_4951.isBuiltAndTrue ()) {
            ::routine_generate_isr_hcs12 (inLexique,  var_cas_isrs,  var_cas_code COMMA_SOURCE_FILE_AT_LINE (133)) ;
          }else if (cond_4951.isBuiltAndFalse ()) {
            const GGS_bool cond_5020 = (var_cas_target).operator_isEqual (GGS_string ("ppc")) ;
            if (cond_5020.isBuiltAndTrue ()) {
              ::routine_generate_isr_ppc (inLexique,  var_cas_isrs,  var_cas_code COMMA_SOURCE_FILE_AT_LINE (135)) ;
            }else if (cond_5020.isBuiltAndFalse ()) {
              const GGS_bool cond_5093 = (var_cas_target).operator_isEqual (GGS_string ("v850e")) ;
              if (cond_5093.isBuiltAndTrue ()) {
                ::routine_generate_isr_v850e (inLexique,  var_cas_isrs,  var_cas_code COMMA_SOURCE_FILE_AT_LINE (137)) ;
              }else if (cond_5093.isBuiltAndFalse ()) {
                const GGS_bool cond_5168 = (var_cas_target).operator_isEqual (GGS_string ("h8300h")) ;
                if (cond_5168.isBuiltAndTrue ()) {
                  ::routine_generate_isr_h8300h (inLexique,  var_cas_isrs,  var_cas_code COMMA_SOURCE_FILE_AT_LINE (139)) ;
                }else if (cond_5168.isBuiltAndFalse ()) {
                  const GGS_bool cond_5238 = (var_cas_target).operator_isEqual (GGS_string ("arm")) ;
                  if (cond_5238.isBuiltAndTrue ()) {
                    ::routine_generate_isr_arm7 (inLexique,  var_cas_isrs,  var_cas_code COMMA_SOURCE_FILE_AT_LINE (141)) ;
                  }else if (cond_5238.isBuiltAndFalse ()) {
                    const GGS_bool cond_5306 = (var_cas_target).operator_isEqual (GGS_string ("avr")) ;
                    if (cond_5306.isBuiltAndTrue ()) {
                      ::routine_generate_isr_avr (inLexique,  var_cas_isrs,  var_cas_code COMMA_SOURCE_FILE_AT_LINE (143)) ;
                    }else if (cond_5306.isBuiltAndFalse ()) {
                      GGS_location (inLexique).reader_location (inLexique COMMA_HERE).signalGGSSemanticError (inLexique, (GGS_string ("unknown target: ")).operator_concat (var_cas_target) COMMA_SOURCE_FILE_AT_LINE (146)) ;
                    }
                  }
                }
              }
            }
          }
        }
      }
    }
  }
  #ifdef DEBUG_TRACE_ENABLED
    printf ("LEAVE routine_generate_isr_specific\n") ;
  #endif
}

//---------------------------------------------------------------------------*
//                                                                           *
//         Implementation of routine "generate_counter_for_target"           *
//                                                                           *
//---------------------------------------------------------------------------*

void routine_generate_counter_for_target (C_Compiler & inLexique,
                                const GGS_string  var_cas_target,
                                const GGS_counter_map   var_cas_counters,
                                GGS_string & var_cas_code COMMA_UNUSED_LOCATION_ARGS) {
  #ifdef DEBUG_TRACE_ENABLED
    printf ("ENTER routine_generate_counter_for_target at %s:%d\n", __FILE__, __LINE__) ;
  #endif
  const GGS_bool cond_5568 = (var_cas_target).operator_isEqual (GGS_string ("c166")) ;
  if (cond_5568.isBuiltAndTrue ()) {
    ::routine_generate_counter_c166 (inLexique,  var_cas_counters,  var_cas_code COMMA_SOURCE_FILE_AT_LINE (155)) ;
  }else if (cond_5568.isBuiltAndFalse ()) {
    const GGS_bool cond_5646 = (var_cas_target).operator_isEqual (GGS_string ("libpcl")) ;
    if (cond_5646.isBuiltAndTrue ()) {
      ::routine_generate_counter_libpcl (inLexique,  var_cas_counters,  var_cas_code COMMA_SOURCE_FILE_AT_LINE (157)) ;
    }else if (cond_5646.isBuiltAndFalse ()) {
      const GGS_bool cond_5721 = (var_cas_target).operator_isEqual (GGS_string ("posix")) ;
      if (cond_5721.isBuiltAndTrue ()) {
        ::routine_generate_counter_posix (inLexique,  var_cas_counters,  var_cas_code COMMA_SOURCE_FILE_AT_LINE (159)) ;
      }else if (cond_5721.isBuiltAndFalse ()) {
        const GGS_bool cond_5802 = (var_cas_target).operator_isEqual (GGS_string ("posix_vp2")) ;
        if (cond_5802.isBuiltAndTrue ()) {
          ::routine_generate_counter_posix_vp2 (inLexique,  var_cas_counters,  var_cas_code COMMA_SOURCE_FILE_AT_LINE (161)) ;
        }else if (cond_5802.isBuiltAndFalse ()) {
          const GGS_bool cond_5878 = (var_cas_target).operator_isEqual (GGS_string ("hcs12")) ;
          if (cond_5878.isBuiltAndTrue ()) {
            ::routine_generate_counter_hcs12 (inLexique,  var_cas_counters,  var_cas_code COMMA_SOURCE_FILE_AT_LINE (163)) ;
          }else if (cond_5878.isBuiltAndFalse ()) {
            const GGS_bool cond_5950 = (var_cas_target).operator_isEqual (GGS_string ("ppc")) ;
            if (cond_5950.isBuiltAndTrue ()) {
              ::routine_generate_counter_ppc (inLexique,  var_cas_counters,  var_cas_code COMMA_SOURCE_FILE_AT_LINE (165)) ;
            }else if (cond_5950.isBuiltAndFalse ()) {
              const GGS_bool cond_6026 = (var_cas_target).operator_isEqual (GGS_string ("v850e")) ;
              if (cond_6026.isBuiltAndTrue ()) {
                ::routine_generate_counter_v850e (inLexique,  var_cas_counters,  var_cas_code COMMA_SOURCE_FILE_AT_LINE (167)) ;
              }else if (cond_6026.isBuiltAndFalse ()) {
                const GGS_bool cond_6104 = (var_cas_target).operator_isEqual (GGS_string ("h8300h")) ;
                if (cond_6104.isBuiltAndTrue ()) {
                  ::routine_generate_counter_h8300h (inLexique,  var_cas_counters,  var_cas_code COMMA_SOURCE_FILE_AT_LINE (169)) ;
                }else if (cond_6104.isBuiltAndFalse ()) {
                  const GGS_bool cond_6177 = (var_cas_target).operator_isEqual (GGS_string ("arm")) ;
                  if (cond_6177.isBuiltAndTrue ()) {
                    ::routine_generate_counter_arm7 (inLexique,  var_cas_counters,  var_cas_code COMMA_SOURCE_FILE_AT_LINE (171)) ;
                  }else if (cond_6177.isBuiltAndFalse ()) {
                    const GGS_bool cond_6248 = (var_cas_target).operator_isEqual (GGS_string ("avr")) ;
                    if (cond_6248.isBuiltAndTrue ()) {
                      ::routine_generate_counter_avr (inLexique,  var_cas_counters,  var_cas_code COMMA_SOURCE_FILE_AT_LINE (173)) ;
                    }else if (cond_6248.isBuiltAndFalse ()) {
                      GGS_location (inLexique).reader_location (inLexique COMMA_HERE).signalGGSSemanticError (inLexique, (GGS_string ("unknown target: ")).operator_concat (var_cas_target) COMMA_SOURCE_FILE_AT_LINE (176)) ;
                    }
                  }
                }
              }
            }
          }
        }
      }
    }
  }
  #ifdef DEBUG_TRACE_ENABLED
    printf ("LEAVE routine_generate_counter_for_target\n") ;
  #endif
}

//---------------------------------------------------------------------------*
//                                                                           *
//          Implementation of routine "generate_counter_specific"            *
//                                                                           *
//---------------------------------------------------------------------------*

void routine_generate_counter_specific (C_Compiler & inLexique,
                                const GGS_counter_map   var_cas_counters,
                                GGS_string & var_cas_code COMMA_UNUSED_LOCATION_ARGS) {
  #ifdef DEBUG_TRACE_ENABLED
    printf ("ENTER routine_generate_counter_specific at %s:%d\n", __FILE__, __LINE__) ;
  #endif
  GGS_string var_cas_target = function_arch (inLexique COMMA_SOURCE_FILE_AT_LINE (184)) ;
  const GGS_bool cond_7588 = gOption_goil_5F_options_posix_5F_it.value () ;
  if (cond_7588.isBuiltAndTrue ()) {
    GGS_counter_by_source  var_cas_cbs = GGS_counter_by_source ::constructor_emptySortedList () ;
    {
      GGS_counter_map::cEnumerator enumerator_6540 (var_cas_counters, true) ;
      const GGS_counter_map::cElement * operand_6540 = NULL ;
      while (((operand_6540 = enumerator_6540.nextObject ()))) {
        macroValidPointer (operand_6540) ;
        var_cas_cbs.addAssign_operation (operand_6540->mInfo.counter.reader_source (inLexique COMMA_SOURCE_FILE_AT_LINE (189)).reader_string (inLexique COMMA_SOURCE_FILE_AT_LINE (189)), operand_6540->mKey, operand_6540->mInfo.counter) ;
      }
    }
    GGS_string var_cas_prev_src = GGS_string ("") ;
    GGS_counter_map  var_cas_cnt_set = GGS_counter_map ::constructor_emptyMap (inLexique COMMA_HERE) ;
    var_cas_code = GGS_string ("") ;
    {
      GGS_counter_by_source::cEnumerator enumerator_6712 (var_cas_cbs, true) ;
      const GGS_counter_by_source::cElement * operand_6712 = NULL ;
      while (((operand_6712 = enumerator_6712.nextObject ()))) {
        macroValidPointer (operand_6712) ;
        const GGS_bool cond_7164 = (operand_6712->source).operator_isNotEqual (var_cas_prev_src) ;
        if (cond_7164.isBuiltAndTrue ()) {
          const GGS_bool cond_7150 = (var_cas_cnt_set.reader_count ()).operator_strictSup (GGS_uint (0U)) ;
          if (cond_7150.isBuiltAndTrue ()) {
            GGS_string var_cas_cnt_set_code = function_template_string (inLexique, GGS_string ("code"), GGS_string ("counter_specific") COMMA_SOURCE_FILE_AT_LINE (197)) ;
            ::routine_doReplace (inLexique,  var_cas_cnt_set_code,  GGS_string ("$TICK_FUNC$"),  GGS_string ("tpl_tick_") COMMA_SOURCE_FILE_AT_LINE (198)) ;
            ::routine_doReplace (inLexique,  var_cas_cnt_set_code,  GGS_string ("$IT_SOURCE$"),  var_cas_prev_src COMMA_SOURCE_FILE_AT_LINE (199)) ;
            ::routine_generate_counter_for_target (inLexique,  var_cas_target,  var_cas_cnt_set,  var_cas_cnt_set_code COMMA_SOURCE_FILE_AT_LINE (200)) ;
            var_cas_code.dotAssign_operation (var_cas_cnt_set_code) ;
            var_cas_cnt_set = GGS_counter_map ::constructor_emptyMap (inLexique COMMA_HERE) ;
          }
        }
        var_cas_cnt_set.modifier_put (inLexique, operand_6712->name, operand_6712->counter COMMA_SOURCE_FILE_AT_LINE (205)) ;
        var_cas_prev_src = operand_6712->source ;
      }
    }
    const GGS_bool cond_7577 = (var_cas_cnt_set.reader_count ()).operator_strictSup (GGS_uint (0U)) ;
    if (cond_7577.isBuiltAndTrue ()) {
      GGS_string var_cas_cnt_set_code = function_template_string (inLexique, GGS_string ("code"), GGS_string ("counter_specific") COMMA_SOURCE_FILE_AT_LINE (209)) ;
      ::routine_doReplace (inLexique,  var_cas_cnt_set_code,  GGS_string ("$TICK_FUNC$"),  GGS_string ("tpl_tick_") COMMA_SOURCE_FILE_AT_LINE (210)) ;
      ::routine_doReplace (inLexique,  var_cas_cnt_set_code,  GGS_string ("$IT_SOURCE$"),  var_cas_prev_src COMMA_SOURCE_FILE_AT_LINE (211)) ;
      ::routine_generate_counter_for_target (inLexique,  var_cas_target,  var_cas_cnt_set,  var_cas_cnt_set_code COMMA_SOURCE_FILE_AT_LINE (212)) ;
      var_cas_code.dotAssign_operation (var_cas_cnt_set_code) ;
    }
  }else if (cond_7588.isBuiltAndFalse ()) {
    var_cas_code = function_template_string (inLexique, GGS_string ("code"), GGS_string ("counter_specific") COMMA_SOURCE_FILE_AT_LINE (216)) ;
    ::routine_doReplace (inLexique,  var_cas_code,  GGS_string ("$TICK_FUNC$"),  GGS_string ("tpl_call_counter_tick") COMMA_SOURCE_FILE_AT_LINE (217)) ;
    ::routine_doReplace (inLexique,  var_cas_code,  GGS_string ("$IT_SOURCE$"),  GGS_string ("") COMMA_SOURCE_FILE_AT_LINE (218)) ;
    ::routine_generate_counter_for_target (inLexique,  var_cas_target,  var_cas_counters,  var_cas_code COMMA_SOURCE_FILE_AT_LINE (219)) ;
  }
  #ifdef DEBUG_TRACE_ENABLED
    printf ("LEAVE routine_generate_counter_specific\n") ;
  #endif
}

//---------------------------------------------------------------------------*

