//---------------------------------------------------------------------------*
//                                                                           *
//                        File 'goil_types_app.cpp'                          *
//                       Generated by version 1.9.10                         *
//                      april 9th, 2010, at 10h17'47"                        *
//                                                                           *
//---------------------------------------------------------------------------*

//--- START OF USER ZONE 1


//--- END OF USER ZONE 1

//---------------------------------------------------------------------------*

#include "version_libpm.h"
#if LIBPM_VERSION != 688
  #error "This file has been compiled with a version of GALGAS different than the version of libpm"
#endif

//---------------------------------------------------------------------------*

#include <typeinfo>
#include "utilities/MF_MemoryControl.h"
#include "files/C_TextFileWrite.h"
#include "galgas/C_galgas_CLI_Options.h"
#include "goil_types_app.h"

//---------------------------------------------------------------------------*

#ifndef DO_NOT_GENERATE_CHECKINGS
  #define SOURCE_FILE_AT_LINE(line) "goil_types_app.ggs", line
  #define COMMA_SOURCE_FILE_AT_LINE(line) , SOURCE_FILE_AT_LINE(line)
#else
  #define SOURCE_FILE_AT_LINE(line) 
  #define COMMA_SOURCE_FILE_AT_LINE(line) 
#endif


//--- START OF USER ZONE 2


//--- END OF USER ZONE 2

//---------------------------------------------------------------------------*
//                                                                           *
//                       class 'cPtr_app_trusted_obj'                        *
//                                                                           *
//---------------------------------------------------------------------------*

cPtr_app_trusted_obj::
cPtr_app_trusted_obj (const GGS_location & argument_0
                                COMMA_LOCATION_ARGS)
:cPtr__AC_galgas_class (THERE),
location (argument_0) {
}

//---------------------------------------------------------------------------*

#ifndef DO_NOT_GENERATE_CHECKINGS
  cPtr_app_trusted_obj * GGS_app_trusted_obj::
  operator () (LOCATION_ARGS) const {
    macroValidObjectThere (mPointer, cPtr_app_trusted_obj) ;
    return (cPtr_app_trusted_obj *) mPointer ;
  }
#endif

//---------------------------------------------------------------------------*

void cPtr_app_trusted_obj::
appendForDescription (C_String & ioString,
                      const PMSInt32 inIndentation) const {
  ioString << "->@app_trusted_obj:"
           << location.reader_description (inIndentation + 1) ;
}

//---------------------------------------------------------------------------*
//                                                                           *
//                              Class message                                *
//                                                                           *
//---------------------------------------------------------------------------*

const char * cPtr_app_trusted_obj::
instanceMessage (void) const {
  return "" ;
}

//---------------------------------------------------------------------------*

const char * cPtr_app_trusted_obj::
_static_message (void) {
  return "" ;
}

//---------------------------------------------------------------------------*

C_galgas_class_inspector _gInspectorFor_app_trusted_obj (& typeid (cPtr_app_trusted_obj), NULL, "") ;

//---------------------------------------------------------------------------*

AC_galgasClassRunTimeInformationEX * cPtr_app_trusted_obj::galgasRTTI (void) const {
  return & gClassInfoFor__app_trusted_obj ;
}

//---------------------------------------------------------------------------*
//                                                                           *
//                    GALGAS class 'GGS_app_trusted_obj'                     *
//                                                                           *
//---------------------------------------------------------------------------*

const C_galgas_type_descriptorEX kTypeDescriptor_GGS_app_trusted_obj ("app_trusted_obj", true, NULL) ;

//---------------------------------------------------------------------------*

GGS_app_trusted_obj::
GGS_app_trusted_obj (const cPtr__AC_galgas_class * inPointer) {
  macroAssignObject (mPointer, (cPtr__AC_galgas_class *) inPointer) ;
}

//---------------------------------------------------------------------------*

GGS_app_trusted_obj::
GGS_app_trusted_obj (cPtr__AC_galgas_class & inObject) {
  macroAssignObject (mPointer, & inObject) ;
}

//---------------------------------------------------------------------------*

//--- castFrom class method (implements cast expression)
GGS_app_trusted_obj GGS_app_trusted_obj::
castFrom (C_Compiler & inLexique,
           cPtr__AC_galgas_class * inPointer,
           const bool inUseKindOfClass,
           const GGS_location & inErrorLocation
           COMMA_LOCATION_ARGS) {
  GGS_app_trusted_obj result ;
  if (inPointer != NULL) {
    macroValidPointer (inPointer) ;
    const bool ok = inUseKindOfClass
      ? (dynamic_cast <cPtr_app_trusted_obj *> (inPointer) != NULL)
      : (typeid (cPtr_app_trusted_obj) == typeid (*inPointer)) ;
    if (ok) {
      result = GGS_app_trusted_obj (inPointer) ;
    }else{
      inErrorLocation.signalCastError (inLexique,
                                       & typeid (cPtr_app_trusted_obj),
                                       inUseKindOfClass,
                                       inPointer->instanceMessage ()
                                       COMMA_THERE) ;
    }
  }
  return result ;
}

//---------------------------------------------------------------------------*

GGS_location  GGS_app_trusted_obj::
reader_location (C_Compiler & /* inLexique */ COMMA_UNUSED_LOCATION_ARGS) const {
  GGS_location   result ;
  if (mPointer != NULL) {
    macroValidPointer (mPointer) ;
    MF_Assert (dynamic_cast <cPtr_app_trusted_obj *> (mPointer) != NULL,
               "dynamic cast error", 0, 0) ;
    result = ((cPtr_app_trusted_obj *) mPointer)->location ;
  }
  return result ;
}

//---------------------------------------------------------------------------*

const char * GGS_app_trusted_obj::actualTypeName (void) const {
  return "app_trusted_obj" ;
}

//---------------------------------------------------------------------------*

AC_galgasClassRunTimeInformationEX * GGS_app_trusted_obj::galgasObjectRunTimeInfo (void) const {
  AC_galgasClassRunTimeInformationEX * result = NULL ;
  if (mPointer != NULL) {
    result = mPointer->galgasRTTI () ;
  }
  return result ;
}

//---------------------------------------------------------------------------*

C_galgasRootClassRunTimeInformationEX gClassInfoFor__app_trusted_obj ("app_trusted_obj", & kTypeDescriptor_GGS_app_trusted_obj) ;

//---------------------------------------------------------------------------*

GGS_object GGS_app_trusted_obj::reader_object (void) const {
  GGS_object result ;
  if (isBuilt ()) {
    GGS_app_trusted_obj * p = NULL ;
    macroMyNew (p, GGS_app_trusted_obj (*this)) ;
    result = GGS_object (p) ;
  }
  return result ;
}

//---------------------------------------------------------------------------*

GGS_app_trusted_obj GGS_app_trusted_obj::castFromObject (C_Compiler & inLexique,
                                   const GGS_object & inObject,
                                   const GGS_location & inErrorLocation
                                   COMMA_LOCATION_ARGS) {
  GGS_app_trusted_obj result ;
  const GGS__root * embeddedObject = inObject.embeddedObject () ;
  if (NULL != embeddedObject) {
    const GGS_app_trusted_obj * p = dynamic_cast <const GGS_app_trusted_obj *> (embeddedObject) ;
    if (NULL != p) {
      result = * p ;
    }else{
      castFromObjectErrorSignaling (inLexique, inErrorLocation, & kTypeDescriptor_GGS_app_trusted_obj, embeddedObject COMMA_THERE) ;
    }
  }
  return result ;
}

//---------------------------------------------------------------------------*

const C_galgas_type_descriptorEX * GGS_app_trusted_obj::typeDescriptor (void) const {
  return & kTypeDescriptor_GGS_app_trusted_obj ;
}

//---------------------------------------------------------------------------*
//                                                                           *
//                      class 'cPtr_app_trusted_void'                        *
//                                                                           *
//---------------------------------------------------------------------------*

cPtr_app_trusted_void::
cPtr_app_trusted_void (const GGS_location & argument_0
                                COMMA_LOCATION_ARGS)
:cPtr_app_trusted_obj (argument_0 COMMA_THERE) {
}

//---------------------------------------------------------------------------*

#ifndef DO_NOT_GENERATE_CHECKINGS
  cPtr_app_trusted_void * GGS_app_trusted_void::
  operator () (LOCATION_ARGS) const {
    macroValidObjectThere (mPointer, cPtr_app_trusted_void) ;
    return (cPtr_app_trusted_void *) mPointer ;
  }
#endif

//---------------------------------------------------------------------------*

bool cPtr_app_trusted_void::
isEqualToObject (const cPtr__AC_galgas_class * inOperand) const {
  bool equal = typeid (this) == typeid (inOperand) ;
  if (equal) {
    const cPtr_app_trusted_void * ptr = dynamic_cast <const cPtr_app_trusted_void *> (inOperand) ;
    macroValidPointer (ptr) ;
    equal = location.operator_isEqual (ptr->location).boolValue () ;
  }
  return equal ;
}

//---------------------------------------------------------------------------*

void cPtr_app_trusted_void::
appendForDescription (C_String & ioString,
                      const PMSInt32 inIndentation) const {
  ioString << "->@app_trusted_void:"
           << location.reader_description (inIndentation + 1) ;
}

//---------------------------------------------------------------------------*
//                                                                           *
//                              Class message                                *
//                                                                           *
//---------------------------------------------------------------------------*

const char * cPtr_app_trusted_void::
instanceMessage (void) const {
  return "" ;
}

//---------------------------------------------------------------------------*

const char * cPtr_app_trusted_void::
_static_message (void) {
  return "" ;
}

//---------------------------------------------------------------------------*

C_galgas_class_inspector _gInspectorFor_app_trusted_void (& typeid (cPtr_app_trusted_void), & typeid (cPtr_app_trusted_obj), "") ;

//---------------------------------------------------------------------------*

AC_galgasClassRunTimeInformationEX * cPtr_app_trusted_void::galgasRTTI (void) const {
  return & gClassInfoFor__app_trusted_void ;
}

//---------------------------------------------------------------------------*

cPtr__AC_galgas_class * cPtr_app_trusted_void::makeClone (void) const {
  cPtr__AC_galgas_class * result = NULL ;
  macroMyNew (result, cPtr_app_trusted_void (location COMMA_HERE)) ;
  return result ;
}

//---------------------------------------------------------------------------*
//                                                                           *
//                   GALGAS class 'GGS_app_trusted_void'                     *
//                                                                           *
//---------------------------------------------------------------------------*

const C_galgas_type_descriptorEX kTypeDescriptor_GGS_app_trusted_void ("app_trusted_void", true, & kTypeDescriptor_GGS_app_trusted_obj) ;

//---------------------------------------------------------------------------*

GGS_app_trusted_void::
GGS_app_trusted_void (const cPtr__AC_galgas_class * inPointer) {
  macroAssignObject (mPointer, (cPtr__AC_galgas_class *) inPointer) ;
}

//---------------------------------------------------------------------------*

GGS_app_trusted_void::
GGS_app_trusted_void (cPtr__AC_galgas_class & inObject) {
  macroAssignObject (mPointer, & inObject) ;
}

//---------------------------------------------------------------------------*

//--- castFrom class method (implements cast expression)
GGS_app_trusted_void GGS_app_trusted_void::
castFrom (C_Compiler & inLexique,
           cPtr__AC_galgas_class * inPointer,
           const bool inUseKindOfClass,
           const GGS_location & inErrorLocation
           COMMA_LOCATION_ARGS) {
  GGS_app_trusted_void result ;
  if (inPointer != NULL) {
    macroValidPointer (inPointer) ;
    const bool ok = inUseKindOfClass
      ? (dynamic_cast <cPtr_app_trusted_void *> (inPointer) != NULL)
      : (typeid (cPtr_app_trusted_void) == typeid (*inPointer)) ;
    if (ok) {
      result = GGS_app_trusted_void (inPointer) ;
    }else{
      inErrorLocation.signalCastError (inLexique,
                                       & typeid (cPtr_app_trusted_void),
                                       inUseKindOfClass,
                                       inPointer->instanceMessage ()
                                       COMMA_THERE) ;
    }
  }
  return result ;
}

//---------------------------------------------------------------------------*

GGS_app_trusted_void GGS_app_trusted_void::
constructor_new (C_Compiler & /* inLexique */,
                 const GGS_location & argument_0
                                COMMA_LOCATION_ARGS) {
  GGS_app_trusted_void result ;
  macroMyNew (result.mPointer, cPtr_app_trusted_void (argument_0 COMMA_THERE)) ;
  macroRetainObject (result.mPointer) ;
  return result ;
}

//---------------------------------------------------------------------------*

const char * GGS_app_trusted_void::actualTypeName (void) const {
  return "app_trusted_void" ;
}

//---------------------------------------------------------------------------*

C_galgasClassRunTimeInformationEX gClassInfoFor__app_trusted_void ("app_trusted_void", gClassInfoFor__app_trusted_obj, & kTypeDescriptor_GGS_app_trusted_void) ;

//---------------------------------------------------------------------------*

GGS_object GGS_app_trusted_void::reader_object (void) const {
  GGS_object result ;
  if (isBuilt ()) {
    GGS_app_trusted_void * p = NULL ;
    macroMyNew (p, GGS_app_trusted_void (*this)) ;
    result = GGS_object (p) ;
  }
  return result ;
}

//---------------------------------------------------------------------------*

GGS_app_trusted_void GGS_app_trusted_void::castFromObject (C_Compiler & inLexique,
                                   const GGS_object & inObject,
                                   const GGS_location & inErrorLocation
                                   COMMA_LOCATION_ARGS) {
  GGS_app_trusted_void result ;
  const GGS__root * embeddedObject = inObject.embeddedObject () ;
  if (NULL != embeddedObject) {
    const GGS_app_trusted_void * p = dynamic_cast <const GGS_app_trusted_void *> (embeddedObject) ;
    if (NULL != p) {
      result = * p ;
    }else{
      castFromObjectErrorSignaling (inLexique, inErrorLocation, & kTypeDescriptor_GGS_app_trusted_void, embeddedObject COMMA_THERE) ;
    }
  }
  return result ;
}

//---------------------------------------------------------------------------*

const C_galgas_type_descriptorEX * GGS_app_trusted_void::typeDescriptor (void) const {
  return & kTypeDescriptor_GGS_app_trusted_void ;
}

//---------------------------------------------------------------------------*
//                                                                           *
//                      class 'cPtr_app_trusted_false'                       *
//                                                                           *
//---------------------------------------------------------------------------*

cPtr_app_trusted_false::
cPtr_app_trusted_false (const GGS_location & argument_0
                                COMMA_LOCATION_ARGS)
:cPtr_app_trusted_obj (argument_0 COMMA_THERE) {
}

//---------------------------------------------------------------------------*

#ifndef DO_NOT_GENERATE_CHECKINGS
  cPtr_app_trusted_false * GGS_app_trusted_false::
  operator () (LOCATION_ARGS) const {
    macroValidObjectThere (mPointer, cPtr_app_trusted_false) ;
    return (cPtr_app_trusted_false *) mPointer ;
  }
#endif

//---------------------------------------------------------------------------*

bool cPtr_app_trusted_false::
isEqualToObject (const cPtr__AC_galgas_class * inOperand) const {
  bool equal = typeid (this) == typeid (inOperand) ;
  if (equal) {
    const cPtr_app_trusted_false * ptr = dynamic_cast <const cPtr_app_trusted_false *> (inOperand) ;
    macroValidPointer (ptr) ;
    equal = location.operator_isEqual (ptr->location).boolValue () ;
  }
  return equal ;
}

//---------------------------------------------------------------------------*

void cPtr_app_trusted_false::
appendForDescription (C_String & ioString,
                      const PMSInt32 inIndentation) const {
  ioString << "->@app_trusted_false:"
           << location.reader_description (inIndentation + 1) ;
}

//---------------------------------------------------------------------------*
//                                                                           *
//                              Class message                                *
//                                                                           *
//---------------------------------------------------------------------------*

const char * cPtr_app_trusted_false::
instanceMessage (void) const {
  return "" ;
}

//---------------------------------------------------------------------------*

const char * cPtr_app_trusted_false::
_static_message (void) {
  return "" ;
}

//---------------------------------------------------------------------------*

C_galgas_class_inspector _gInspectorFor_app_trusted_false (& typeid (cPtr_app_trusted_false), & typeid (cPtr_app_trusted_obj), "") ;

//---------------------------------------------------------------------------*

AC_galgasClassRunTimeInformationEX * cPtr_app_trusted_false::galgasRTTI (void) const {
  return & gClassInfoFor__app_trusted_false ;
}

//---------------------------------------------------------------------------*

cPtr__AC_galgas_class * cPtr_app_trusted_false::makeClone (void) const {
  cPtr__AC_galgas_class * result = NULL ;
  macroMyNew (result, cPtr_app_trusted_false (location COMMA_HERE)) ;
  return result ;
}

//---------------------------------------------------------------------------*
//                                                                           *
//                   GALGAS class 'GGS_app_trusted_false'                    *
//                                                                           *
//---------------------------------------------------------------------------*

const C_galgas_type_descriptorEX kTypeDescriptor_GGS_app_trusted_false ("app_trusted_false", true, & kTypeDescriptor_GGS_app_trusted_obj) ;

//---------------------------------------------------------------------------*

GGS_app_trusted_false::
GGS_app_trusted_false (const cPtr__AC_galgas_class * inPointer) {
  macroAssignObject (mPointer, (cPtr__AC_galgas_class *) inPointer) ;
}

//---------------------------------------------------------------------------*

GGS_app_trusted_false::
GGS_app_trusted_false (cPtr__AC_galgas_class & inObject) {
  macroAssignObject (mPointer, & inObject) ;
}

//---------------------------------------------------------------------------*

//--- castFrom class method (implements cast expression)
GGS_app_trusted_false GGS_app_trusted_false::
castFrom (C_Compiler & inLexique,
           cPtr__AC_galgas_class * inPointer,
           const bool inUseKindOfClass,
           const GGS_location & inErrorLocation
           COMMA_LOCATION_ARGS) {
  GGS_app_trusted_false result ;
  if (inPointer != NULL) {
    macroValidPointer (inPointer) ;
    const bool ok = inUseKindOfClass
      ? (dynamic_cast <cPtr_app_trusted_false *> (inPointer) != NULL)
      : (typeid (cPtr_app_trusted_false) == typeid (*inPointer)) ;
    if (ok) {
      result = GGS_app_trusted_false (inPointer) ;
    }else{
      inErrorLocation.signalCastError (inLexique,
                                       & typeid (cPtr_app_trusted_false),
                                       inUseKindOfClass,
                                       inPointer->instanceMessage ()
                                       COMMA_THERE) ;
    }
  }
  return result ;
}

//---------------------------------------------------------------------------*

GGS_app_trusted_false GGS_app_trusted_false::
constructor_new (C_Compiler & /* inLexique */,
                 const GGS_location & argument_0
                                COMMA_LOCATION_ARGS) {
  GGS_app_trusted_false result ;
  macroMyNew (result.mPointer, cPtr_app_trusted_false (argument_0 COMMA_THERE)) ;
  macroRetainObject (result.mPointer) ;
  return result ;
}

//---------------------------------------------------------------------------*

const char * GGS_app_trusted_false::actualTypeName (void) const {
  return "app_trusted_false" ;
}

//---------------------------------------------------------------------------*

C_galgasClassRunTimeInformationEX gClassInfoFor__app_trusted_false ("app_trusted_false", gClassInfoFor__app_trusted_obj, & kTypeDescriptor_GGS_app_trusted_false) ;

//---------------------------------------------------------------------------*

GGS_object GGS_app_trusted_false::reader_object (void) const {
  GGS_object result ;
  if (isBuilt ()) {
    GGS_app_trusted_false * p = NULL ;
    macroMyNew (p, GGS_app_trusted_false (*this)) ;
    result = GGS_object (p) ;
  }
  return result ;
}

//---------------------------------------------------------------------------*

GGS_app_trusted_false GGS_app_trusted_false::castFromObject (C_Compiler & inLexique,
                                   const GGS_object & inObject,
                                   const GGS_location & inErrorLocation
                                   COMMA_LOCATION_ARGS) {
  GGS_app_trusted_false result ;
  const GGS__root * embeddedObject = inObject.embeddedObject () ;
  if (NULL != embeddedObject) {
    const GGS_app_trusted_false * p = dynamic_cast <const GGS_app_trusted_false *> (embeddedObject) ;
    if (NULL != p) {
      result = * p ;
    }else{
      castFromObjectErrorSignaling (inLexique, inErrorLocation, & kTypeDescriptor_GGS_app_trusted_false, embeddedObject COMMA_THERE) ;
    }
  }
  return result ;
}

//---------------------------------------------------------------------------*

const C_galgas_type_descriptorEX * GGS_app_trusted_false::typeDescriptor (void) const {
  return & kTypeDescriptor_GGS_app_trusted_false ;
}

//---------------------------------------------------------------------------*
//                                                                           *
//                      class 'cPtr_app_trusted_true'                        *
//                                                                           *
//---------------------------------------------------------------------------*

cPtr_app_trusted_true::
cPtr_app_trusted_true (const GGS_location & argument_0,
                                const GGS_stringset & argument_1
                                COMMA_LOCATION_ARGS)
:cPtr_app_trusted_obj (argument_0 COMMA_THERE),
trusted_fcts (argument_1) {
}

//---------------------------------------------------------------------------*

#ifndef DO_NOT_GENERATE_CHECKINGS
  cPtr_app_trusted_true * GGS_app_trusted_true::
  operator () (LOCATION_ARGS) const {
    macroValidObjectThere (mPointer, cPtr_app_trusted_true) ;
    return (cPtr_app_trusted_true *) mPointer ;
  }
#endif

//---------------------------------------------------------------------------*

bool cPtr_app_trusted_true::
isEqualToObject (const cPtr__AC_galgas_class * inOperand) const {
  bool equal = typeid (this) == typeid (inOperand) ;
  if (equal) {
    const cPtr_app_trusted_true * ptr = dynamic_cast <const cPtr_app_trusted_true *> (inOperand) ;
    macroValidPointer (ptr) ;
    equal = location.operator_isEqual (ptr->location).boolValue ()
         && trusted_fcts.operator_isEqual (ptr->trusted_fcts).boolValue () ;
  }
  return equal ;
}

//---------------------------------------------------------------------------*

void cPtr_app_trusted_true::
appendForDescription (C_String & ioString,
                      const PMSInt32 inIndentation) const {
  ioString << "->@app_trusted_true:"
           << location.reader_description (inIndentation + 1)
           << trusted_fcts.reader_description (inIndentation + 1) ;
}

//---------------------------------------------------------------------------*
//                                                                           *
//                              Class message                                *
//                                                                           *
//---------------------------------------------------------------------------*

const char * cPtr_app_trusted_true::
instanceMessage (void) const {
  return "" ;
}

//---------------------------------------------------------------------------*

const char * cPtr_app_trusted_true::
_static_message (void) {
  return "" ;
}

//---------------------------------------------------------------------------*

C_galgas_class_inspector _gInspectorFor_app_trusted_true (& typeid (cPtr_app_trusted_true), & typeid (cPtr_app_trusted_obj), "") ;

//---------------------------------------------------------------------------*

AC_galgasClassRunTimeInformationEX * cPtr_app_trusted_true::galgasRTTI (void) const {
  return & gClassInfoFor__app_trusted_true ;
}

//---------------------------------------------------------------------------*

cPtr__AC_galgas_class * cPtr_app_trusted_true::makeClone (void) const {
  cPtr__AC_galgas_class * result = NULL ;
  macroMyNew (result, cPtr_app_trusted_true (location, trusted_fcts COMMA_HERE)) ;
  return result ;
}

//---------------------------------------------------------------------------*
//                                                                           *
//                   GALGAS class 'GGS_app_trusted_true'                     *
//                                                                           *
//---------------------------------------------------------------------------*

const C_galgas_type_descriptorEX kTypeDescriptor_GGS_app_trusted_true ("app_trusted_true", true, & kTypeDescriptor_GGS_app_trusted_obj) ;

//---------------------------------------------------------------------------*

GGS_app_trusted_true::
GGS_app_trusted_true (const cPtr__AC_galgas_class * inPointer) {
  macroAssignObject (mPointer, (cPtr__AC_galgas_class *) inPointer) ;
}

//---------------------------------------------------------------------------*

GGS_app_trusted_true::
GGS_app_trusted_true (cPtr__AC_galgas_class & inObject) {
  macroAssignObject (mPointer, & inObject) ;
}

//---------------------------------------------------------------------------*

//--- castFrom class method (implements cast expression)
GGS_app_trusted_true GGS_app_trusted_true::
castFrom (C_Compiler & inLexique,
           cPtr__AC_galgas_class * inPointer,
           const bool inUseKindOfClass,
           const GGS_location & inErrorLocation
           COMMA_LOCATION_ARGS) {
  GGS_app_trusted_true result ;
  if (inPointer != NULL) {
    macroValidPointer (inPointer) ;
    const bool ok = inUseKindOfClass
      ? (dynamic_cast <cPtr_app_trusted_true *> (inPointer) != NULL)
      : (typeid (cPtr_app_trusted_true) == typeid (*inPointer)) ;
    if (ok) {
      result = GGS_app_trusted_true (inPointer) ;
    }else{
      inErrorLocation.signalCastError (inLexique,
                                       & typeid (cPtr_app_trusted_true),
                                       inUseKindOfClass,
                                       inPointer->instanceMessage ()
                                       COMMA_THERE) ;
    }
  }
  return result ;
}

//---------------------------------------------------------------------------*

GGS_app_trusted_true GGS_app_trusted_true::
constructor_new (C_Compiler & /* inLexique */,
                 const GGS_location & argument_0,
                 const GGS_stringset & argument_1
                                COMMA_LOCATION_ARGS) {
  GGS_app_trusted_true result ;
  macroMyNew (result.mPointer, cPtr_app_trusted_true (argument_0,
                                argument_1 COMMA_THERE)) ;
  macroRetainObject (result.mPointer) ;
  return result ;
}

//---------------------------------------------------------------------------*

GGS_stringset  GGS_app_trusted_true::
reader_trusted_fcts (C_Compiler & /* inLexique */ COMMA_UNUSED_LOCATION_ARGS) const {
  GGS_stringset   result ;
  if (mPointer != NULL) {
    macroValidPointer (mPointer) ;
    MF_Assert (dynamic_cast <cPtr_app_trusted_true *> (mPointer) != NULL,
               "dynamic cast error", 0, 0) ;
    result = ((cPtr_app_trusted_true *) mPointer)->trusted_fcts ;
  }
  return result ;
}

//---------------------------------------------------------------------------*

const char * GGS_app_trusted_true::actualTypeName (void) const {
  return "app_trusted_true" ;
}

//---------------------------------------------------------------------------*

C_galgasClassRunTimeInformationEX gClassInfoFor__app_trusted_true ("app_trusted_true", gClassInfoFor__app_trusted_obj, & kTypeDescriptor_GGS_app_trusted_true) ;

//---------------------------------------------------------------------------*

GGS_object GGS_app_trusted_true::reader_object (void) const {
  GGS_object result ;
  if (isBuilt ()) {
    GGS_app_trusted_true * p = NULL ;
    macroMyNew (p, GGS_app_trusted_true (*this)) ;
    result = GGS_object (p) ;
  }
  return result ;
}

//---------------------------------------------------------------------------*

GGS_app_trusted_true GGS_app_trusted_true::castFromObject (C_Compiler & inLexique,
                                   const GGS_object & inObject,
                                   const GGS_location & inErrorLocation
                                   COMMA_LOCATION_ARGS) {
  GGS_app_trusted_true result ;
  const GGS__root * embeddedObject = inObject.embeddedObject () ;
  if (NULL != embeddedObject) {
    const GGS_app_trusted_true * p = dynamic_cast <const GGS_app_trusted_true *> (embeddedObject) ;
    if (NULL != p) {
      result = * p ;
    }else{
      castFromObjectErrorSignaling (inLexique, inErrorLocation, & kTypeDescriptor_GGS_app_trusted_true, embeddedObject COMMA_THERE) ;
    }
  }
  return result ;
}

//---------------------------------------------------------------------------*

const C_galgas_type_descriptorEX * GGS_app_trusted_true::typeDescriptor (void) const {
  return & kTypeDescriptor_GGS_app_trusted_true ;
}

//---------------------------------------------------------------------------*
//                                                                           *
//                           class 'cPtr_app_obj'                            *
//                                                                           *
//---------------------------------------------------------------------------*

cPtr_app_obj::
cPtr_app_obj (const GGS_lstring & argument_0,
                                const GGS_app_trusted_obj & argument_1,
                                const GGS_basic_type & argument_2,
                                const GGS_basic_type & argument_3,
                                const GGS_basic_type & argument_4,
                                const GGS_basic_type & argument_5,
                                const GGS_ident_map & argument_6,
                                const GGS_ident_map & argument_7,
                                const GGS_ident_map & argument_8,
                                const GGS_ident_map & argument_9,
                                const GGS_ident_map & argument_10,
                                const GGS_ident_map & argument_11,
                                const GGS_ident_map & argument_12
                                COMMA_LOCATION_ARGS)
:cPtr_oil_obj (argument_0 COMMA_THERE),
trusted (argument_1),
startuphook (argument_2),
shutdownhook (argument_3),
errorhook (argument_4),
restart (argument_5),
tasks (argument_6),
isrs (argument_7),
alarms (argument_8),
scheduletables (argument_9),
counters (argument_10),
resources (argument_11),
messages (argument_12) {
}

//---------------------------------------------------------------------------*

#ifndef DO_NOT_GENERATE_CHECKINGS
  cPtr_app_obj * GGS_app_obj::
  operator () (LOCATION_ARGS) const {
    macroValidObjectThere (mPointer, cPtr_app_obj) ;
    return (cPtr_app_obj *) mPointer ;
  }
#endif

//---------------------------------------------------------------------------*

bool cPtr_app_obj::
isEqualToObject (const cPtr__AC_galgas_class * inOperand) const {
  bool equal = typeid (this) == typeid (inOperand) ;
  if (equal) {
    const cPtr_app_obj * ptr = dynamic_cast <const cPtr_app_obj *> (inOperand) ;
    macroValidPointer (ptr) ;
    equal = desc.operator_isEqual (ptr->desc).boolValue ()
         && trusted.operator_isEqual (ptr->trusted).boolValue ()
         && startuphook.operator_isEqual (ptr->startuphook).boolValue ()
         && shutdownhook.operator_isEqual (ptr->shutdownhook).boolValue ()
         && errorhook.operator_isEqual (ptr->errorhook).boolValue ()
         && restart.operator_isEqual (ptr->restart).boolValue ()
         && tasks.operator_isEqual (ptr->tasks).boolValue ()
         && isrs.operator_isEqual (ptr->isrs).boolValue ()
         && alarms.operator_isEqual (ptr->alarms).boolValue ()
         && scheduletables.operator_isEqual (ptr->scheduletables).boolValue ()
         && counters.operator_isEqual (ptr->counters).boolValue ()
         && resources.operator_isEqual (ptr->resources).boolValue ()
         && messages.operator_isEqual (ptr->messages).boolValue () ;
  }
  return equal ;
}

//---------------------------------------------------------------------------*

void cPtr_app_obj::
appendForDescription (C_String & ioString,
                      const PMSInt32 inIndentation) const {
  ioString << "->@app_obj:"
           << desc.reader_description (inIndentation + 1)
           << trusted.reader_description (inIndentation + 1)
           << startuphook.reader_description (inIndentation + 1)
           << shutdownhook.reader_description (inIndentation + 1)
           << errorhook.reader_description (inIndentation + 1)
           << restart.reader_description (inIndentation + 1)
           << tasks.reader_description (inIndentation + 1)
           << isrs.reader_description (inIndentation + 1)
           << alarms.reader_description (inIndentation + 1)
           << scheduletables.reader_description (inIndentation + 1)
           << counters.reader_description (inIndentation + 1)
           << resources.reader_description (inIndentation + 1)
           << messages.reader_description (inIndentation + 1) ;
}

//---------------------------------------------------------------------------*
//                                                                           *
//                              Class message                                *
//                                                                           *
//---------------------------------------------------------------------------*

const char * cPtr_app_obj::
instanceMessage (void) const {
  return "" ;
}

//---------------------------------------------------------------------------*

const char * cPtr_app_obj::
_static_message (void) {
  return "" ;
}

//---------------------------------------------------------------------------*

C_galgas_class_inspector _gInspectorFor_app_obj (& typeid (cPtr_app_obj), & typeid (cPtr_oil_obj), "") ;

//---------------------------------------------------------------------------*

AC_galgasClassRunTimeInformationEX * cPtr_app_obj::galgasRTTI (void) const {
  return & gClassInfoFor__app_obj ;
}

//---------------------------------------------------------------------------*

cPtr__AC_galgas_class * cPtr_app_obj::makeClone (void) const {
  cPtr__AC_galgas_class * result = NULL ;
  macroMyNew (result, cPtr_app_obj (desc, trusted, startuphook, shutdownhook, errorhook, restart, tasks, isrs, alarms, scheduletables, counters, resources, messages COMMA_HERE)) ;
  return result ;
}

//---------------------------------------------------------------------------*
//                                                                           *
//                        GALGAS class 'GGS_app_obj'                         *
//                                                                           *
//---------------------------------------------------------------------------*

const C_galgas_type_descriptorEX kTypeDescriptor_GGS_app_obj ("app_obj", true, & kTypeDescriptor_GGS_oil_obj) ;

//---------------------------------------------------------------------------*

GGS_app_obj::
GGS_app_obj (const cPtr__AC_galgas_class * inPointer) {
  macroAssignObject (mPointer, (cPtr__AC_galgas_class *) inPointer) ;
}

//---------------------------------------------------------------------------*

GGS_app_obj::
GGS_app_obj (cPtr__AC_galgas_class & inObject) {
  macroAssignObject (mPointer, & inObject) ;
}

//---------------------------------------------------------------------------*

//--- castFrom class method (implements cast expression)
GGS_app_obj GGS_app_obj::
castFrom (C_Compiler & inLexique,
           cPtr__AC_galgas_class * inPointer,
           const bool inUseKindOfClass,
           const GGS_location & inErrorLocation
           COMMA_LOCATION_ARGS) {
  GGS_app_obj result ;
  if (inPointer != NULL) {
    macroValidPointer (inPointer) ;
    const bool ok = inUseKindOfClass
      ? (dynamic_cast <cPtr_app_obj *> (inPointer) != NULL)
      : (typeid (cPtr_app_obj) == typeid (*inPointer)) ;
    if (ok) {
      result = GGS_app_obj (inPointer) ;
    }else{
      inErrorLocation.signalCastError (inLexique,
                                       & typeid (cPtr_app_obj),
                                       inUseKindOfClass,
                                       inPointer->instanceMessage ()
                                       COMMA_THERE) ;
    }
  }
  return result ;
}

//---------------------------------------------------------------------------*

GGS_app_obj GGS_app_obj::
constructor_new (C_Compiler & /* inLexique */,
                 const GGS_lstring & argument_0,
                 const GGS_app_trusted_obj & argument_1,
                 const GGS_basic_type & argument_2,
                 const GGS_basic_type & argument_3,
                 const GGS_basic_type & argument_4,
                 const GGS_basic_type & argument_5,
                 const GGS_ident_map & argument_6,
                 const GGS_ident_map & argument_7,
                 const GGS_ident_map & argument_8,
                 const GGS_ident_map & argument_9,
                 const GGS_ident_map & argument_10,
                 const GGS_ident_map & argument_11,
                 const GGS_ident_map & argument_12
                                COMMA_LOCATION_ARGS) {
  GGS_app_obj result ;
  macroMyNew (result.mPointer, cPtr_app_obj (argument_0,
                                argument_1,
                                argument_2,
                                argument_3,
                                argument_4,
                                argument_5,
                                argument_6,
                                argument_7,
                                argument_8,
                                argument_9,
                                argument_10,
                                argument_11,
                                argument_12 COMMA_THERE)) ;
  macroRetainObject (result.mPointer) ;
  return result ;
}

//---------------------------------------------------------------------------*

GGS_app_trusted_obj  GGS_app_obj::
reader_trusted (C_Compiler & /* inLexique */ COMMA_UNUSED_LOCATION_ARGS) const {
  GGS_app_trusted_obj   result ;
  if (mPointer != NULL) {
    macroValidPointer (mPointer) ;
    MF_Assert (dynamic_cast <cPtr_app_obj *> (mPointer) != NULL,
               "dynamic cast error", 0, 0) ;
    result = ((cPtr_app_obj *) mPointer)->trusted ;
  }
  return result ;
}

//---------------------------------------------------------------------------*

GGS_basic_type  GGS_app_obj::
reader_startuphook (C_Compiler & /* inLexique */ COMMA_UNUSED_LOCATION_ARGS) const {
  GGS_basic_type   result ;
  if (mPointer != NULL) {
    macroValidPointer (mPointer) ;
    MF_Assert (dynamic_cast <cPtr_app_obj *> (mPointer) != NULL,
               "dynamic cast error", 0, 0) ;
    result = ((cPtr_app_obj *) mPointer)->startuphook ;
  }
  return result ;
}

//---------------------------------------------------------------------------*

GGS_basic_type  GGS_app_obj::
reader_shutdownhook (C_Compiler & /* inLexique */ COMMA_UNUSED_LOCATION_ARGS) const {
  GGS_basic_type   result ;
  if (mPointer != NULL) {
    macroValidPointer (mPointer) ;
    MF_Assert (dynamic_cast <cPtr_app_obj *> (mPointer) != NULL,
               "dynamic cast error", 0, 0) ;
    result = ((cPtr_app_obj *) mPointer)->shutdownhook ;
  }
  return result ;
}

//---------------------------------------------------------------------------*

GGS_basic_type  GGS_app_obj::
reader_errorhook (C_Compiler & /* inLexique */ COMMA_UNUSED_LOCATION_ARGS) const {
  GGS_basic_type   result ;
  if (mPointer != NULL) {
    macroValidPointer (mPointer) ;
    MF_Assert (dynamic_cast <cPtr_app_obj *> (mPointer) != NULL,
               "dynamic cast error", 0, 0) ;
    result = ((cPtr_app_obj *) mPointer)->errorhook ;
  }
  return result ;
}

//---------------------------------------------------------------------------*

GGS_basic_type  GGS_app_obj::
reader_restart (C_Compiler & /* inLexique */ COMMA_UNUSED_LOCATION_ARGS) const {
  GGS_basic_type   result ;
  if (mPointer != NULL) {
    macroValidPointer (mPointer) ;
    MF_Assert (dynamic_cast <cPtr_app_obj *> (mPointer) != NULL,
               "dynamic cast error", 0, 0) ;
    result = ((cPtr_app_obj *) mPointer)->restart ;
  }
  return result ;
}

//---------------------------------------------------------------------------*

GGS_ident_map  GGS_app_obj::
reader_tasks (C_Compiler & /* inLexique */ COMMA_UNUSED_LOCATION_ARGS) const {
  GGS_ident_map   result ;
  if (mPointer != NULL) {
    macroValidPointer (mPointer) ;
    MF_Assert (dynamic_cast <cPtr_app_obj *> (mPointer) != NULL,
               "dynamic cast error", 0, 0) ;
    result = ((cPtr_app_obj *) mPointer)->tasks ;
  }
  return result ;
}

//---------------------------------------------------------------------------*

GGS_ident_map  GGS_app_obj::
reader_isrs (C_Compiler & /* inLexique */ COMMA_UNUSED_LOCATION_ARGS) const {
  GGS_ident_map   result ;
  if (mPointer != NULL) {
    macroValidPointer (mPointer) ;
    MF_Assert (dynamic_cast <cPtr_app_obj *> (mPointer) != NULL,
               "dynamic cast error", 0, 0) ;
    result = ((cPtr_app_obj *) mPointer)->isrs ;
  }
  return result ;
}

//---------------------------------------------------------------------------*

GGS_ident_map  GGS_app_obj::
reader_alarms (C_Compiler & /* inLexique */ COMMA_UNUSED_LOCATION_ARGS) const {
  GGS_ident_map   result ;
  if (mPointer != NULL) {
    macroValidPointer (mPointer) ;
    MF_Assert (dynamic_cast <cPtr_app_obj *> (mPointer) != NULL,
               "dynamic cast error", 0, 0) ;
    result = ((cPtr_app_obj *) mPointer)->alarms ;
  }
  return result ;
}

//---------------------------------------------------------------------------*

GGS_ident_map  GGS_app_obj::
reader_scheduletables (C_Compiler & /* inLexique */ COMMA_UNUSED_LOCATION_ARGS) const {
  GGS_ident_map   result ;
  if (mPointer != NULL) {
    macroValidPointer (mPointer) ;
    MF_Assert (dynamic_cast <cPtr_app_obj *> (mPointer) != NULL,
               "dynamic cast error", 0, 0) ;
    result = ((cPtr_app_obj *) mPointer)->scheduletables ;
  }
  return result ;
}

//---------------------------------------------------------------------------*

GGS_ident_map  GGS_app_obj::
reader_counters (C_Compiler & /* inLexique */ COMMA_UNUSED_LOCATION_ARGS) const {
  GGS_ident_map   result ;
  if (mPointer != NULL) {
    macroValidPointer (mPointer) ;
    MF_Assert (dynamic_cast <cPtr_app_obj *> (mPointer) != NULL,
               "dynamic cast error", 0, 0) ;
    result = ((cPtr_app_obj *) mPointer)->counters ;
  }
  return result ;
}

//---------------------------------------------------------------------------*

GGS_ident_map  GGS_app_obj::
reader_resources (C_Compiler & /* inLexique */ COMMA_UNUSED_LOCATION_ARGS) const {
  GGS_ident_map   result ;
  if (mPointer != NULL) {
    macroValidPointer (mPointer) ;
    MF_Assert (dynamic_cast <cPtr_app_obj *> (mPointer) != NULL,
               "dynamic cast error", 0, 0) ;
    result = ((cPtr_app_obj *) mPointer)->resources ;
  }
  return result ;
}

//---------------------------------------------------------------------------*

GGS_ident_map  GGS_app_obj::
reader_messages (C_Compiler & /* inLexique */ COMMA_UNUSED_LOCATION_ARGS) const {
  GGS_ident_map   result ;
  if (mPointer != NULL) {
    macroValidPointer (mPointer) ;
    MF_Assert (dynamic_cast <cPtr_app_obj *> (mPointer) != NULL,
               "dynamic cast error", 0, 0) ;
    result = ((cPtr_app_obj *) mPointer)->messages ;
  }
  return result ;
}

//---------------------------------------------------------------------------*

const char * GGS_app_obj::actualTypeName (void) const {
  return "app_obj" ;
}

//---------------------------------------------------------------------------*

C_galgasClassRunTimeInformationEX gClassInfoFor__app_obj ("app_obj", gClassInfoFor__oil_obj, & kTypeDescriptor_GGS_app_obj) ;

//---------------------------------------------------------------------------*

GGS_object GGS_app_obj::reader_object (void) const {
  GGS_object result ;
  if (isBuilt ()) {
    GGS_app_obj * p = NULL ;
    macroMyNew (p, GGS_app_obj (*this)) ;
    result = GGS_object (p) ;
  }
  return result ;
}

//---------------------------------------------------------------------------*

GGS_app_obj GGS_app_obj::castFromObject (C_Compiler & inLexique,
                                   const GGS_object & inObject,
                                   const GGS_location & inErrorLocation
                                   COMMA_LOCATION_ARGS) {
  GGS_app_obj result ;
  const GGS__root * embeddedObject = inObject.embeddedObject () ;
  if (NULL != embeddedObject) {
    const GGS_app_obj * p = dynamic_cast <const GGS_app_obj *> (embeddedObject) ;
    if (NULL != p) {
      result = * p ;
    }else{
      castFromObjectErrorSignaling (inLexique, inErrorLocation, & kTypeDescriptor_GGS_app_obj, embeddedObject COMMA_THERE) ;
    }
  }
  return result ;
}

//---------------------------------------------------------------------------*

const C_galgas_type_descriptorEX * GGS_app_obj::typeDescriptor (void) const {
  return & kTypeDescriptor_GGS_app_obj ;
}

//---------------------------------------------------------------------------*
//                                                                           *
//                            class 'e_app_map'                              *
//                                                                           *
//---------------------------------------------------------------------------*

e_app_map::e_app_map (void) :
app () {
}

//---------------------------------------------------------------------------*
//                                                                           *
//                           class map '@app_map'                            *
//                                                                           *
//---------------------------------------------------------------------------*

const C_galgas_type_descriptorEX kTypeDescriptor_GGS_app_map ("app_map", false, NULL) ;

//---------------------------------------------------------------------------*

elementOf_GGS_app_map::
elementOf_GGS_app_map (const GGS_lstring & inKey,
              const PMSInt32 inIndex,
              const e_app_map & inInfo) :
AC_galgas_map_element (inKey, inIndex),
mInfo (inInfo) {
}

//---------------------------------------------------------------------------*

void elementOf_GGS_app_map::
appendForMapDescription (const PMSInt32 inElementIndex,
                         C_String & ioString,
                         const PMSInt32 inIndentation) const {
  ioString << "\n" ;
  ioString.writeStringMultiple ("| ", inIndentation) ;
  ioString << "|-key " ;
  ioString.appendSigned (inElementIndex) ;
  ioString << ":" << mKey.reader_description (inIndentation + 1) ;
  ioString << "\n" ;
  ioString.writeStringMultiple ("| ", inIndentation) ;
  ioString << "|-value " ;
  ioString.appendSigned (inElementIndex) ;
  ioString << ":" << mInfo.app.reader_description (inIndentation + 1) ;
}

//---------------------------------------------------------------------------*

bool elementOf_GGS_app_map::
isEqualToMapElement (const AC_galgas_map_element * inOperand) const {
  const elementOf_GGS_app_map * ptr = dynamic_cast <const elementOf_GGS_app_map *> (inOperand) ;
  macroValidPointer (ptr) ;
  return (mInfo.app.operator_isEqual (ptr->mInfo.app)).boolValue () ;
}

//---------------------------------------------------------------------------*

AC_galgas_map_element * GGS_app_map::
new_element (const GGS_lstring & inKey, void * inInfo) {
  MF_Assert (reinterpret_cast <e_app_map *> (inInfo) != NULL, "Dynamic cast error", 0, 0) ;
  AC_galgas_map_element * p = NULL ;
  e_app_map * info = (e_app_map *) inInfo ;
  macroMyNew (p, cElement (inKey, nextIndex (), * info)) ;
  return p ;
}

//---------------------------------------------------------------------------*

void GGS_app_map::
assignInfo (AC_galgas_map_element * inPtr, void * inInfo) {
  MF_Assert (reinterpret_cast <cElement *> (inPtr) != NULL, "Dynamic cast error", 0, 0) ;
  MF_Assert (reinterpret_cast <e_app_map *> (inInfo) != NULL, "Dynamic cast error", 0, 0) ;
  cElement * p = (cElement *) inPtr ;
  e_app_map * info = (e_app_map *) inInfo ;
  p->mInfo = * info ;
}

//---------------------------------------------------------------------------*

GGS_app_map GGS_app_map::
constructor_emptyMap (C_Compiler & /* inLexique */ COMMA_UNUSED_LOCATION_ARGS) {
  GGS_app_map result ;
  macroMyNew (result.mSharedMapRoot, cMapRoot) ;
  return result ;
}

//---------------------------------------------------------------------------*

void GGS_app_map::
enterIndex (const GGS_lstring & inKey,
            AC_galgas_index_core & outIndex) {
  e_app_map info  ;
  internalEnterIndex (inKey,
                      (void *) & info,
                      outIndex) ;
}

//---------------------------------------------------------------------------*

GGS_bool GGS_app_map::
operator_isEqual (const GGS_app_map & inOperand) const {
  return GGS_bool (isBuilt () && inOperand.isBuilt (), isEqualToMap (inOperand)) ;
}

//---------------------------------------------------------------------------*

GGS_bool GGS_app_map::
operator_isNotEqual (const GGS_app_map & inOperand) const {
  return GGS_bool (isBuilt () && inOperand.isBuilt (), ! isEqualToMap (inOperand)) ;
}

//---------------------------------------------------------------------------*

void GGS_app_map::
internalInsertForDuplication (AC_galgas_map_element * inPtr) {
  MF_Assert (reinterpret_cast <cElement *> (inPtr) != NULL, "Dynamic cast error", 0, 0) ;
  cElement * p = (cElement *) inPtr ;
  PMSInt32 attributeIndex = -1 ; // Unused here
  GGS_location existingKeyLocation ; // Unused here
  internalInsert (p->mKey, (void *) & p->mInfo, attributeIndex, existingKeyLocation) ;
}

//---------------------------------------------------------------------------*

void GGS_app_map::
removeElement (C_Compiler & inLexique,
                const utf32 * inErrorMessage,
                const GGS_lstring & inKey,
                GGS_app_obj & outParameter0,
                GGS_luint * outIndex
                COMMA_LOCATION_ARGS) {
  AC_galgas_map_element * removedElement = NULL ;
  PMSInt32 elementID = - 1 ;
  if (isBuilt () && inKey.isBuilt ()) {
    removedElement = internalRemove (inKey) ;
    if (removedElement == NULL) {
      emitMapSemanticErrorMessage (inLexique, inKey, inErrorMessage COMMA_THERE) ;
      outParameter0.drop () ;
    }else{
      cElement * ptr = (cElement *) removedElement ;
      elementID = ptr->mID ;
      outParameter0 = ptr->mInfo.app ;
    }
  }
  if (outIndex != NULL) {
    * outIndex = GGS_luint (GGS_uint (elementID >= 0, (PMUInt32) elementID), inKey) ;
  }
  macroMyDelete (removedElement) ;
}

//---------------------------------------------------------------------------*

void GGS_app_map::
insertElement (C_Compiler & inLexique,
                const utf32 * inErrorMessage,
                const GGS_lstring & inKey,
                const GGS_app_obj & inParameter0,
                GGS_luint * outIndex
                COMMA_LOCATION_ARGS) {
  PMSInt32 elementID = - 1 ;
  if (isBuilt ()
   && inParameter0.isBuilt ()
   && inKey.isBuilt ()) {
    insulateMap () ;
    e_app_map info  ;
    info.app = inParameter0 ;
    GGS_location existingKeyLocation ;
    internalInsert (inKey, (void *) & info, elementID, existingKeyLocation) ;
    if (elementID < 0) {
      emitInsertMapSemanticErrorMessage (inLexique, inKey, inErrorMessage, existingKeyLocation COMMA_THERE) ;
    }
  }
  if (outIndex != NULL) {
    * outIndex = GGS_luint (GGS_uint (elementID >= 0, (PMUInt32) elementID), inKey) ;
  }
}

//---------------------------------------------------------------------------*

void GGS_app_map::
searchElement (C_Compiler & inLexique,
               const utf32 * inErrorMessage,
               const GGS_lstring & inKey,
               GGS_app_obj   & outParameter0,
               GGS_luint * outIndex
               COMMA_LOCATION_ARGS) const {
  cElement * node = NULL  ;
  if (isBuilt () && inKey.isBuilt ()) {
    AC_galgas_map_element * p = internal_search (inKey.string ()) ;
    MF_Assert ((p == NULL) || (reinterpret_cast <cElement *> (p) != NULL), "Dynamic cast error", 0, 0) ;
    node = (cElement *) p ;
    if (node == NULL) {
      emitMapSemanticErrorMessage (inLexique, inKey, inErrorMessage COMMA_THERE) ;
    }
  }
  if (node == NULL) {
    outParameter0.drop () ;
    if (outIndex != NULL) {
      outIndex->drop () ;
     }
  }else{
    outParameter0 = node->mInfo.app ;
    if (outIndex != NULL) {
      * outIndex = GGS_luint (GGS_uint (true, (PMUInt32) node->mID), inKey) ;
    }
  }
}

//---------------------------------------------------------------------------*

const utf32 GGS_app_map::kSearchMessage_get [] = {
  TO_UNICODE ('A'),
  TO_UNICODE ('p'),
  TO_UNICODE ('p'),
  TO_UNICODE ('l'),
  TO_UNICODE ('i'),
  TO_UNICODE ('c'),
  TO_UNICODE ('a'),
  TO_UNICODE ('t'),
  TO_UNICODE ('i'),
  TO_UNICODE ('o'),
  TO_UNICODE ('n'),
  TO_UNICODE (' '),
  TO_UNICODE ('%'),
  TO_UNICODE ('K'),
  TO_UNICODE (' '),
  TO_UNICODE ('i'),
  TO_UNICODE ('s'),
  TO_UNICODE (' '),
  TO_UNICODE ('u'),
  TO_UNICODE ('n'),
  TO_UNICODE ('k'),
  TO_UNICODE ('o'),
  TO_UNICODE ('w'),
  TO_UNICODE ('n'),
  TO_UNICODE (0)
} ;

//---------------------------------------------------------------------------*

void GGS_app_map::
method_get (C_Compiler & inLexique,
                                const GGS_lstring & inKey,
                                GGS_app_obj   & outParameter0 COMMA_LOCATION_ARGS) const {
  searchElement (inLexique,
                  kSearchMessage_get,
                  inKey,
                  outParameter0,
                  NULL
                  COMMA_THERE) ;
}

//---------------------------------------------------------------------------*

const utf32 GGS_app_map::kRemoveMessage_del [] = {
  TO_UNICODE ('A'),
  TO_UNICODE ('p'),
  TO_UNICODE ('p'),
  TO_UNICODE ('l'),
  TO_UNICODE ('i'),
  TO_UNICODE ('c'),
  TO_UNICODE ('a'),
  TO_UNICODE ('t'),
  TO_UNICODE ('i'),
  TO_UNICODE ('o'),
  TO_UNICODE ('n'),
  TO_UNICODE (' '),
  TO_UNICODE ('%'),
  TO_UNICODE ('K'),
  TO_UNICODE (' '),
  TO_UNICODE ('i'),
  TO_UNICODE ('s'),
  TO_UNICODE (' '),
  TO_UNICODE ('u'),
  TO_UNICODE ('n'),
  TO_UNICODE ('k'),
  TO_UNICODE ('o'),
  TO_UNICODE ('w'),
  TO_UNICODE ('n'),
  TO_UNICODE (0)
} ;

//---------------------------------------------------------------------------*

void GGS_app_map::
modifier_del (C_Compiler & inLexique,
                                const GGS_lstring & inKey,
                                GGS_app_obj & outParameter0 COMMA_LOCATION_ARGS) {
  removeElement (inLexique,
                  kRemoveMessage_del,
                  inKey,
                  outParameter0,
                  NULL
                  COMMA_THERE) ;
}

//---------------------------------------------------------------------------*

const utf32 GGS_app_map::kInsertMessage_put [] = {
  TO_UNICODE ('A'),
  TO_UNICODE ('p'),
  TO_UNICODE ('p'),
  TO_UNICODE ('l'),
  TO_UNICODE ('i'),
  TO_UNICODE ('c'),
  TO_UNICODE ('a'),
  TO_UNICODE ('t'),
  TO_UNICODE ('i'),
  TO_UNICODE ('o'),
  TO_UNICODE ('n'),
  TO_UNICODE (' '),
  TO_UNICODE ('%'),
  TO_UNICODE ('K'),
  TO_UNICODE (' '),
  TO_UNICODE ('i'),
  TO_UNICODE ('s'),
  TO_UNICODE (' '),
  TO_UNICODE ('a'),
  TO_UNICODE ('l'),
  TO_UNICODE ('r'),
  TO_UNICODE ('e'),
  TO_UNICODE ('a'),
  TO_UNICODE ('d'),
  TO_UNICODE ('y'),
  TO_UNICODE (' '),
  TO_UNICODE ('d'),
  TO_UNICODE ('e'),
  TO_UNICODE ('f'),
  TO_UNICODE ('i'),
  TO_UNICODE ('n'),
  TO_UNICODE ('e'),
  TO_UNICODE ('d'),
  TO_UNICODE (' '),
  TO_UNICODE ('i'),
  TO_UNICODE ('n'),
  TO_UNICODE (' '),
  TO_UNICODE ('%'),
  TO_UNICODE ('L'),
  TO_UNICODE (0)
} ;

//---------------------------------------------------------------------------*

void GGS_app_map::
modifier_put (C_Compiler & inLexique,
                                const GGS_lstring & inKey,
                                const GGS_app_obj & inParameter0 COMMA_LOCATION_ARGS) {
  insertElement (inLexique,
                 kInsertMessage_put,
                 inKey,
                 inParameter0,
                 NULL
                 COMMA_THERE) ;
}

//---------------------------------------------------------------------------*

GGS_app_map GGS_app_map::
constructor_mapWithMapToOverride (C_Compiler & /* inLexique */,
                                  const GGS_app_map & inMapToOverride
                                  COMMA_UNUSED_LOCATION_ARGS) {
  GGS_app_map result ; // Not Built
  if (inMapToOverride.mSharedMapRoot != NULL) {
    macroValidPointer (inMapToOverride.mSharedMapRoot) ;
    macroMyNew (result.mSharedMapRoot, cMapRoot) ;
    result.mSharedMapRoot->mNextMap = inMapToOverride.mSharedMapRoot ;
    inMapToOverride.mSharedMapRoot->mReferenceCount ++ ;
    result.mSharedMapRoot->mSequenceNumber = inMapToOverride.mSharedMapRoot->mSequenceNumber ;
  }
  return result ;
}

//---------------------------------------------------------------------------*

GGS_app_map GGS_app_map::
reader_overriddenMap (C_Compiler & /* inLexique */
                      COMMA_UNUSED_LOCATION_ARGS) const {
  GGS_app_map result ; // Not Built
  if (mSharedMapRoot != NULL) {
    macroValidPointer (mSharedMapRoot) ;
    result.mSharedMapRoot = mSharedMapRoot->mNextMap ;
    if (result.mSharedMapRoot != NULL) {
      macroValidPointer (result.mSharedMapRoot) ;
      result.mSharedMapRoot->mReferenceCount ++ ;
    }else{
      macroMyNew (result.mSharedMapRoot, cMapRoot) ;
    }
  }
  return result ;
}

//---------------------------------------------------------------------------*

GGS_string GGS_app_map::
reader_description (const PMSInt32 inIndentation) const {
  C_String s ;
  s << "<map @app_map " ;
  if (isBuilt ()) {
    s.appendSigned (count ()) ;
    s << " object" << ((count () > 1) ? "s " : " ") ;
    cMapRoot * mapRoot = mSharedMapRoot ;
    PMSInt32 level = 0 ;
    while (mapRoot != NULL) {
      if (level > 0) {
        s << "\n" ;
        s.writeStringMultiple ("| ", inIndentation) ;
        s << "------- level " << cStringWithSigned (level) ;
      }
      macroValidPointer (mapRoot) ;
      cElement * p = (cElement *) mapRoot->mFirstItem ;
      PMSInt32 elementID = 0 ;
      while (p != NULL) {
        macroValidPointer (p) ;
        p->appendForMapDescription (elementID, s, inIndentation) ;
        p = p->nextObject () ;
        elementID ++ ;
      }
      mapRoot = mapRoot->mNextMap ;
      level ++ ;
    }
  }else{
    s << "not built" ;
  }
  s << "\n" ;
  s.writeStringMultiple ("| ", inIndentation) ;
  s << ">" ;
  return GGS_string (true, s) ;
}

//---------------------------------------------------------------------------*

/* const */ GGS_app_obj  & GGS_app_map::cEnumerator::_app (LOCATION_ARGS) const {
  return ((cElement *) mObjectArray (mCurrentIndex COMMA_THERE))->mInfo.app ;
}

//---------------------------------------------------------------------------*

GGS_object GGS_app_map::reader_object (void) const {
  GGS_object result ;
  if (isBuilt ()) {
    GGS_app_map * p = NULL ;
    macroMyNew (p, GGS_app_map (*this)) ;
    result = GGS_object (p) ;
  }
  return result ;
}

//---------------------------------------------------------------------------*

GGS_app_map GGS_app_map::castFromObject (C_Compiler & inLexique,
                                   const GGS_object & inObject,
                                   const GGS_location & inErrorLocation
                                   COMMA_LOCATION_ARGS) {
  GGS_app_map result ;
  const GGS__root * embeddedObject = inObject.embeddedObject () ;
  if (NULL != embeddedObject) {
    const GGS_app_map * p = dynamic_cast <const GGS_app_map *> (embeddedObject) ;
    if (NULL != p) {
      result = * p ;
    }else{
      castFromObjectErrorSignaling (inLexique, inErrorLocation, & kTypeDescriptor_GGS_app_map, embeddedObject COMMA_THERE) ;
    }
  }
  return result ;
}

//---------------------------------------------------------------------------*

const C_galgas_type_descriptorEX * GGS_app_map::typeDescriptor (void) const {
  return & kTypeDescriptor_GGS_app_map ;
}

//---------------------------------------------------------------------------*

