//---------------------------------------------------------------------------*
//                                                                           *
//                    File 'goil_types_timing_prot.cpp'                      *
//             Generated by version version GALGAS_BETA_VERSION              *
//                    november 17th, 2010, at 19h29'53"                      *
//                                                                           *
//---------------------------------------------------------------------------*

//--- START OF USER ZONE 1


//--- END OF USER ZONE 1

#include "version_libpm.h"
#if CURRENT_LIBPM_VERSION != VERSION_OF_LIBPM_USED_BY_GALGAS_COMPILER
  #error "This file has been compiled with a version of GALGAS that uses libpm version VERSION_OF_LIBPM_USED_BY_GALGAS_COMPILER, different than the current version (CURRENT_LIBPM_VERSION) of libpm"
#endif

//---------------------------------------------------------------------------*

#include "goil_types_timing_prot.h"
#include "galgas2/C_Compiler.h"
#include "galgas2/C_galgas_CLI_Options.h"

//---------------------------------------------------------------------------*

#include "goil_options.h"

//---------------------------------------------------------------------------*

#ifndef DO_NOT_GENERATE_CHECKINGS
  #define SOURCE_FILE_AT_LINE(line) "goil_types_timing_prot.gSemantics", line
  #define COMMA_SOURCE_FILE_AT_LINE(line) , SOURCE_FILE_AT_LINE(line)
#else
  #define SOURCE_FILE_AT_LINE(line) 
  #define COMMA_SOURCE_FILE_AT_LINE(line) 
#endif

//---------------------------------------------------------------------------*

cMapElement_rezlock_5F_map::cMapElement_rezlock_5F_map (const GALGAS_lstring & inKey,
                                                        const GALGAS_uint_36__34_ & in_time
                                                        COMMA_LOCATION_ARGS) :
cMapElement (inKey COMMA_THERE),
mAttribute_time (in_time) {
}

//---------------------------------------------------------------------------*

bool cMapElement_rezlock_5F_map::isValid (void) const {
  return mAttribute_lkey.isValid () && mAttribute_time.isValid () ;
}

//---------------------------------------------------------------------------*

cMapElement * cMapElement_rezlock_5F_map::copy (void) {
  cMapElement * result = NULL ;
  macroMyNew (result, cMapElement_rezlock_5F_map (mAttribute_lkey, mAttribute_time COMMA_HERE)) ;
  return result ;
}

//---------------------------------------------------------------------------*

void cMapElement_rezlock_5F_map::description (C_String & /* ioString */, const PMSInt32 /* inIndentation */) const {
// mAttribute_time.description (ioString, inIndentation) ;
}

//---------------------------------------------------------------------------*

enumComparisonResult cMapElement_rezlock_5F_map::compare (const cCollectionElement * inOperand) const {
  cMapElement_rezlock_5F_map * operand = (cMapElement_rezlock_5F_map *) inOperand ;
  enumComparisonResult result = mAttribute_lkey.objectCompare (operand->mAttribute_lkey) ;
  if (kOperandEqual == result) {
    result = mAttribute_time.objectCompare (operand->mAttribute_time) ;
  }
  return result ;
}

//---------------------------------------------------------------------------*

GALGAS_rezlock_5F_map::GALGAS_rezlock_5F_map (void) :
AC_GALGAS_map () {
}

//---------------------------------------------------------------------------*

GALGAS_rezlock_5F_map::GALGAS_rezlock_5F_map (const GALGAS_rezlock_5F_map & inSource) :
AC_GALGAS_map (inSource) {
}

//---------------------------------------------------------------------------*

GALGAS_rezlock_5F_map & GALGAS_rezlock_5F_map::operator = (const GALGAS_rezlock_5F_map & inSource) {
  * ((AC_GALGAS_map *) this) = inSource ;
  return * this ;
}

//---------------------------------------------------------------------------*

GALGAS_rezlock_5F_map GALGAS_rezlock_5F_map::constructor_emptyMap (LOCATION_ARGS) {
  GALGAS_rezlock_5F_map result ;
  result.makeNewEmptyMap (THERE) ;
  return result ;
}

//---------------------------------------------------------------------------*

GALGAS_rezlock_5F_map GALGAS_rezlock_5F_map::constructor_mapWithMapToOverride (const GALGAS_rezlock_5F_map & inMapToOverride
                                                                               COMMA_LOCATION_ARGS) {
  GALGAS_rezlock_5F_map result ;
  result.makeNewEmptyMapWithMapToOverride (inMapToOverride COMMA_THERE) ;
  return result ;
}

//---------------------------------------------------------------------------*

GALGAS_rezlock_5F_map GALGAS_rezlock_5F_map::reader_overriddenMap (UNUSED_LOCATION_ARGS) const {
  GALGAS_rezlock_5F_map result ;
  getOverridenMap (result) ;
  return result ;
}
//---------------------------------------------------------------------------*

void GALGAS_rezlock_5F_map::modifier_put (GALGAS_lstring inKey,
                                          GALGAS_uint_36__34_ inArgument0,
                                          C_Compiler * inCompiler
                                          COMMA_LOCATION_ARGS) {
  cMapElement_rezlock_5F_map * p = NULL ;
  macroMyNew (p, cMapElement_rezlock_5F_map (inKey, inArgument0 COMMA_HERE)) ;
  capCollectionElement attributes ;
  attributes.setPointer (p) ;
  macroDetachSharedObject (p) ;
  const char * kInsertErrorMessage = "Resource %K is already defined in %L" ;
  const char * kShadowErrorMessage = "" ;
  performInsert (attributes, inCompiler, kInsertErrorMessage, kShadowErrorMessage COMMA_THERE) ;
}

//---------------------------------------------------------------------------*

const char * kSearchErrorMessage_rezlock_5F_map_get = "Resource %K is not defined" ;

//---------------------------------------------------------------------------*

void GALGAS_rezlock_5F_map::method_get (GALGAS_lstring inKey,
                                        GALGAS_uint_36__34_ & outArgument0,
                                        C_Compiler * inCompiler
                                        COMMA_LOCATION_ARGS) const {
  const cMapElement_rezlock_5F_map * p = (const cMapElement_rezlock_5F_map *) performSearch (inKey,
                                                                                               inCompiler,
                                                                                               kSearchErrorMessage_rezlock_5F_map_get
                                                                                               COMMA_THERE) ;
  if (NULL == p) {
    outArgument0.drop () ;
  }else{
    macroValidSharedObject (p, const cMapElement_rezlock_5F_map) ;
    outArgument0 = p->mAttribute_time ;
  }
}

//---------------------------------------------------------------------------*

void GALGAS_rezlock_5F_map::modifier_del (GALGAS_lstring inKey,
                                          GALGAS_uint_36__34_ & outArgument0,
                                          C_Compiler * inCompiler
                                          COMMA_LOCATION_ARGS) {
  const char * kRemoveErrorMessage = "Resource %K is not defined" ;
  capCollectionElement attributes ;
  performRemove (inKey, attributes, inCompiler, kRemoveErrorMessage COMMA_THERE) ;
  cMapElement_rezlock_5F_map * p = (cMapElement_rezlock_5F_map *) attributes.ptr () ;
  if (NULL != p) {
    macroValidSharedObject (p, cMapElement_rezlock_5F_map) ;
    outArgument0 = p->mAttribute_time ;
  }
}

//---------------------------------------------------------------------------*

GALGAS_uint_36__34_ GALGAS_rezlock_5F_map::reader_timeForKey (const GALGAS_string & inKey,
                                                              C_Compiler * inCompiler
                                                              COMMA_LOCATION_ARGS) const {
  const cCollectionElement * attributes = searchForReadingAttribute (inKey, inCompiler COMMA_THERE) ;
  const cMapElement_rezlock_5F_map * p = (const cMapElement_rezlock_5F_map *) attributes ;
  GALGAS_uint_36__34_ result ;
  if (NULL != p) {
    macroValidSharedObject (p, const cMapElement_rezlock_5F_map) ;
    result = p->mAttribute_time ;
  }
  return result ;
}

//---------------------------------------------------------------------------*

void GALGAS_rezlock_5F_map::modifier_setTimeForKey (GALGAS_uint_36__34_ inAttributeValue,
                                                    GALGAS_string inKey,
                                                    C_Compiler * inCompiler
                                                    COMMA_LOCATION_ARGS) {
  cCollectionElement * attributes = searchForReadWriteAttribute (inKey, inCompiler COMMA_THERE) ;
  cMapElement_rezlock_5F_map * p = (cMapElement_rezlock_5F_map *) attributes ;
  if (NULL != p) {
    macroValidSharedObject (p, cMapElement_rezlock_5F_map) ;
    p->mAttribute_time = inAttributeValue ;
  }
}

//---------------------------------------------------------------------------*

cMapElement_rezlock_5F_map * GALGAS_rezlock_5F_map::readWriteAccessForWithInstruction_get (C_Compiler * inCompiler,
                                                                                           const GALGAS_lstring & inKey
                                                                                           COMMA_LOCATION_ARGS) {
  cMapElement * p = searchForReadWriteAttribute (inKey, inCompiler, kSearchErrorMessage_rezlock_5F_map_get COMMA_THERE) ;
  cMapElement_rezlock_5F_map * result = (cMapElement_rezlock_5F_map *) p ;
  macroNullOrValidSharedObject (result, cMapElement_rezlock_5F_map) ;
  return result ;
}

//---------------------------------------------------------------------------*

cMapElement_rezlock_5F_map * GALGAS_rezlock_5F_map::readWriteAccessForWithInstruction_hasKey (C_Compiler * inCompiler,
                                                                                              const GALGAS_string & inKey
                                                                                              COMMA_LOCATION_ARGS) {
  cMapElement * p = searchForReadWriteAttribute (inKey, inCompiler COMMA_THERE) ;
  cMapElement_rezlock_5F_map * result = (cMapElement_rezlock_5F_map *) p ;
  macroNullOrValidSharedObject (result, cMapElement_rezlock_5F_map) ;
  return result ;
}

//---------------------------------------------------------------------------*

cEnumerator_rezlock_5F_map::cEnumerator_rezlock_5F_map (const GALGAS_rezlock_5F_map & inEnumeratedObject,
                                                        const bool inAscending) :
cGenericAbstractEnumerator () {
  inEnumeratedObject.populateEnumerationArray (mEnumerationArray, inAscending) ;
}

//---------------------------------------------------------------------------*

GALGAS_lstring cEnumerator_rezlock_5F_map::current_lkey (LOCATION_ARGS) const {
  const cMapElement * p = (const cMapElement *) currentObjectPtr (THERE) ;
  macroValidSharedObject (p, const cMapElement) ;
  return p->mAttribute_lkey ;
}

//---------------------------------------------------------------------------*

GALGAS_uint_36__34_ cEnumerator_rezlock_5F_map::current_time (LOCATION_ARGS) const {
  const cMapElement_rezlock_5F_map * p = (const cMapElement_rezlock_5F_map *) currentObjectPtr (THERE) ;
  macroValidSharedObject (p, const cMapElement_rezlock_5F_map) ;
  return p->mAttribute_time ;
}



//---------------------------------------------------------------------------*
//                                                                           *
//                             @rezlock_map type                             *
//                                                                           *
//---------------------------------------------------------------------------*

const C_galgas_type_descriptor
kTypeDescriptor_GALGAS_rezlock_5F_map ("rezlock_map",
                                       NULL) ;

//---------------------------------------------------------------------------*

const C_galgas_type_descriptor * GALGAS_rezlock_5F_map::staticTypeDescriptor (void) const {
  return & kTypeDescriptor_GALGAS_rezlock_5F_map ;
}

//---------------------------------------------------------------------------*

AC_GALGAS_root * GALGAS_rezlock_5F_map::clonedObject (void) const {
  AC_GALGAS_root * result = NULL ;
  if (isValid ()) {
    macroMyNew (result, GALGAS_rezlock_5F_map (*this)) ;
  }
  return result ;
}

//---------------------------------------------------------------------------*

GALGAS_rezlock_5F_map GALGAS_rezlock_5F_map::extractObject (const GALGAS_object & inObject,
                                                            C_Compiler * inCompiler,
                                                            const GALGAS_location & inErrorLocation
                                                            COMMA_LOCATION_ARGS) {
  GALGAS_rezlock_5F_map result ;
  const GALGAS_rezlock_5F_map * p = (const GALGAS_rezlock_5F_map *) inObject.embeddedObject () ;
  if (NULL != p) {
    if (NULL != dynamic_cast <const GALGAS_rezlock_5F_map *> (p)) {
      result = *p ;
    }else{
      inCompiler->extractObjectError (inErrorLocation, "rezlock_map", p->dynamicTypeDescriptor () COMMA_THERE) ;
    }  
  }
  return result ;
}

//---------------------------------------------------------------------------*
//                                                                           *
//                          Routine 'gen_rez_table'                          *
//                                                                           *
//---------------------------------------------------------------------------*

void routine_gen_5F_rez_5F_table (GALGAS_rezlock_5F_map inArgument_rezlocks,
                                  GALGAS_resource_5F_map inArgument_rez,
                                  GALGAS_uint_36__34_ inArgument_tpn,
                                  GALGAS_string & outArgument_table,
                                  C_Compiler * inCompiler
                                  COMMA_UNUSED_LOCATION_ARGS) {
  outArgument_table.drop () ; // Release 'out' argument
  //-------- @assignmentInstructionForGeneration
  outArgument_table = GALGAS_string ("") ;
  //-------- @localVariableOrConstantDeclarationWithSourceExpressionForGeneration
  GALGAS_uint var_i = GALGAS_uint ((PMUInt32) 0U) ;
  //-------- @foreachInstructionForGeneration
  cEnumerator_resource_5F_map enumerator_592 (inArgument_rez, true) ;
  //--- simple foreach instruction
  while (enumerator_592.hasCurrentObject ()) {
    //-------- @ifInstructionForGeneration
    if (inArgument_rezlocks.reader_hasKey (enumerator_592.current_lkey (HERE).reader_string (SOURCE_FILE_AT_LINE (24)) COMMA_SOURCE_FILE_AT_LINE (24)).isValidAndTrue ()) {
      //-------- @localVariableDeclarationForGeneration
      GALGAS_uint_36__34_ var_time ;
      //-------- @methodCallInstructionForGeneration
      inArgument_rezlocks.method_get (enumerator_592.current_lkey (HERE), var_time, inCompiler COMMA_SOURCE_FILE_AT_LINE (26)) ;
      //-------- END @methodCallInstructionForGeneration
      //-------- @appendInstructionForGeneration
      outArgument_table.dotAssign_operation (GALGAS_string ("    ").operator_concat (var_time.divide_operation (inArgument_tpn, inCompiler COMMA_SOURCE_FILE_AT_LINE (27)).reader_string (SOURCE_FILE_AT_LINE (27)) COMMA_SOURCE_FILE_AT_LINE (27)) COMMA_SOURCE_FILE_AT_LINE (27)) ;
    }else{
      //-------- @appendInstructionForGeneration
      outArgument_table.dotAssign_operation (GALGAS_string ("    0") COMMA_SOURCE_FILE_AT_LINE (29)) ;
    }
    //-------- @ifInstructionForGeneration
    if (GALGAS_bool (kIsStrictInf, var_i.objectCompare (inArgument_rez.reader_count (SOURCE_FILE_AT_LINE (31)).substract_operation (GALGAS_uint ((PMUInt32) 1U), inCompiler COMMA_SOURCE_FILE_AT_LINE (31)))).isValidAndTrue ()) {
      //-------- @appendInstructionForGeneration
      outArgument_table.dotAssign_operation (GALGAS_string (",\n") COMMA_SOURCE_FILE_AT_LINE (32)) ;
    }else{
      //-------- @appendInstructionForGeneration
      outArgument_table.dotAssign_operation (GALGAS_string ("\n") COMMA_SOURCE_FILE_AT_LINE (34)) ;
    }
    //-------- @incrementInstructionForGeneration
    var_i.increment_operation (inCompiler COMMA_SOURCE_FILE_AT_LINE (36)) ;
    enumerator_592.gotoNextObject () ;
  }
}


//---------------------------------------------------------------------------*

enumComparisonResult GALGAS_timing_5F_prot::objectCompare (const GALGAS_timing_5F_prot & inOperand) const {
  enumComparisonResult result = kOperandEqual ;
  const cPtr_timing_5F_prot * p = (const cPtr_timing_5F_prot *) mObjectPtr ;
  macroNullOrValidSharedObject (p, const cPtr_timing_5F_prot) ;
  const cPtr_timing_5F_prot * q = (const cPtr_timing_5F_prot *) inOperand.mObjectPtr ;
  macroNullOrValidSharedObject (q, const cPtr_timing_5F_prot) ;
  if (kOperandEqual == result) {
    result = p->mAttribute_location.objectCompare (q->mAttribute_location) ;
  }
  return result ;
}


//---------------------------------------------------------------------------*

GALGAS_timing_5F_prot::GALGAS_timing_5F_prot (void) :
AC_GALGAS_class () {
}

//---------------------------------------------------------------------------*

GALGAS_timing_5F_prot::GALGAS_timing_5F_prot (const cPtr_timing_5F_prot * inSourcePtr) :
AC_GALGAS_class (inSourcePtr) {
  macroNullOrValidSharedObject (inSourcePtr, const cPtr_timing_5F_prot) ;
}

//---------------------------------------------------------------------------*

GALGAS_location GALGAS_timing_5F_prot::reader_location (UNUSED_LOCATION_ARGS) const {
  GALGAS_location result ;
  if (NULL != mObjectPtr) {
    const cPtr_timing_5F_prot * p = (const cPtr_timing_5F_prot *) mObjectPtr ;
    macroValidSharedObject (p, const cPtr_timing_5F_prot) ;
    result = p->mAttribute_location ;
  }
  return result ;
}

//---------------------------------------------------------------------------*

void GALGAS_timing_5F_prot::method_generate (GALGAS_config inArgument0,
                                             GALGAS_string & outArgument1,
                                             GALGAS_string & outArgument2,
                                             GALGAS_string inArgument3,
                                             GALGAS_resource_5F_map inArgument4,
                                             C_Compiler * inCompiler
                                             COMMA_LOCATION_ARGS) const {
  if (mObjectPtr != NULL) {
    const cPtr_timing_5F_prot * p = (const cPtr_timing_5F_prot *) mObjectPtr ;
    macroValidSharedObject (p, const cPtr_timing_5F_prot) ;
    p->method_generate (inArgument0, outArgument1, outArgument2, inArgument3, inArgument4, inCompiler COMMA_THERE) ;
  }
}

//---------------------------------------------------------------------------*
//                   Pointer class for @timing_prot class                    *
//---------------------------------------------------------------------------*

cPtr_timing_5F_prot::cPtr_timing_5F_prot (const GALGAS_location & in_location
                                          COMMA_LOCATION_ARGS) :
acPtr_class (THERE),
mAttribute_location (in_location) {
}



//---------------------------------------------------------------------------*
//                                                                           *
//                             @timing_prot type                             *
//                                                                           *
//---------------------------------------------------------------------------*

const C_galgas_type_descriptor
kTypeDescriptor_GALGAS_timing_5F_prot ("timing_prot",
                                       NULL) ;

//---------------------------------------------------------------------------*

const C_galgas_type_descriptor * GALGAS_timing_5F_prot::staticTypeDescriptor (void) const {
  return & kTypeDescriptor_GALGAS_timing_5F_prot ;
}

//---------------------------------------------------------------------------*

AC_GALGAS_root * GALGAS_timing_5F_prot::clonedObject (void) const {
  AC_GALGAS_root * result = NULL ;
  if (isValid ()) {
    macroMyNew (result, GALGAS_timing_5F_prot (*this)) ;
  }
  return result ;
}

//---------------------------------------------------------------------------*

GALGAS_timing_5F_prot GALGAS_timing_5F_prot::extractObject (const GALGAS_object & inObject,
                                                            C_Compiler * inCompiler,
                                                            const GALGAS_location & inErrorLocation
                                                            COMMA_LOCATION_ARGS) {
  GALGAS_timing_5F_prot result ;
  const GALGAS_timing_5F_prot * p = (const GALGAS_timing_5F_prot *) inObject.embeddedObject () ;
  if (NULL != p) {
    if (NULL != dynamic_cast <const GALGAS_timing_5F_prot *> (p)) {
      result = *p ;
    }else{
      inCompiler->extractObjectError (inErrorLocation, "timing_prot", p->dynamicTypeDescriptor () COMMA_THERE) ;
    }  
  }
  return result ;
}

//---------------------------------------------------------------------------*

enumComparisonResult GALGAS_false_5F_timing_5F_prot::objectCompare (const GALGAS_false_5F_timing_5F_prot & inOperand) const {
  return (isValid () && inOperand.isValid ()) ? kOperandEqual : kOperandNotValid ;
}


//---------------------------------------------------------------------------*

GALGAS_false_5F_timing_5F_prot::GALGAS_false_5F_timing_5F_prot (void) :
GALGAS_timing_5F_prot () {
}

//---------------------------------------------------------------------------*

GALGAS_false_5F_timing_5F_prot::GALGAS_false_5F_timing_5F_prot (const cPtr_false_5F_timing_5F_prot * inSourcePtr) :
GALGAS_timing_5F_prot (inSourcePtr) {
  macroNullOrValidSharedObject (inSourcePtr, const cPtr_false_5F_timing_5F_prot) ;
}

//---------------------------------------------------------------------------*

GALGAS_false_5F_timing_5F_prot GALGAS_false_5F_timing_5F_prot::constructor_new (const GALGAS_location & inAttribute_location
                                                                                COMMA_LOCATION_ARGS) {
  GALGAS_false_5F_timing_5F_prot result ;
  if (inAttribute_location.isValid ()) {
    macroMyNew (result.mObjectPtr, cPtr_false_5F_timing_5F_prot (inAttribute_location COMMA_THERE)) ;
  }
  return result ;
}

//---------------------------------------------------------------------------*

void GALGAS_false_5F_timing_5F_prot::insulate (LOCATION_ARGS) {
  if (isValid () && (mObjectPtr->retainCount () > 1)) {
    cPtr_false_5F_timing_5F_prot * p = (cPtr_false_5F_timing_5F_prot *) mObjectPtr ;
    macroValidSharedObject (p, cPtr_false_5F_timing_5F_prot) ;
    cPtr_false_5F_timing_5F_prot * r = NULL ;
    macroMyNew (r, cPtr_false_5F_timing_5F_prot (p->mAttribute_location COMMA_THERE)) ;
    macroAssignSharedObject (mObjectPtr, r) ;
    macroDetachSharedObject (r) ;
  }
}

//---------------------------------------------------------------------------*

void cPtr_false_5F_timing_5F_prot::method_generate (GALGAS_config /* inArgument_cfg */,
                                                    GALGAS_string & outArgument_result,
                                                    GALGAS_string & outArgument_st_5F_name,
                                                    GALGAS_string /* inArgument_name */,
                                                    GALGAS_resource_5F_map /* inArgument_rez */,
                                                    C_Compiler * /* inCompiler */
                                                    COMMA_UNUSED_LOCATION_ARGS) const {
  outArgument_result.drop () ; // Release 'out' argument
  outArgument_st_5F_name.drop () ; // Release 'out' argument
  //-------- @assignmentInstructionForGeneration
  outArgument_result = GALGAS_string ("") ;
  //-------- @assignmentInstructionForGeneration
  outArgument_st_5F_name = GALGAS_string ("NULL") ;
}

//---------------------------------------------------------------------------*
//                Pointer class for @false_timing_prot class                 *
//---------------------------------------------------------------------------*

cPtr_false_5F_timing_5F_prot::cPtr_false_5F_timing_5F_prot (const GALGAS_location & in_location
                                                            COMMA_LOCATION_ARGS) :
cPtr_timing_5F_prot (in_location COMMA_THERE) {
}

//---------------------------------------------------------------------------*

const C_galgas_type_descriptor * cPtr_false_5F_timing_5F_prot::classDescriptor (void) const {
  return & kTypeDescriptor_GALGAS_false_5F_timing_5F_prot ;
}

void cPtr_false_5F_timing_5F_prot::description (C_String & ioString,
                                                const PMSInt32 inIndentation) const {
  ioString << "[@false_timing_prot:" ;
  mAttribute_location.description (ioString, inIndentation+1) ;
  ioString << "]" ;
}



//---------------------------------------------------------------------------*
//                                                                           *
//                          @false_timing_prot type                          *
//                                                                           *
//---------------------------------------------------------------------------*

const C_galgas_type_descriptor
kTypeDescriptor_GALGAS_false_5F_timing_5F_prot ("false_timing_prot",
                                                & kTypeDescriptor_GALGAS_timing_5F_prot) ;

//---------------------------------------------------------------------------*

const C_galgas_type_descriptor * GALGAS_false_5F_timing_5F_prot::staticTypeDescriptor (void) const {
  return & kTypeDescriptor_GALGAS_false_5F_timing_5F_prot ;
}

//---------------------------------------------------------------------------*

AC_GALGAS_root * GALGAS_false_5F_timing_5F_prot::clonedObject (void) const {
  AC_GALGAS_root * result = NULL ;
  if (isValid ()) {
    macroMyNew (result, GALGAS_false_5F_timing_5F_prot (*this)) ;
  }
  return result ;
}

//---------------------------------------------------------------------------*

GALGAS_false_5F_timing_5F_prot GALGAS_false_5F_timing_5F_prot::extractObject (const GALGAS_object & inObject,
                                                                              C_Compiler * inCompiler,
                                                                              const GALGAS_location & inErrorLocation
                                                                              COMMA_LOCATION_ARGS) {
  GALGAS_false_5F_timing_5F_prot result ;
  const GALGAS_false_5F_timing_5F_prot * p = (const GALGAS_false_5F_timing_5F_prot *) inObject.embeddedObject () ;
  if (NULL != p) {
    if (NULL != dynamic_cast <const GALGAS_false_5F_timing_5F_prot *> (p)) {
      result = *p ;
    }else{
      inCompiler->extractObjectError (inErrorLocation, "false_timing_prot", p->dynamicTypeDescriptor () COMMA_THERE) ;
    }  
  }
  return result ;
}

//---------------------------------------------------------------------------*

enumComparisonResult GALGAS_timing_5F_prot_5F_isr::objectCompare (const GALGAS_timing_5F_prot_5F_isr & inOperand) const {
  enumComparisonResult result = GALGAS_timing_5F_prot::objectCompare (inOperand) ;
  const cPtr_timing_5F_prot_5F_isr * p = (const cPtr_timing_5F_prot_5F_isr *) mObjectPtr ;
  macroNullOrValidSharedObject (p, const cPtr_timing_5F_prot_5F_isr) ;
  const cPtr_timing_5F_prot_5F_isr * q = (const cPtr_timing_5F_prot_5F_isr *) inOperand.mObjectPtr ;
  macroNullOrValidSharedObject (q, const cPtr_timing_5F_prot_5F_isr) ;
  if (kOperandEqual == result) {
    result = p->mAttribute_exe_5F_time.objectCompare (q->mAttribute_exe_5F_time) ;
  }
  if (kOperandEqual == result) {
    result = p->mAttribute_time_5F_frame.objectCompare (q->mAttribute_time_5F_frame) ;
  }
  if (kOperandEqual == result) {
    result = p->mAttribute_os_5F_it_5F_lock.objectCompare (q->mAttribute_os_5F_it_5F_lock) ;
  }
  if (kOperandEqual == result) {
    result = p->mAttribute_all_5F_it_5F_lock.objectCompare (q->mAttribute_all_5F_it_5F_lock) ;
  }
  if (kOperandEqual == result) {
    result = p->mAttribute_rezlocks.objectCompare (q->mAttribute_rezlocks) ;
  }
  return result ;
}


//---------------------------------------------------------------------------*

GALGAS_timing_5F_prot_5F_isr::GALGAS_timing_5F_prot_5F_isr (void) :
GALGAS_timing_5F_prot () {
}

//---------------------------------------------------------------------------*

GALGAS_timing_5F_prot_5F_isr::GALGAS_timing_5F_prot_5F_isr (const cPtr_timing_5F_prot_5F_isr * inSourcePtr) :
GALGAS_timing_5F_prot (inSourcePtr) {
  macroNullOrValidSharedObject (inSourcePtr, const cPtr_timing_5F_prot_5F_isr) ;
}

//---------------------------------------------------------------------------*

GALGAS_timing_5F_prot_5F_isr GALGAS_timing_5F_prot_5F_isr::constructor_new (const GALGAS_location & inAttribute_location,
                                                                            const GALGAS_basic_5F_type & inAttribute_exe_5F_time,
                                                                            const GALGAS_basic_5F_type & inAttribute_time_5F_frame,
                                                                            const GALGAS_basic_5F_type & inAttribute_os_5F_it_5F_lock,
                                                                            const GALGAS_basic_5F_type & inAttribute_all_5F_it_5F_lock,
                                                                            const GALGAS_rezlock_5F_map & inAttribute_rezlocks
                                                                            COMMA_LOCATION_ARGS) {
  GALGAS_timing_5F_prot_5F_isr result ;
  if (inAttribute_location.isValid () && inAttribute_exe_5F_time.isValid () && inAttribute_time_5F_frame.isValid () && inAttribute_os_5F_it_5F_lock.isValid () && inAttribute_all_5F_it_5F_lock.isValid () && inAttribute_rezlocks.isValid ()) {
    macroMyNew (result.mObjectPtr, cPtr_timing_5F_prot_5F_isr (inAttribute_location, inAttribute_exe_5F_time, inAttribute_time_5F_frame, inAttribute_os_5F_it_5F_lock, inAttribute_all_5F_it_5F_lock, inAttribute_rezlocks COMMA_THERE)) ;
  }
  return result ;
}

//---------------------------------------------------------------------------*

void GALGAS_timing_5F_prot_5F_isr::insulate (LOCATION_ARGS) {
  if (isValid () && (mObjectPtr->retainCount () > 1)) {
    cPtr_timing_5F_prot_5F_isr * p = (cPtr_timing_5F_prot_5F_isr *) mObjectPtr ;
    macroValidSharedObject (p, cPtr_timing_5F_prot_5F_isr) ;
    cPtr_timing_5F_prot_5F_isr * r = NULL ;
    macroMyNew (r, cPtr_timing_5F_prot_5F_isr (p->mAttribute_location, p->mAttribute_exe_5F_time, p->mAttribute_time_5F_frame, p->mAttribute_os_5F_it_5F_lock, p->mAttribute_all_5F_it_5F_lock, p->mAttribute_rezlocks COMMA_THERE)) ;
    macroAssignSharedObject (mObjectPtr, r) ;
    macroDetachSharedObject (r) ;
  }
}

//---------------------------------------------------------------------------*

void cPtr_timing_5F_prot_5F_isr::method_generate (GALGAS_config inArgument_cfg,
                                                  GALGAS_string & outArgument_result,
                                                  GALGAS_string & outArgument_st_5F_name,
                                                  GALGAS_string inArgument_name,
                                                  GALGAS_resource_5F_map inArgument_rez,
                                                  C_Compiler * inCompiler
                                                  COMMA_UNUSED_LOCATION_ARGS) const {
  outArgument_result.drop () ; // Release 'out' argument
  outArgument_st_5F_name.drop () ; // Release 'out' argument
  //-------- @localVariableOrConstantDeclarationWithSourceExpressionForGeneration
  GALGAS_uint_36__34_ var_tpn = GALGAS_uint_36__34_ ((PMUInt64) 1ULL) ;
  //-------- @ifInstructionForGeneration
  if (inArgument_cfg.reader_hasKey (GALGAS_string ("wd_ticks_per_ns") COMMA_SOURCE_FILE_AT_LINE (156)).isValidAndTrue ()) {
    //-------- @localVariableDeclarationForGeneration
    GALGAS_basic_5F_type var_val ;
    //-------- @methodCallInstructionForGeneration
    inArgument_cfg.method_get (GALGAS_lstring::constructor_new (GALGAS_string ("wd_ticks_per_ns"), inCompiler->here () COMMA_SOURCE_FILE_AT_LINE (158)), var_val, inCompiler COMMA_SOURCE_FILE_AT_LINE (158)) ;
    //-------- END @methodCallInstructionForGeneration
    //-------- @structuredCastInstructionForGeneration
    if (var_val.isValid ()) {
      if (var_val.dynamicTypeDescriptor () == & kTypeDescriptor_GALGAS_uint_36__34__5F_class) {
        GALGAS_uint_36__34__5F_class cast_4878_ui ((cPtr_uint_36__34__5F_class *) var_val.ptr ()) ;
        //-------- @assignmentInstructionForGeneration
        var_tpn = cast_4878_ui.reader_value (SOURCE_FILE_AT_LINE (160)) ;
      }
    }
  }
  //-------- @assignmentInstructionForGeneration
  outArgument_result = function_template_5F_string (GALGAS_string ("code"), GALGAS_string ("timing_protection"), inCompiler COMMA_SOURCE_FILE_AT_LINE (164)) ;
  //-------- @structuredCastInstructionForGeneration
  if (mAttribute_exe_5F_time.isValid ()) {
    if (mAttribute_exe_5F_time.dynamicTypeDescriptor () == & kTypeDescriptor_GALGAS_uint_36__34__5F_class) {
      GALGAS_uint_36__34__5F_class cast_5070_et ((cPtr_uint_36__34__5F_class *) mAttribute_exe_5F_time.ptr ()) ;
      //-------- @assignmentInstructionForGeneration
      outArgument_result = outArgument_result.reader_stringByReplacingStringByString (GALGAS_string ("$EXE_BUDGET$"), cast_5070_et.reader_value (SOURCE_FILE_AT_LINE (168)).divide_operation (var_tpn, inCompiler COMMA_SOURCE_FILE_AT_LINE (168)).reader_string (SOURCE_FILE_AT_LINE (168)), inCompiler COMMA_SOURCE_FILE_AT_LINE (168)) ;
    }
  }
  //-------- @structuredCastInstructionForGeneration
  if (mAttribute_time_5F_frame.isValid ()) {
    if (mAttribute_time_5F_frame.dynamicTypeDescriptor () == & kTypeDescriptor_GALGAS_uint_36__34__5F_class) {
      GALGAS_uint_36__34__5F_class cast_5263_tf ((cPtr_uint_36__34__5F_class *) mAttribute_time_5F_frame.ptr ()) ;
      //-------- @assignmentInstructionForGeneration
      outArgument_result = outArgument_result.reader_stringByReplacingStringByString (GALGAS_string ("$TIME_FRAME$"), cast_5263_tf.reader_value (SOURCE_FILE_AT_LINE (172)).divide_operation (var_tpn, inCompiler COMMA_SOURCE_FILE_AT_LINE (172)).reader_string (SOURCE_FILE_AT_LINE (172)), inCompiler COMMA_SOURCE_FILE_AT_LINE (172)) ;
    }
  }
  //-------- @structuredCastInstructionForGeneration
  if (mAttribute_os_5F_it_5F_lock.isValid ()) {
    if (mAttribute_os_5F_it_5F_lock.dynamicTypeDescriptor () == & kTypeDescriptor_GALGAS_uint_36__34__5F_class) {
      GALGAS_uint_36__34__5F_class cast_5457_oil ((cPtr_uint_36__34__5F_class *) mAttribute_os_5F_it_5F_lock.ptr ()) ;
      //-------- @assignmentInstructionForGeneration
      outArgument_result = outArgument_result.reader_stringByReplacingStringByString (GALGAS_string ("$OS_IT_LOCK$"), cast_5457_oil.reader_value (SOURCE_FILE_AT_LINE (176)).divide_operation (var_tpn, inCompiler COMMA_SOURCE_FILE_AT_LINE (176)).reader_string (SOURCE_FILE_AT_LINE (176)), inCompiler COMMA_SOURCE_FILE_AT_LINE (176)) ;
    }
  }
  //-------- @structuredCastInstructionForGeneration
  if (mAttribute_all_5F_it_5F_lock.isValid ()) {
    if (mAttribute_all_5F_it_5F_lock.dynamicTypeDescriptor () == & kTypeDescriptor_GALGAS_uint_36__34__5F_class) {
      GALGAS_uint_36__34__5F_class cast_5653_ail ((cPtr_uint_36__34__5F_class *) mAttribute_all_5F_it_5F_lock.ptr ()) ;
      //-------- @assignmentInstructionForGeneration
      outArgument_result = outArgument_result.reader_stringByReplacingStringByString (GALGAS_string ("$ALL_IT_LOCK$"), cast_5653_ail.reader_value (SOURCE_FILE_AT_LINE (180)).divide_operation (var_tpn, inCompiler COMMA_SOURCE_FILE_AT_LINE (180)).reader_string (SOURCE_FILE_AT_LINE (180)), inCompiler COMMA_SOURCE_FILE_AT_LINE (180)) ;
    }
  }
  //-------- @assignmentInstructionForGeneration
  outArgument_st_5F_name = GALGAS_string ("isr_").operator_concat (inArgument_name COMMA_SOURCE_FILE_AT_LINE (183)).operator_concat (GALGAS_string ("_timing_prot") COMMA_SOURCE_FILE_AT_LINE (183)) ;
  //-------- @assignmentInstructionForGeneration
  outArgument_result = outArgument_result.reader_stringByReplacingStringByString (GALGAS_string ("$TIMING_PROT$"), outArgument_st_5F_name, inCompiler COMMA_SOURCE_FILE_AT_LINE (184)) ;
  //-------- @localVariableOrConstantDeclarationWithSourceExpressionForGeneration
  GALGAS_string var_table_5F_name = GALGAS_string ("isr_").operator_concat (inArgument_name COMMA_SOURCE_FILE_AT_LINE (186)).operator_concat (GALGAS_string ("_rez_lock_time") COMMA_SOURCE_FILE_AT_LINE (186)) ;
  //-------- @localVariableOrConstantDeclarationWithSourceExpressionForGeneration
  GALGAS_string var_table = GALGAS_string ("") ;
  { //-------- @routineCallInstructionForGeneration
  routine_gen_5F_rez_5F_table (mAttribute_rezlocks, inArgument_rez, var_tpn, var_table, inCompiler COMMA_SOURCE_FILE_AT_LINE (188)) ;
  } //-------- @routineCallInstructionForGeneration
  //-------- @ifInstructionForGeneration
  if (GALGAS_bool (kIsStrictSup, inArgument_rez.reader_count (SOURCE_FILE_AT_LINE (190)).objectCompare (GALGAS_uint ((PMUInt32) 0U))).isValidAndTrue ()) {
    //-------- @assignmentInstructionForGeneration
    var_table = GALGAS_string ("tpl_time ").operator_concat (var_table_5F_name COMMA_SOURCE_FILE_AT_LINE (191)).operator_concat (GALGAS_string ("[") COMMA_SOURCE_FILE_AT_LINE (191)).operator_concat (inArgument_rez.reader_count (SOURCE_FILE_AT_LINE (191)).reader_string (SOURCE_FILE_AT_LINE (191)) COMMA_SOURCE_FILE_AT_LINE (191)).operator_concat (GALGAS_string ("] = {\n") COMMA_SOURCE_FILE_AT_LINE (191)).operator_concat (var_table COMMA_SOURCE_FILE_AT_LINE (191)).operator_concat (GALGAS_string ("};") COMMA_SOURCE_FILE_AT_LINE (191)) ;
  }
  //-------- @assignmentInstructionForGeneration
  outArgument_result = outArgument_result.reader_stringByReplacingStringByString (GALGAS_string ("$LOCK_TIME_TABLE$"), var_table, inCompiler COMMA_SOURCE_FILE_AT_LINE (194)) ;
  //-------- @ifInstructionForGeneration
  if (GALGAS_bool (kIsStrictSup, inArgument_rez.reader_count (SOURCE_FILE_AT_LINE (196)).objectCompare (GALGAS_uint ((PMUInt32) 0U))).isValidAndTrue ()) {
    //-------- @assignmentInstructionForGeneration
    outArgument_result = outArgument_result.reader_stringByReplacingStringByString (GALGAS_string ("$REZ_LOCK_TIME$"), var_table_5F_name, inCompiler COMMA_SOURCE_FILE_AT_LINE (197)) ;
  }else{
    //-------- @assignmentInstructionForGeneration
    outArgument_result = outArgument_result.reader_stringByReplacingStringByString (GALGAS_string ("$REZ_LOCK_TIME$"), GALGAS_string ("NULL"), inCompiler COMMA_SOURCE_FILE_AT_LINE (199)) ;
  }
  //-------- @assignmentInstructionForGeneration
  outArgument_st_5F_name = GALGAS_string ("&").operator_concat (outArgument_st_5F_name COMMA_SOURCE_FILE_AT_LINE (202)) ;
}

//---------------------------------------------------------------------------*

GALGAS_basic_5F_type GALGAS_timing_5F_prot_5F_isr::reader_exe_5F_time (UNUSED_LOCATION_ARGS) const {
  GALGAS_basic_5F_type result ;
  if (NULL != mObjectPtr) {
    const cPtr_timing_5F_prot_5F_isr * p = (const cPtr_timing_5F_prot_5F_isr *) mObjectPtr ;
    macroValidSharedObject (p, const cPtr_timing_5F_prot_5F_isr) ;
    result = p->mAttribute_exe_5F_time ;
  }
  return result ;
}

//---------------------------------------------------------------------------*

GALGAS_basic_5F_type GALGAS_timing_5F_prot_5F_isr::reader_time_5F_frame (UNUSED_LOCATION_ARGS) const {
  GALGAS_basic_5F_type result ;
  if (NULL != mObjectPtr) {
    const cPtr_timing_5F_prot_5F_isr * p = (const cPtr_timing_5F_prot_5F_isr *) mObjectPtr ;
    macroValidSharedObject (p, const cPtr_timing_5F_prot_5F_isr) ;
    result = p->mAttribute_time_5F_frame ;
  }
  return result ;
}

//---------------------------------------------------------------------------*

GALGAS_basic_5F_type GALGAS_timing_5F_prot_5F_isr::reader_os_5F_it_5F_lock (UNUSED_LOCATION_ARGS) const {
  GALGAS_basic_5F_type result ;
  if (NULL != mObjectPtr) {
    const cPtr_timing_5F_prot_5F_isr * p = (const cPtr_timing_5F_prot_5F_isr *) mObjectPtr ;
    macroValidSharedObject (p, const cPtr_timing_5F_prot_5F_isr) ;
    result = p->mAttribute_os_5F_it_5F_lock ;
  }
  return result ;
}

//---------------------------------------------------------------------------*

GALGAS_basic_5F_type GALGAS_timing_5F_prot_5F_isr::reader_all_5F_it_5F_lock (UNUSED_LOCATION_ARGS) const {
  GALGAS_basic_5F_type result ;
  if (NULL != mObjectPtr) {
    const cPtr_timing_5F_prot_5F_isr * p = (const cPtr_timing_5F_prot_5F_isr *) mObjectPtr ;
    macroValidSharedObject (p, const cPtr_timing_5F_prot_5F_isr) ;
    result = p->mAttribute_all_5F_it_5F_lock ;
  }
  return result ;
}

//---------------------------------------------------------------------------*

GALGAS_rezlock_5F_map GALGAS_timing_5F_prot_5F_isr::reader_rezlocks (UNUSED_LOCATION_ARGS) const {
  GALGAS_rezlock_5F_map result ;
  if (NULL != mObjectPtr) {
    const cPtr_timing_5F_prot_5F_isr * p = (const cPtr_timing_5F_prot_5F_isr *) mObjectPtr ;
    macroValidSharedObject (p, const cPtr_timing_5F_prot_5F_isr) ;
    result = p->mAttribute_rezlocks ;
  }
  return result ;
}

//---------------------------------------------------------------------------*
//                 Pointer class for @timing_prot_isr class                  *
//---------------------------------------------------------------------------*

cPtr_timing_5F_prot_5F_isr::cPtr_timing_5F_prot_5F_isr (const GALGAS_location & in_location,
                                                        const GALGAS_basic_5F_type & in_exe_5F_time,
                                                        const GALGAS_basic_5F_type & in_time_5F_frame,
                                                        const GALGAS_basic_5F_type & in_os_5F_it_5F_lock,
                                                        const GALGAS_basic_5F_type & in_all_5F_it_5F_lock,
                                                        const GALGAS_rezlock_5F_map & in_rezlocks
                                                        COMMA_LOCATION_ARGS) :
cPtr_timing_5F_prot (in_location COMMA_THERE),
mAttribute_exe_5F_time (in_exe_5F_time),
mAttribute_time_5F_frame (in_time_5F_frame),
mAttribute_os_5F_it_5F_lock (in_os_5F_it_5F_lock),
mAttribute_all_5F_it_5F_lock (in_all_5F_it_5F_lock),
mAttribute_rezlocks (in_rezlocks) {
}

//---------------------------------------------------------------------------*

const C_galgas_type_descriptor * cPtr_timing_5F_prot_5F_isr::classDescriptor (void) const {
  return & kTypeDescriptor_GALGAS_timing_5F_prot_5F_isr ;
}

void cPtr_timing_5F_prot_5F_isr::description (C_String & ioString,
                                              const PMSInt32 inIndentation) const {
  ioString << "[@timing_prot_isr:" ;
  mAttribute_location.description (ioString, inIndentation+1) ;
  ioString << ", " ;
  mAttribute_exe_5F_time.description (ioString, inIndentation+1) ;
  ioString << ", " ;
  mAttribute_time_5F_frame.description (ioString, inIndentation+1) ;
  ioString << ", " ;
  mAttribute_os_5F_it_5F_lock.description (ioString, inIndentation+1) ;
  ioString << ", " ;
  mAttribute_all_5F_it_5F_lock.description (ioString, inIndentation+1) ;
  ioString << ", " ;
  mAttribute_rezlocks.description (ioString, inIndentation+1) ;
  ioString << "]" ;
}



//---------------------------------------------------------------------------*
//                                                                           *
//                           @timing_prot_isr type                           *
//                                                                           *
//---------------------------------------------------------------------------*

const C_galgas_type_descriptor
kTypeDescriptor_GALGAS_timing_5F_prot_5F_isr ("timing_prot_isr",
                                              & kTypeDescriptor_GALGAS_timing_5F_prot) ;

//---------------------------------------------------------------------------*

const C_galgas_type_descriptor * GALGAS_timing_5F_prot_5F_isr::staticTypeDescriptor (void) const {
  return & kTypeDescriptor_GALGAS_timing_5F_prot_5F_isr ;
}

//---------------------------------------------------------------------------*

AC_GALGAS_root * GALGAS_timing_5F_prot_5F_isr::clonedObject (void) const {
  AC_GALGAS_root * result = NULL ;
  if (isValid ()) {
    macroMyNew (result, GALGAS_timing_5F_prot_5F_isr (*this)) ;
  }
  return result ;
}

//---------------------------------------------------------------------------*

GALGAS_timing_5F_prot_5F_isr GALGAS_timing_5F_prot_5F_isr::extractObject (const GALGAS_object & inObject,
                                                                          C_Compiler * inCompiler,
                                                                          const GALGAS_location & inErrorLocation
                                                                          COMMA_LOCATION_ARGS) {
  GALGAS_timing_5F_prot_5F_isr result ;
  const GALGAS_timing_5F_prot_5F_isr * p = (const GALGAS_timing_5F_prot_5F_isr *) inObject.embeddedObject () ;
  if (NULL != p) {
    if (NULL != dynamic_cast <const GALGAS_timing_5F_prot_5F_isr *> (p)) {
      result = *p ;
    }else{
      inCompiler->extractObjectError (inErrorLocation, "timing_prot_isr", p->dynamicTypeDescriptor () COMMA_THERE) ;
    }  
  }
  return result ;
}

//---------------------------------------------------------------------------*

enumComparisonResult GALGAS_timing_5F_prot_5F_task::objectCompare (const GALGAS_timing_5F_prot_5F_task & inOperand) const {
  enumComparisonResult result = GALGAS_timing_5F_prot::objectCompare (inOperand) ;
  const cPtr_timing_5F_prot_5F_task * p = (const cPtr_timing_5F_prot_5F_task *) mObjectPtr ;
  macroNullOrValidSharedObject (p, const cPtr_timing_5F_prot_5F_task) ;
  const cPtr_timing_5F_prot_5F_task * q = (const cPtr_timing_5F_prot_5F_task *) inOperand.mObjectPtr ;
  macroNullOrValidSharedObject (q, const cPtr_timing_5F_prot_5F_task) ;
  if (kOperandEqual == result) {
    result = p->mAttribute_exe_5F_budget.objectCompare (q->mAttribute_exe_5F_budget) ;
  }
  if (kOperandEqual == result) {
    result = p->mAttribute_time_5F_frame.objectCompare (q->mAttribute_time_5F_frame) ;
  }
  if (kOperandEqual == result) {
    result = p->mAttribute_os_5F_it_5F_lock.objectCompare (q->mAttribute_os_5F_it_5F_lock) ;
  }
  if (kOperandEqual == result) {
    result = p->mAttribute_all_5F_it_5F_lock.objectCompare (q->mAttribute_all_5F_it_5F_lock) ;
  }
  if (kOperandEqual == result) {
    result = p->mAttribute_rezlocks.objectCompare (q->mAttribute_rezlocks) ;
  }
  return result ;
}


//---------------------------------------------------------------------------*

GALGAS_timing_5F_prot_5F_task::GALGAS_timing_5F_prot_5F_task (void) :
GALGAS_timing_5F_prot () {
}

//---------------------------------------------------------------------------*

GALGAS_timing_5F_prot_5F_task::GALGAS_timing_5F_prot_5F_task (const cPtr_timing_5F_prot_5F_task * inSourcePtr) :
GALGAS_timing_5F_prot (inSourcePtr) {
  macroNullOrValidSharedObject (inSourcePtr, const cPtr_timing_5F_prot_5F_task) ;
}

//---------------------------------------------------------------------------*

GALGAS_timing_5F_prot_5F_task GALGAS_timing_5F_prot_5F_task::constructor_new (const GALGAS_location & inAttribute_location,
                                                                              const GALGAS_basic_5F_type & inAttribute_exe_5F_budget,
                                                                              const GALGAS_basic_5F_type & inAttribute_time_5F_frame,
                                                                              const GALGAS_basic_5F_type & inAttribute_os_5F_it_5F_lock,
                                                                              const GALGAS_basic_5F_type & inAttribute_all_5F_it_5F_lock,
                                                                              const GALGAS_rezlock_5F_map & inAttribute_rezlocks
                                                                              COMMA_LOCATION_ARGS) {
  GALGAS_timing_5F_prot_5F_task result ;
  if (inAttribute_location.isValid () && inAttribute_exe_5F_budget.isValid () && inAttribute_time_5F_frame.isValid () && inAttribute_os_5F_it_5F_lock.isValid () && inAttribute_all_5F_it_5F_lock.isValid () && inAttribute_rezlocks.isValid ()) {
    macroMyNew (result.mObjectPtr, cPtr_timing_5F_prot_5F_task (inAttribute_location, inAttribute_exe_5F_budget, inAttribute_time_5F_frame, inAttribute_os_5F_it_5F_lock, inAttribute_all_5F_it_5F_lock, inAttribute_rezlocks COMMA_THERE)) ;
  }
  return result ;
}

//---------------------------------------------------------------------------*

void GALGAS_timing_5F_prot_5F_task::insulate (LOCATION_ARGS) {
  if (isValid () && (mObjectPtr->retainCount () > 1)) {
    cPtr_timing_5F_prot_5F_task * p = (cPtr_timing_5F_prot_5F_task *) mObjectPtr ;
    macroValidSharedObject (p, cPtr_timing_5F_prot_5F_task) ;
    cPtr_timing_5F_prot_5F_task * r = NULL ;
    macroMyNew (r, cPtr_timing_5F_prot_5F_task (p->mAttribute_location, p->mAttribute_exe_5F_budget, p->mAttribute_time_5F_frame, p->mAttribute_os_5F_it_5F_lock, p->mAttribute_all_5F_it_5F_lock, p->mAttribute_rezlocks COMMA_THERE)) ;
    macroAssignSharedObject (mObjectPtr, r) ;
    macroDetachSharedObject (r) ;
  }
}

//---------------------------------------------------------------------------*

void cPtr_timing_5F_prot_5F_task::method_generate (GALGAS_config inArgument_cfg,
                                                   GALGAS_string & outArgument_result,
                                                   GALGAS_string & outArgument_st_5F_name,
                                                   GALGAS_string inArgument_name,
                                                   GALGAS_resource_5F_map inArgument_rez,
                                                   C_Compiler * inCompiler
                                                   COMMA_UNUSED_LOCATION_ARGS) const {
  outArgument_result.drop () ; // Release 'out' argument
  outArgument_st_5F_name.drop () ; // Release 'out' argument
  //-------- @localVariableOrConstantDeclarationWithSourceExpressionForGeneration
  GALGAS_uint_36__34_ var_tpn = GALGAS_uint_36__34_ ((PMUInt64) 1ULL) ;
  //-------- @ifInstructionForGeneration
  if (inArgument_cfg.reader_hasKey (GALGAS_string ("wd_ticks_per_ns") COMMA_SOURCE_FILE_AT_LINE (91)).isValidAndTrue ()) {
    //-------- @localVariableDeclarationForGeneration
    GALGAS_basic_5F_type var_val ;
    //-------- @methodCallInstructionForGeneration
    inArgument_cfg.method_get (GALGAS_lstring::constructor_new (GALGAS_string ("wd_ticks_per_ns"), inCompiler->here () COMMA_SOURCE_FILE_AT_LINE (93)), var_val, inCompiler COMMA_SOURCE_FILE_AT_LINE (93)) ;
    //-------- END @methodCallInstructionForGeneration
    //-------- @structuredCastInstructionForGeneration
    if (var_val.isValid ()) {
      if (var_val.dynamicTypeDescriptor () == & kTypeDescriptor_GALGAS_uint_36__34__5F_class) {
        GALGAS_uint_36__34__5F_class cast_2524_ui ((cPtr_uint_36__34__5F_class *) var_val.ptr ()) ;
        //-------- @assignmentInstructionForGeneration
        var_tpn = cast_2524_ui.reader_value (SOURCE_FILE_AT_LINE (95)) ;
      }
    }
  }
  //-------- @assignmentInstructionForGeneration
  outArgument_result = function_template_5F_string (GALGAS_string ("code"), GALGAS_string ("timing_protection"), inCompiler COMMA_SOURCE_FILE_AT_LINE (99)) ;
  //-------- @structuredCastInstructionForGeneration
  if (mAttribute_exe_5F_budget.isValid ()) {
    if (mAttribute_exe_5F_budget.dynamicTypeDescriptor () == & kTypeDescriptor_GALGAS_uint_36__34__5F_class) {
      GALGAS_uint_36__34__5F_class cast_2718_eb ((cPtr_uint_36__34__5F_class *) mAttribute_exe_5F_budget.ptr ()) ;
      //-------- @assignmentInstructionForGeneration
      outArgument_result = outArgument_result.reader_stringByReplacingStringByString (GALGAS_string ("$EXE_BUDGET$"), cast_2718_eb.reader_value (SOURCE_FILE_AT_LINE (103)).divide_operation (var_tpn, inCompiler COMMA_SOURCE_FILE_AT_LINE (103)).reader_string (SOURCE_FILE_AT_LINE (103)), inCompiler COMMA_SOURCE_FILE_AT_LINE (103)) ;
    }
  }
  //-------- @structuredCastInstructionForGeneration
  if (mAttribute_time_5F_frame.isValid ()) {
    if (mAttribute_time_5F_frame.dynamicTypeDescriptor () == & kTypeDescriptor_GALGAS_uint_36__34__5F_class) {
      GALGAS_uint_36__34__5F_class cast_2911_tf ((cPtr_uint_36__34__5F_class *) mAttribute_time_5F_frame.ptr ()) ;
      //-------- @assignmentInstructionForGeneration
      outArgument_result = outArgument_result.reader_stringByReplacingStringByString (GALGAS_string ("$TIME_FRAME$"), cast_2911_tf.reader_value (SOURCE_FILE_AT_LINE (107)).divide_operation (var_tpn, inCompiler COMMA_SOURCE_FILE_AT_LINE (107)).reader_string (SOURCE_FILE_AT_LINE (107)), inCompiler COMMA_SOURCE_FILE_AT_LINE (107)) ;
    }
  }
  //-------- @structuredCastInstructionForGeneration
  if (mAttribute_os_5F_it_5F_lock.isValid ()) {
    if (mAttribute_os_5F_it_5F_lock.dynamicTypeDescriptor () == & kTypeDescriptor_GALGAS_uint_36__34__5F_class) {
      GALGAS_uint_36__34__5F_class cast_3105_oil ((cPtr_uint_36__34__5F_class *) mAttribute_os_5F_it_5F_lock.ptr ()) ;
      //-------- @assignmentInstructionForGeneration
      outArgument_result = outArgument_result.reader_stringByReplacingStringByString (GALGAS_string ("$OS_IT_LOCK$"), cast_3105_oil.reader_value (SOURCE_FILE_AT_LINE (111)).divide_operation (var_tpn, inCompiler COMMA_SOURCE_FILE_AT_LINE (111)).reader_string (SOURCE_FILE_AT_LINE (111)), inCompiler COMMA_SOURCE_FILE_AT_LINE (111)) ;
    }
  }
  //-------- @structuredCastInstructionForGeneration
  if (mAttribute_all_5F_it_5F_lock.isValid ()) {
    if (mAttribute_all_5F_it_5F_lock.dynamicTypeDescriptor () == & kTypeDescriptor_GALGAS_uint_36__34__5F_class) {
      GALGAS_uint_36__34__5F_class cast_3301_ail ((cPtr_uint_36__34__5F_class *) mAttribute_all_5F_it_5F_lock.ptr ()) ;
      //-------- @assignmentInstructionForGeneration
      outArgument_result = outArgument_result.reader_stringByReplacingStringByString (GALGAS_string ("$ALL_IT_LOCK$"), cast_3301_ail.reader_value (SOURCE_FILE_AT_LINE (115)).divide_operation (var_tpn, inCompiler COMMA_SOURCE_FILE_AT_LINE (115)).reader_string (SOURCE_FILE_AT_LINE (115)), inCompiler COMMA_SOURCE_FILE_AT_LINE (115)) ;
    }
  }
  //-------- @assignmentInstructionForGeneration
  outArgument_st_5F_name = GALGAS_string ("task_").operator_concat (inArgument_name COMMA_SOURCE_FILE_AT_LINE (118)).operator_concat (GALGAS_string ("_timing_prot") COMMA_SOURCE_FILE_AT_LINE (118)) ;
  //-------- @assignmentInstructionForGeneration
  outArgument_result = outArgument_result.reader_stringByReplacingStringByString (GALGAS_string ("$TIMING_PROT$"), outArgument_st_5F_name, inCompiler COMMA_SOURCE_FILE_AT_LINE (119)) ;
  //-------- @localVariableOrConstantDeclarationWithSourceExpressionForGeneration
  GALGAS_string var_table_5F_name = GALGAS_string ("task_").operator_concat (inArgument_name COMMA_SOURCE_FILE_AT_LINE (121)).operator_concat (GALGAS_string ("_rez_lock_time") COMMA_SOURCE_FILE_AT_LINE (121)) ;
  //-------- @localVariableOrConstantDeclarationWithSourceExpressionForGeneration
  GALGAS_string var_table = GALGAS_string ("") ;
  { //-------- @routineCallInstructionForGeneration
  routine_gen_5F_rez_5F_table (mAttribute_rezlocks, inArgument_rez, var_tpn, var_table, inCompiler COMMA_SOURCE_FILE_AT_LINE (123)) ;
  } //-------- @routineCallInstructionForGeneration
  //-------- @ifInstructionForGeneration
  if (GALGAS_bool (kIsStrictSup, inArgument_rez.reader_count (SOURCE_FILE_AT_LINE (125)).objectCompare (GALGAS_uint ((PMUInt32) 0U))).isValidAndTrue ()) {
    //-------- @assignmentInstructionForGeneration
    var_table = GALGAS_string ("tpl_time ").operator_concat (var_table_5F_name COMMA_SOURCE_FILE_AT_LINE (126)).operator_concat (GALGAS_string ("[") COMMA_SOURCE_FILE_AT_LINE (126)).operator_concat (inArgument_rez.reader_count (SOURCE_FILE_AT_LINE (126)).reader_string (SOURCE_FILE_AT_LINE (126)) COMMA_SOURCE_FILE_AT_LINE (126)).operator_concat (GALGAS_string ("] = {\n") COMMA_SOURCE_FILE_AT_LINE (126)).operator_concat (var_table COMMA_SOURCE_FILE_AT_LINE (126)).operator_concat (GALGAS_string ("};") COMMA_SOURCE_FILE_AT_LINE (126)) ;
  }
  //-------- @assignmentInstructionForGeneration
  outArgument_result = outArgument_result.reader_stringByReplacingStringByString (GALGAS_string ("$LOCK_TIME_TABLE$"), var_table, inCompiler COMMA_SOURCE_FILE_AT_LINE (129)) ;
  //-------- @ifInstructionForGeneration
  if (GALGAS_bool (kIsStrictSup, inArgument_rez.reader_count (SOURCE_FILE_AT_LINE (131)).objectCompare (GALGAS_uint ((PMUInt32) 0U))).isValidAndTrue ()) {
    //-------- @assignmentInstructionForGeneration
    outArgument_result = outArgument_result.reader_stringByReplacingStringByString (GALGAS_string ("$REZ_LOCK_TIME$"), var_table_5F_name, inCompiler COMMA_SOURCE_FILE_AT_LINE (132)) ;
  }else{
    //-------- @assignmentInstructionForGeneration
    outArgument_result = outArgument_result.reader_stringByReplacingStringByString (GALGAS_string ("$REZ_LOCK_TIME$"), GALGAS_string ("NULL"), inCompiler COMMA_SOURCE_FILE_AT_LINE (134)) ;
  }
  //-------- @assignmentInstructionForGeneration
  outArgument_st_5F_name = GALGAS_string ("&").operator_concat (outArgument_st_5F_name COMMA_SOURCE_FILE_AT_LINE (137)) ;
}

//---------------------------------------------------------------------------*

GALGAS_basic_5F_type GALGAS_timing_5F_prot_5F_task::reader_exe_5F_budget (UNUSED_LOCATION_ARGS) const {
  GALGAS_basic_5F_type result ;
  if (NULL != mObjectPtr) {
    const cPtr_timing_5F_prot_5F_task * p = (const cPtr_timing_5F_prot_5F_task *) mObjectPtr ;
    macroValidSharedObject (p, const cPtr_timing_5F_prot_5F_task) ;
    result = p->mAttribute_exe_5F_budget ;
  }
  return result ;
}

//---------------------------------------------------------------------------*

GALGAS_basic_5F_type GALGAS_timing_5F_prot_5F_task::reader_time_5F_frame (UNUSED_LOCATION_ARGS) const {
  GALGAS_basic_5F_type result ;
  if (NULL != mObjectPtr) {
    const cPtr_timing_5F_prot_5F_task * p = (const cPtr_timing_5F_prot_5F_task *) mObjectPtr ;
    macroValidSharedObject (p, const cPtr_timing_5F_prot_5F_task) ;
    result = p->mAttribute_time_5F_frame ;
  }
  return result ;
}

//---------------------------------------------------------------------------*

GALGAS_basic_5F_type GALGAS_timing_5F_prot_5F_task::reader_os_5F_it_5F_lock (UNUSED_LOCATION_ARGS) const {
  GALGAS_basic_5F_type result ;
  if (NULL != mObjectPtr) {
    const cPtr_timing_5F_prot_5F_task * p = (const cPtr_timing_5F_prot_5F_task *) mObjectPtr ;
    macroValidSharedObject (p, const cPtr_timing_5F_prot_5F_task) ;
    result = p->mAttribute_os_5F_it_5F_lock ;
  }
  return result ;
}

//---------------------------------------------------------------------------*

GALGAS_basic_5F_type GALGAS_timing_5F_prot_5F_task::reader_all_5F_it_5F_lock (UNUSED_LOCATION_ARGS) const {
  GALGAS_basic_5F_type result ;
  if (NULL != mObjectPtr) {
    const cPtr_timing_5F_prot_5F_task * p = (const cPtr_timing_5F_prot_5F_task *) mObjectPtr ;
    macroValidSharedObject (p, const cPtr_timing_5F_prot_5F_task) ;
    result = p->mAttribute_all_5F_it_5F_lock ;
  }
  return result ;
}

//---------------------------------------------------------------------------*

GALGAS_rezlock_5F_map GALGAS_timing_5F_prot_5F_task::reader_rezlocks (UNUSED_LOCATION_ARGS) const {
  GALGAS_rezlock_5F_map result ;
  if (NULL != mObjectPtr) {
    const cPtr_timing_5F_prot_5F_task * p = (const cPtr_timing_5F_prot_5F_task *) mObjectPtr ;
    macroValidSharedObject (p, const cPtr_timing_5F_prot_5F_task) ;
    result = p->mAttribute_rezlocks ;
  }
  return result ;
}

//---------------------------------------------------------------------------*
//                 Pointer class for @timing_prot_task class                 *
//---------------------------------------------------------------------------*

cPtr_timing_5F_prot_5F_task::cPtr_timing_5F_prot_5F_task (const GALGAS_location & in_location,
                                                          const GALGAS_basic_5F_type & in_exe_5F_budget,
                                                          const GALGAS_basic_5F_type & in_time_5F_frame,
                                                          const GALGAS_basic_5F_type & in_os_5F_it_5F_lock,
                                                          const GALGAS_basic_5F_type & in_all_5F_it_5F_lock,
                                                          const GALGAS_rezlock_5F_map & in_rezlocks
                                                          COMMA_LOCATION_ARGS) :
cPtr_timing_5F_prot (in_location COMMA_THERE),
mAttribute_exe_5F_budget (in_exe_5F_budget),
mAttribute_time_5F_frame (in_time_5F_frame),
mAttribute_os_5F_it_5F_lock (in_os_5F_it_5F_lock),
mAttribute_all_5F_it_5F_lock (in_all_5F_it_5F_lock),
mAttribute_rezlocks (in_rezlocks) {
}

//---------------------------------------------------------------------------*

const C_galgas_type_descriptor * cPtr_timing_5F_prot_5F_task::classDescriptor (void) const {
  return & kTypeDescriptor_GALGAS_timing_5F_prot_5F_task ;
}

void cPtr_timing_5F_prot_5F_task::description (C_String & ioString,
                                               const PMSInt32 inIndentation) const {
  ioString << "[@timing_prot_task:" ;
  mAttribute_location.description (ioString, inIndentation+1) ;
  ioString << ", " ;
  mAttribute_exe_5F_budget.description (ioString, inIndentation+1) ;
  ioString << ", " ;
  mAttribute_time_5F_frame.description (ioString, inIndentation+1) ;
  ioString << ", " ;
  mAttribute_os_5F_it_5F_lock.description (ioString, inIndentation+1) ;
  ioString << ", " ;
  mAttribute_all_5F_it_5F_lock.description (ioString, inIndentation+1) ;
  ioString << ", " ;
  mAttribute_rezlocks.description (ioString, inIndentation+1) ;
  ioString << "]" ;
}



//---------------------------------------------------------------------------*
//                                                                           *
//                          @timing_prot_task type                           *
//                                                                           *
//---------------------------------------------------------------------------*

const C_galgas_type_descriptor
kTypeDescriptor_GALGAS_timing_5F_prot_5F_task ("timing_prot_task",
                                               & kTypeDescriptor_GALGAS_timing_5F_prot) ;

//---------------------------------------------------------------------------*

const C_galgas_type_descriptor * GALGAS_timing_5F_prot_5F_task::staticTypeDescriptor (void) const {
  return & kTypeDescriptor_GALGAS_timing_5F_prot_5F_task ;
}

//---------------------------------------------------------------------------*

AC_GALGAS_root * GALGAS_timing_5F_prot_5F_task::clonedObject (void) const {
  AC_GALGAS_root * result = NULL ;
  if (isValid ()) {
    macroMyNew (result, GALGAS_timing_5F_prot_5F_task (*this)) ;
  }
  return result ;
}

//---------------------------------------------------------------------------*

GALGAS_timing_5F_prot_5F_task GALGAS_timing_5F_prot_5F_task::extractObject (const GALGAS_object & inObject,
                                                                            C_Compiler * inCompiler,
                                                                            const GALGAS_location & inErrorLocation
                                                                            COMMA_LOCATION_ARGS) {
  GALGAS_timing_5F_prot_5F_task result ;
  const GALGAS_timing_5F_prot_5F_task * p = (const GALGAS_timing_5F_prot_5F_task *) inObject.embeddedObject () ;
  if (NULL != p) {
    if (NULL != dynamic_cast <const GALGAS_timing_5F_prot_5F_task *> (p)) {
      result = *p ;
    }else{
      inCompiler->extractObjectError (inErrorLocation, "timing_prot_task", p->dynamicTypeDescriptor () COMMA_THERE) ;
    }  
  }
  return result ;
}

//---------------------------------------------------------------------------*

enumComparisonResult GALGAS_void_5F_timing_5F_prot::objectCompare (const GALGAS_void_5F_timing_5F_prot & inOperand) const {
  return (isValid () && inOperand.isValid ()) ? kOperandEqual : kOperandNotValid ;
}


//---------------------------------------------------------------------------*

GALGAS_void_5F_timing_5F_prot::GALGAS_void_5F_timing_5F_prot (void) :
GALGAS_timing_5F_prot () {
}

//---------------------------------------------------------------------------*

GALGAS_void_5F_timing_5F_prot::GALGAS_void_5F_timing_5F_prot (const cPtr_void_5F_timing_5F_prot * inSourcePtr) :
GALGAS_timing_5F_prot (inSourcePtr) {
  macroNullOrValidSharedObject (inSourcePtr, const cPtr_void_5F_timing_5F_prot) ;
}

//---------------------------------------------------------------------------*

GALGAS_void_5F_timing_5F_prot GALGAS_void_5F_timing_5F_prot::constructor_new (const GALGAS_location & inAttribute_location
                                                                              COMMA_LOCATION_ARGS) {
  GALGAS_void_5F_timing_5F_prot result ;
  if (inAttribute_location.isValid ()) {
    macroMyNew (result.mObjectPtr, cPtr_void_5F_timing_5F_prot (inAttribute_location COMMA_THERE)) ;
  }
  return result ;
}

//---------------------------------------------------------------------------*

void GALGAS_void_5F_timing_5F_prot::insulate (LOCATION_ARGS) {
  if (isValid () && (mObjectPtr->retainCount () > 1)) {
    cPtr_void_5F_timing_5F_prot * p = (cPtr_void_5F_timing_5F_prot *) mObjectPtr ;
    macroValidSharedObject (p, cPtr_void_5F_timing_5F_prot) ;
    cPtr_void_5F_timing_5F_prot * r = NULL ;
    macroMyNew (r, cPtr_void_5F_timing_5F_prot (p->mAttribute_location COMMA_THERE)) ;
    macroAssignSharedObject (mObjectPtr, r) ;
    macroDetachSharedObject (r) ;
  }
}

//---------------------------------------------------------------------------*

void cPtr_void_5F_timing_5F_prot::method_generate (GALGAS_config /* inArgument_cfg */,
                                                   GALGAS_string & outArgument_result,
                                                   GALGAS_string & outArgument_st_5F_name,
                                                   GALGAS_string /* inArgument_name */,
                                                   GALGAS_resource_5F_map /* inArgument_rez */,
                                                   C_Compiler * /* inCompiler */
                                                   COMMA_UNUSED_LOCATION_ARGS) const {
  outArgument_result.drop () ; // Release 'out' argument
  outArgument_st_5F_name.drop () ; // Release 'out' argument
  //-------- @assignmentInstructionForGeneration
  outArgument_result = GALGAS_string ("") ;
  //-------- @assignmentInstructionForGeneration
  outArgument_st_5F_name = GALGAS_string ("NULL") ;
}

//---------------------------------------------------------------------------*
//                 Pointer class for @void_timing_prot class                 *
//---------------------------------------------------------------------------*

cPtr_void_5F_timing_5F_prot::cPtr_void_5F_timing_5F_prot (const GALGAS_location & in_location
                                                          COMMA_LOCATION_ARGS) :
cPtr_timing_5F_prot (in_location COMMA_THERE) {
}

//---------------------------------------------------------------------------*

const C_galgas_type_descriptor * cPtr_void_5F_timing_5F_prot::classDescriptor (void) const {
  return & kTypeDescriptor_GALGAS_void_5F_timing_5F_prot ;
}

void cPtr_void_5F_timing_5F_prot::description (C_String & ioString,
                                               const PMSInt32 inIndentation) const {
  ioString << "[@void_timing_prot:" ;
  mAttribute_location.description (ioString, inIndentation+1) ;
  ioString << "]" ;
}



//---------------------------------------------------------------------------*
//                                                                           *
//                          @void_timing_prot type                           *
//                                                                           *
//---------------------------------------------------------------------------*

const C_galgas_type_descriptor
kTypeDescriptor_GALGAS_void_5F_timing_5F_prot ("void_timing_prot",
                                               & kTypeDescriptor_GALGAS_timing_5F_prot) ;

//---------------------------------------------------------------------------*

const C_galgas_type_descriptor * GALGAS_void_5F_timing_5F_prot::staticTypeDescriptor (void) const {
  return & kTypeDescriptor_GALGAS_void_5F_timing_5F_prot ;
}

//---------------------------------------------------------------------------*

AC_GALGAS_root * GALGAS_void_5F_timing_5F_prot::clonedObject (void) const {
  AC_GALGAS_root * result = NULL ;
  if (isValid ()) {
    macroMyNew (result, GALGAS_void_5F_timing_5F_prot (*this)) ;
  }
  return result ;
}

//---------------------------------------------------------------------------*

GALGAS_void_5F_timing_5F_prot GALGAS_void_5F_timing_5F_prot::extractObject (const GALGAS_object & inObject,
                                                                            C_Compiler * inCompiler,
                                                                            const GALGAS_location & inErrorLocation
                                                                            COMMA_LOCATION_ARGS) {
  GALGAS_void_5F_timing_5F_prot result ;
  const GALGAS_void_5F_timing_5F_prot * p = (const GALGAS_void_5F_timing_5F_prot *) inObject.embeddedObject () ;
  if (NULL != p) {
    if (NULL != dynamic_cast <const GALGAS_void_5F_timing_5F_prot *> (p)) {
      result = *p ;
    }else{
      inCompiler->extractObjectError (inErrorLocation, "void_timing_prot", p->dynamicTypeDescriptor () COMMA_THERE) ;
    }  
  }
  return result ;
}

//--- START OF USER ZONE 2


//--- END OF USER ZONE 2


