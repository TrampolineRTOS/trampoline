//---------------------------------------------------------------------------*
//                                                                           *
//                       File 'trace_description.cpp'                        *
//                        Generated by version 1.9.6                         *
//                    november 30th, 2009, at 10h44'41"                      *
//                                                                           *
//---------------------------------------------------------------------------*

//--- START OF USER ZONE 1


//--- END OF USER ZONE 1

//---------------------------------------------------------------------------*

#include "version_libpm.h"
#if LIBPM_VERSION != 621
  #error "This file has been compiled with a version of GALGAS different than the version of libpm"
#endif

//---------------------------------------------------------------------------*

#include <typeinfo>
#include "utilities/MF_MemoryControl.h"
#include "files/C_TextFileWrite.h"
#include "galgas/C_galgas_CLI_Options.h"
#include "trace_description.h"

//---------------------------------------------------------------------------*

#ifndef DO_NOT_GENERATE_CHECKINGS
  #define SOURCE_FILE_AT_LINE(line) "trace_description.ggs", line
  #define COMMA_SOURCE_FILE_AT_LINE(line) , SOURCE_FILE_AT_LINE(line)
#else
  #define SOURCE_FILE_AT_LINE(line) 
  #define COMMA_SOURCE_FILE_AT_LINE(line) 
#endif


//--- START OF USER ZONE 2


//--- END OF USER ZONE 2

//---------------------------------------------------------------------------*
//                                                                           *
//             Implementation of routine "generate_description"              *
//                                                                           *
//---------------------------------------------------------------------------*

void routine_generate_description (C_Compiler & inLexique,
                                const GGS_root_obj   var_cas_cpu COMMA_UNUSED_LOCATION_ARGS) {
  #ifdef DEBUG_TRACE_ENABLED
    printf ("ENTER routine_generate_description at %s:%d\n", __FILE__, __LINE__) ;
  #endif
  GGS_trace  var_cas_tr = var_cas_cpu.reader_os (inLexique COMMA_SOURCE_FILE_AT_LINE (34)).reader_trace (inLexique COMMA_SOURCE_FILE_AT_LINE (34)) ;
  { const GGS_trace _var_2844 = var_cas_tr ; // CAST instruction
    if (_var_2844.getPtr () != NULL) {
      macroValidPointer (_var_2844.getPtr ()) ;
      if (typeid (cPtr_trace_on) == typeid (* (_var_2844.getPtr ()))) {
        const GGS_trace_on var_cas_to (_var_2844.getPtr ()) ;
        const GGS_bool cond_2829 = function_get_bool (inLexique, var_cas_to.reader_desc (inLexique COMMA_SOURCE_FILE_AT_LINE (37)), GGS_bool (false) COMMA_SOURCE_FILE_AT_LINE (37)) ;
        if (cond_2829.isBuiltAndTrue ()) {
          GGS_string var_cas_res = GGS_string ("<\?xml version=\"1.0\" encoding=\"ISO-8859-1\"\?>\n") ;
          var_cas_res.appendCString ("<app name=\"") ;
          var_cas_res.dotAssign_operation (function_project_name (inLexique COMMA_SOURCE_FILE_AT_LINE (39)).reader_lastPathComponent ()) ;
          var_cas_res.appendCString ("\">\n") ;
          GGS_tasks_by_type  var_cas_stasks = GGS_tasks_by_type ::constructor_emptySortedList () ;
          {
            GGS_task_map::cEnumerator enumerator_1019 (var_cas_cpu.reader_tasks (inLexique COMMA_SOURCE_FILE_AT_LINE (43)), true) ;
            const GGS_task_map::cElement * operand_1019 = NULL ;
            while (((operand_1019 = enumerator_1019.nextObject ()))) {
              macroValidPointer (operand_1019) ;
              const GGS_bool cond_1126 = (operand_1019->mInfo.task.reader_events (inLexique COMMA_SOURCE_FILE_AT_LINE (44)).reader_length ()).operator_strictSup (GGS_uint (0U)) ;
              if (cond_1126.isBuiltAndTrue ()) {
                var_cas_stasks.addAssign_operation (GGS_uint (0U), operand_1019->mKey.reader_string (inLexique COMMA_SOURCE_FILE_AT_LINE (45))) ;
              }else if (cond_1126.isBuiltAndFalse ()) {
                var_cas_stasks.addAssign_operation (GGS_uint (1U), operand_1019->mKey.reader_string (inLexique COMMA_SOURCE_FILE_AT_LINE (47))) ;
              }
            }
          }
          GGS_uint  var_cas_id = GGS_uint (0U) ;
          const GGS_bool cond_1799 = function_get_bool (inLexique, var_cas_to.reader_trace_task (inLexique COMMA_SOURCE_FILE_AT_LINE (52)), GGS_bool (true) COMMA_SOURCE_FILE_AT_LINE (52)) ;
          if (cond_1799.isBuiltAndTrue ()) {
            var_cas_res.appendCString ("<tasks>\n") ;
            GGS_tasks_by_type  var_cas_stasks = GGS_tasks_by_type ::constructor_emptySortedList () ;
            {
              GGS_task_map::cEnumerator enumerator_1424 (var_cas_cpu.reader_tasks (inLexique COMMA_SOURCE_FILE_AT_LINE (56)), true) ;
              const GGS_task_map::cElement * operand_1424 = NULL ;
              while (((operand_1424 = enumerator_1424.nextObject ()))) {
                macroValidPointer (operand_1424) ;
                const GGS_bool cond_1537 = (operand_1424->mInfo.task.reader_events (inLexique COMMA_SOURCE_FILE_AT_LINE (57)).reader_length ()).operator_strictSup (GGS_uint (0U)) ;
                if (cond_1537.isBuiltAndTrue ()) {
                  var_cas_stasks.addAssign_operation (GGS_uint (0U), operand_1424->mKey.reader_string (inLexique COMMA_SOURCE_FILE_AT_LINE (58))) ;
                }else if (cond_1537.isBuiltAndFalse ()) {
                  var_cas_stasks.addAssign_operation (GGS_uint (1U), operand_1424->mKey.reader_string (inLexique COMMA_SOURCE_FILE_AT_LINE (60))) ;
                }
              }
            }
            {
              GGS_tasks_by_type::cEnumerator enumerator_1647 (var_cas_stasks, true) ;
              const GGS_tasks_by_type::cElement * operand_1647 = NULL ;
              while (((operand_1647 = enumerator_1647.nextObject ()))) {
                macroValidPointer (operand_1647) ;
                var_cas_res.appendCString ("  <task name=\"") ;
                var_cas_res.dotAssign_operation (operand_1647->name) ;
                var_cas_res.appendCString ("\" id=\"") ;
                var_cas_res.dotAssign_operation (var_cas_id.reader_string (inLexique COMMA_SOURCE_FILE_AT_LINE (65))) ;
                var_cas_res.appendCString ("\"/>\n") ;
                var_cas_id.increment_operation (inLexique COMMA_SOURCE_FILE_AT_LINE (66)) ;
              }
            }
            var_cas_res.appendCString ("</tasks>\n") ;
          }
          var_cas_id = var_cas_stasks.reader_length () ;
          const GGS_bool cond_2095 = function_get_bool (inLexique, var_cas_to.reader_trace_isr (inLexique COMMA_SOURCE_FILE_AT_LINE (72)), GGS_bool (true) COMMA_SOURCE_FILE_AT_LINE (72)) ;
          if (cond_2095.isBuiltAndTrue ()) {
            var_cas_res.appendCString ("<isrs>\n") ;
            {
              GGS_isr_map::cEnumerator enumerator_1928 (var_cas_cpu.reader_isrs (inLexique COMMA_SOURCE_FILE_AT_LINE (74)), true) ;
              const GGS_isr_map::cElement * operand_1928 = NULL ;
              while (((operand_1928 = enumerator_1928.nextObject ()))) {
                macroValidPointer (operand_1928) ;
                var_cas_res.appendCString ("  <isr name=\"") ;
                var_cas_res.dotAssign_operation (operand_1928->mKey.reader_string (inLexique COMMA_SOURCE_FILE_AT_LINE (75))) ;
                var_cas_res.appendCString ("\" id=\"") ;
                var_cas_res.dotAssign_operation (var_cas_id.reader_string (inLexique COMMA_SOURCE_FILE_AT_LINE (75))) ;
                var_cas_res.appendCString ("\"/>\n") ;
                var_cas_id.increment_operation (inLexique COMMA_SOURCE_FILE_AT_LINE (76)) ;
              }
            }
            var_cas_res.appendCString ("</isrs>\n") ;
          }
          const GGS_bool cond_2404 = function_get_bool (inLexique, var_cas_to.reader_trace_resource (inLexique COMMA_SOURCE_FILE_AT_LINE (81)), GGS_bool (true) COMMA_SOURCE_FILE_AT_LINE (81)) ;
          if (cond_2404.isBuiltAndTrue ()) {
            var_cas_id = GGS_uint (0U) ;
            var_cas_res.appendCString ("<resources>\n") ;
            {
              GGS_resource_map::cEnumerator enumerator_2222 (var_cas_cpu.reader_resources (inLexique COMMA_SOURCE_FILE_AT_LINE (84)), true) ;
              const GGS_resource_map::cElement * operand_2222 = NULL ;
              while (((operand_2222 = enumerator_2222.nextObject ()))) {
                macroValidPointer (operand_2222) ;
                var_cas_res.appendCString ("  <resource name=\"") ;
                var_cas_res.dotAssign_operation (operand_2222->mKey.reader_string (inLexique COMMA_SOURCE_FILE_AT_LINE (85))) ;
                var_cas_res.appendCString ("\" id=\"") ;
                var_cas_res.dotAssign_operation (var_cas_id.reader_string (inLexique COMMA_SOURCE_FILE_AT_LINE (85))) ;
                var_cas_res.appendCString ("\"/>\n") ;
                var_cas_id.increment_operation (inLexique COMMA_SOURCE_FILE_AT_LINE (86)) ;
              }
            }
            var_cas_res.appendCString ("</resources>\n") ;
          }
          const GGS_bool cond_2694 = function_get_bool (inLexique, var_cas_to.reader_trace_alarm (inLexique COMMA_SOURCE_FILE_AT_LINE (91)), GGS_bool (true) COMMA_SOURCE_FILE_AT_LINE (91)) ;
          if (cond_2694.isBuiltAndTrue ()) {
            var_cas_id = GGS_uint (0U) ;
            var_cas_res.appendCString ("<alarms>\n") ;
            {
              GGS_alarm_map::cEnumerator enumerator_2521 (var_cas_cpu.reader_alarms (inLexique COMMA_SOURCE_FILE_AT_LINE (94)), true) ;
              const GGS_alarm_map::cElement * operand_2521 = NULL ;
              while (((operand_2521 = enumerator_2521.nextObject ()))) {
                macroValidPointer (operand_2521) ;
                var_cas_res.appendCString ("  <alarm name=\"") ;
                var_cas_res.dotAssign_operation (operand_2521->mKey.reader_string (inLexique COMMA_SOURCE_FILE_AT_LINE (95))) ;
                var_cas_res.appendCString ("\" id=\"") ;
                var_cas_res.dotAssign_operation (var_cas_id.reader_string (inLexique COMMA_SOURCE_FILE_AT_LINE (95))) ;
                var_cas_res.appendCString ("\"/>\n") ;
                var_cas_id.increment_operation (inLexique COMMA_SOURCE_FILE_AT_LINE (96)) ;
              }
            }
            var_cas_res.appendCString ("</alarms>\n") ;
          }
          var_cas_res.appendCString ("</app>\n") ;
          GGS_string var_cas_desc_file_name = (function_project_name (inLexique COMMA_SOURCE_FILE_AT_LINE (103))).operator_concat (GGS_string (".desc")) ;
          const GGS_string temp_2804 = var_cas_res ;
          if (temp_2804.isBuilt ()) {
            temp_2804 (HERE)->method_writeToFile (inLexique, var_cas_desc_file_name COMMA_SOURCE_FILE_AT_LINE (104)) ;
          }
        }
      }else{
      }
    }
  }
  #ifdef DEBUG_TRACE_ENABLED
    printf ("LEAVE routine_generate_description\n") ;
  #endif
}

//---------------------------------------------------------------------------*

