//---------------------------------------------------------------------------*
//                                                                           *
//                           File 'xml_types.cpp'                            *
//                 Generated by version GALGAS_BETA_VERSION                  *
//                      june 12th, 2009, at 14h44'46"                        *
//                                                                           *
//---------------------------------------------------------------------------*

//--- START OF USER ZONE 1


//--- END OF USER ZONE 1

//---------------------------------------------------------------------------*

#include "version_libpm.h"
#if LIBPM_VERSION != 502
  #error "This file has been compiled with a version of GALGAS different than the version of libpm"
#endif

//---------------------------------------------------------------------------*

#include <typeinfo>
#include "utilities/MF_MemoryControl.h"
#include "files/C_TextFileWrite.h"
#include "xml_types.h"

//---------------------------------------------------------------------------*

#ifndef DO_NOT_GENERATE_CHECKINGS
  #define SOURCE_FILE_AT_LINE(line) "xml_types.ggs", line
  #define COMMA_SOURCE_FILE_AT_LINE(line) , SOURCE_FILE_AT_LINE(line)
#else
  #define SOURCE_FILE_AT_LINE(line) 
  #define COMMA_SOURCE_FILE_AT_LINE(line) 
#endif


//--- START OF USER ZONE 2


//--- END OF USER ZONE 2

//---------------------------------------------------------------------------*
//                                                                           *
//                   Class for 'xmlNodeType' Enumeration                     *
//                                                                           *
//---------------------------------------------------------------------------*

bool GGS_xmlNodeType::
isBuilt (void) const {
  return mValue > kNotBuilt ;
}

//---------------------------------------------------------------------------*

GGS_bool GGS_xmlNodeType::
operator_isEqual (const GGS_xmlNodeType inOperand) const {
  return GGS_bool (isBuilt () && inOperand.isBuilt (),
                   mValue == inOperand.mValue) ;
}

//---------------------------------------------------------------------------*

GGS_bool GGS_xmlNodeType::
operator_isNotEqual (const GGS_xmlNodeType inOperand) const {
  return GGS_bool (isBuilt () && inOperand.isBuilt (),
                   mValue != inOperand.mValue) ;
}

//---------------------------------------------------------------------------*

GGS_bool GGS_xmlNodeType::
operator_infOrEqual (const GGS_xmlNodeType inOperand) const {
  return GGS_bool (isBuilt () && inOperand.isBuilt (),
                   mValue <= inOperand.mValue) ;
}

//---------------------------------------------------------------------------*

GGS_bool GGS_xmlNodeType::
operator_supOrEqual (const GGS_xmlNodeType inOperand) const {
  return GGS_bool (isBuilt () && inOperand.isBuilt (),
                   mValue >= inOperand.mValue) ;
}

//---------------------------------------------------------------------------*

GGS_bool GGS_xmlNodeType::
operator_strictInf (const GGS_xmlNodeType inOperand) const {
  return GGS_bool (isBuilt () && inOperand.isBuilt (),
                   mValue < inOperand.mValue) ;
}

//---------------------------------------------------------------------------*

GGS_bool GGS_xmlNodeType::
operator_strictSup (const GGS_xmlNodeType inOperand) const {
  return GGS_bool (isBuilt () && inOperand.isBuilt (),
                   mValue > inOperand.mValue) ;
}

//---------------------------------------------------------------------------*

GGS_string GGS_xmlNodeType::
reader_description (C_Compiler & /* inLexique */
                    COMMA_UNUSED_LOCATION_ARGS,
                    const sint32 /* inIndentation */) const {
  C_String s ;
  s << "<enum @xmlNodeType" ;
  switch (mValue) {
  case enum_comment:
    s << " comment>" ;
    break ;
  case enum_element:
    s << " element>" ;
    break ;
  case enum_text:
    s << " text>" ;
    break ;
  case enum_void:
    s << " void>" ;
    break ;
  case kNotBuilt:
    s << " (not built)>" ;
    break ;
  }
  return GGS_string (true, s) ;
}

//---------------------------------------------------------------------------*
//                                                                           *
//                        class 'e_xmlAttributeMap'                          *
//                                                                           *
//---------------------------------------------------------------------------*

e_xmlAttributeMap::e_xmlAttributeMap (void) :
value () {
}

//---------------------------------------------------------------------------*
//                                                                           *
//                       class map '@xmlAttributeMap'                        *
//                                                                           *
//---------------------------------------------------------------------------*

elementOf_GGS_xmlAttributeMap::
elementOf_GGS_xmlAttributeMap (const GGS_lstring & inKey,
              const sint32 inIndex,
              const e_xmlAttributeMap & inInfo) :
AC_galgas_map_element (inKey, inIndex),
mInfo (inInfo) {
}

//---------------------------------------------------------------------------*

void elementOf_GGS_xmlAttributeMap::
appendForMapDescription (C_Compiler & inLexique,
                         const sint32 inElementIndex,
                         C_String & ioString,
                         const sint32 inIndentation
                         COMMA_LOCATION_ARGS) const {
  ioString << "\n" ;
  ioString.writeStringMultiple ("| ", inIndentation) ;
  ioString << "|-key " ;
  ioString.appendSigned (inElementIndex) ;
  ioString << ":" << mKey.reader_description  (inLexique COMMA_THERE, inIndentation + 1) ;
  ioString << "\n" ;
  ioString.writeStringMultiple ("| ", inIndentation) ;
  ioString << "|-value " ;
  ioString.appendSigned (inElementIndex) ;
  ioString << ":" << mInfo.value.reader_description  (inLexique COMMA_THERE, inIndentation + 1) ;
}

//---------------------------------------------------------------------------*

bool elementOf_GGS_xmlAttributeMap::
isEqualToMapElement (const AC_galgas_map_element * inOperand) const {
  const elementOf_GGS_xmlAttributeMap * ptr = dynamic_cast <const elementOf_GGS_xmlAttributeMap *> (inOperand) ;
  macroValidPointer (ptr) ;
  return (mInfo.value.operator_isEqual (ptr->mInfo.value)).boolValue () ;
}

//---------------------------------------------------------------------------*

AC_galgas_map_element * GGS_xmlAttributeMap::
new_element (const GGS_lstring & inKey, void * inInfo) {
  MF_Assert (reinterpret_cast <e_xmlAttributeMap *> (inInfo) != NULL, "Dynamic cast error", 0, 0) ;
  AC_galgas_map_element * p = NULL ;
  e_xmlAttributeMap * info = (e_xmlAttributeMap *) inInfo ;
  macroMyNew (p, cElement (inKey, nextIndex (), * info)) ;
  return p ;
}

//---------------------------------------------------------------------------*

void GGS_xmlAttributeMap::
assignInfo (AC_galgas_map_element * inPtr, void * inInfo) {
  MF_Assert (reinterpret_cast <cElement *> (inPtr) != NULL, "Dynamic cast error", 0, 0) ;
  MF_Assert (reinterpret_cast <e_xmlAttributeMap *> (inInfo) != NULL, "Dynamic cast error", 0, 0) ;
  cElement * p = (cElement *) inPtr ;
  e_xmlAttributeMap * info = (e_xmlAttributeMap *) inInfo ;
  p->mInfo = * info ;
}

//---------------------------------------------------------------------------*

GGS_xmlAttributeMap GGS_xmlAttributeMap::
constructor_emptyMap (C_Compiler & /* inLexique */ COMMA_UNUSED_LOCATION_ARGS) {
  GGS_xmlAttributeMap result ;
  macroMyNew (result.mSharedMapRoot, cMapRoot) ;
  return result ;
}

//---------------------------------------------------------------------------*

void GGS_xmlAttributeMap::
enterIndex (const GGS_lstring & inKey,
            AC_galgas_index_core & outIndex) {
  e_xmlAttributeMap info  ;
  internalEnterIndex (inKey,
                      (void *) & info,
                      outIndex) ;
}

//---------------------------------------------------------------------------*

GGS_bool GGS_xmlAttributeMap::
operator_isEqual (const GGS_xmlAttributeMap & inOperand) const {
  return GGS_bool (isBuilt () && inOperand.isBuilt (), isEqualToMap (inOperand)) ;
}

//---------------------------------------------------------------------------*

GGS_bool GGS_xmlAttributeMap::
operator_isNotEqual (const GGS_xmlAttributeMap & inOperand) const {
  return GGS_bool (isBuilt () && inOperand.isBuilt (), ! isEqualToMap (inOperand)) ;
}

//---------------------------------------------------------------------------*

void GGS_xmlAttributeMap::
internalInsertForDuplication (AC_galgas_map_element * inPtr) {
  MF_Assert (reinterpret_cast <cElement *> (inPtr) != NULL, "Dynamic cast error", 0, 0) ;
  cElement * p = (cElement *) inPtr ;
  sint32 attributeIndex = -1 ; // Unused here
  GGS_location existingKeyLocation ; // Unused here
  internalInsert (p->mKey, (void *) & p->mInfo, attributeIndex, existingKeyLocation) ;
}

//---------------------------------------------------------------------------*

void GGS_xmlAttributeMap::
insertElement (C_Compiler & inLexique,
                const utf32 * inErrorMessage,
                const GGS_lstring & inKey,
                const GGS_lstring & inParameter0,
                GGS_luint * outIndex
                COMMA_LOCATION_ARGS) {
  sint32 elementID = - 1 ;
  if (isBuilt ()
   && inParameter0.isBuilt ()
   && inKey.isBuilt ()) {
    insulateMap () ;
    e_xmlAttributeMap info  ;
    info.value = inParameter0 ;
    GGS_location existingKeyLocation ;
    internalInsert (inKey, (void *) & info, elementID, existingKeyLocation) ;
    if (elementID < 0) {
      emitInsertMapSemanticErrorMessage (inLexique, inKey, inErrorMessage, existingKeyLocation COMMA_THERE) ;
    }
  }
  if (outIndex != NULL) {
    * outIndex = GGS_luint (GGS_uint (elementID >= 0, (uint32) elementID), inKey) ;
  }
}

//---------------------------------------------------------------------------*

void GGS_xmlAttributeMap::
searchElement (C_Compiler & inLexique,
               const utf32 * inErrorMessage,
               const GGS_lstring & inKey,
               GGS_lstring   & outParameter0,
               GGS_luint * outIndex
               COMMA_LOCATION_ARGS) const {
  cElement * node = NULL  ;
  if (isBuilt () && inKey.isBuilt ()) {
    AC_galgas_map_element * p = internal_search (inKey.string ()) ;
    MF_Assert ((p == NULL) || (reinterpret_cast <cElement *> (p) != NULL), "Dynamic cast error", 0, 0) ;
    node = (cElement *) p ;
    if (node == NULL) {
      emitMapSemanticErrorMessage (inLexique, inKey, inErrorMessage COMMA_THERE) ;
    }
  }
  if (node == NULL) {
    outParameter0.drop () ;
    if (outIndex != NULL) {
      outIndex->drop () ;
     }
  }else{
    outParameter0 = node->mInfo.value ;
    if (outIndex != NULL) {
      * outIndex = GGS_luint (GGS_uint (true, (uint32) node->mID), inKey) ;
    }
  }
}

//---------------------------------------------------------------------------*

const utf32 GGS_xmlAttributeMap::kSearchMessage_searchKey [] = {
  TO_UNICODE ('t'),
  TO_UNICODE ('h'),
  TO_UNICODE ('e'),
  TO_UNICODE (' '),
  TO_UNICODE ('\''),
  TO_UNICODE ('%'),
  TO_UNICODE ('K'),
  TO_UNICODE ('\''),
  TO_UNICODE (' '),
  TO_UNICODE ('a'),
  TO_UNICODE ('t'),
  TO_UNICODE ('t'),
  TO_UNICODE ('r'),
  TO_UNICODE ('i'),
  TO_UNICODE ('b'),
  TO_UNICODE ('u'),
  TO_UNICODE ('t'),
  TO_UNICODE ('e'),
  TO_UNICODE (' '),
  TO_UNICODE ('i'),
  TO_UNICODE ('s'),
  TO_UNICODE (' '),
  TO_UNICODE ('n'),
  TO_UNICODE ('o'),
  TO_UNICODE ('t'),
  TO_UNICODE (' '),
  TO_UNICODE ('d'),
  TO_UNICODE ('e'),
  TO_UNICODE ('c'),
  TO_UNICODE ('l'),
  TO_UNICODE ('a'),
  TO_UNICODE ('r'),
  TO_UNICODE ('e'),
  TO_UNICODE ('d'),
  TO_UNICODE (0)
} ;

//---------------------------------------------------------------------------*

void GGS_xmlAttributeMap::
method_searchKey (C_Compiler & inLexique,
                                const GGS_lstring & inKey,
                                GGS_lstring   & outParameter0 COMMA_LOCATION_ARGS) const {
  searchElement (inLexique,
                  kSearchMessage_searchKey,
                  inKey,
                  outParameter0,
                  NULL
                  COMMA_THERE) ;
}

//---------------------------------------------------------------------------*

const utf32 GGS_xmlAttributeMap::kInsertMessage_insertKey [] = {
  TO_UNICODE ('t'),
  TO_UNICODE ('h'),
  TO_UNICODE ('e'),
  TO_UNICODE (' '),
  TO_UNICODE ('\''),
  TO_UNICODE ('%'),
  TO_UNICODE ('K'),
  TO_UNICODE ('\''),
  TO_UNICODE (' '),
  TO_UNICODE ('a'),
  TO_UNICODE ('t'),
  TO_UNICODE ('t'),
  TO_UNICODE ('r'),
  TO_UNICODE ('i'),
  TO_UNICODE ('b'),
  TO_UNICODE ('u'),
  TO_UNICODE ('t'),
  TO_UNICODE ('e'),
  TO_UNICODE (' '),
  TO_UNICODE ('h'),
  TO_UNICODE ('a'),
  TO_UNICODE ('s'),
  TO_UNICODE (' '),
  TO_UNICODE ('b'),
  TO_UNICODE ('e'),
  TO_UNICODE ('e'),
  TO_UNICODE ('n'),
  TO_UNICODE (' '),
  TO_UNICODE ('a'),
  TO_UNICODE ('l'),
  TO_UNICODE ('r'),
  TO_UNICODE ('e'),
  TO_UNICODE ('a'),
  TO_UNICODE ('d'),
  TO_UNICODE ('y'),
  TO_UNICODE (' '),
  TO_UNICODE ('d'),
  TO_UNICODE ('e'),
  TO_UNICODE ('c'),
  TO_UNICODE ('l'),
  TO_UNICODE ('a'),
  TO_UNICODE ('r'),
  TO_UNICODE ('e'),
  TO_UNICODE ('d'),
  TO_UNICODE (0)
} ;

//---------------------------------------------------------------------------*

void GGS_xmlAttributeMap::
modifier_insertKey (C_Compiler & inLexique,
                                const GGS_lstring & inKey,
                                const GGS_lstring & inParameter0 COMMA_LOCATION_ARGS) {
  insertElement (inLexique,
                 kInsertMessage_insertKey,
                 inKey,
                 inParameter0,
                 NULL
                 COMMA_THERE) ;
}

//---------------------------------------------------------------------------*

GGS_xmlAttributeMap GGS_xmlAttributeMap::
constructor_mapWithMapToOverride (C_Compiler & /* inLexique */,
                                  const GGS_xmlAttributeMap & inMapToOverride
                                  COMMA_UNUSED_LOCATION_ARGS) {
  GGS_xmlAttributeMap result ; // Not Built
  if (inMapToOverride.mSharedMapRoot != NULL) {
    macroValidPointer (inMapToOverride.mSharedMapRoot) ;
    macroMyNew (result.mSharedMapRoot, cMapRoot) ;
    result.mSharedMapRoot->mNextMap = inMapToOverride.mSharedMapRoot ;
    inMapToOverride.mSharedMapRoot->mReferenceCount ++ ;
    result.mSharedMapRoot->mSequenceNumber = inMapToOverride.mSharedMapRoot->mSequenceNumber ;
  }
  return result ;
}

//---------------------------------------------------------------------------*

GGS_xmlAttributeMap GGS_xmlAttributeMap::
reader_overriddenMap (C_Compiler & /* inLexique */
                      COMMA_UNUSED_LOCATION_ARGS) const {
  GGS_xmlAttributeMap result ; // Not Built
  if (mSharedMapRoot != NULL) {
    macroValidPointer (mSharedMapRoot) ;
    result.mSharedMapRoot = mSharedMapRoot->mNextMap ;
    if (result.mSharedMapRoot != NULL) {
      macroValidPointer (result.mSharedMapRoot) ;
      result.mSharedMapRoot->mReferenceCount ++ ;
    }else{
      macroMyNew (result.mSharedMapRoot, cMapRoot) ;
    }
  }
  return result ;
}

//---------------------------------------------------------------------------*

GGS_string GGS_xmlAttributeMap::
reader_description (C_Compiler & inLexique
                    COMMA_LOCATION_ARGS,
                    const sint32 inIndentation) const {
  C_String s ;
  s << "<map @xmlAttributeMap " ;
  if (isBuilt ()) {
    s.appendSigned (count ()) ;
    s << " object" << ((count () > 1) ? "s " : " ") ;
    cElement * p = firstObject () ;
    sint32 elementID = 0 ;
    while (p != NULL) {
      macroValidPointer (p) ;
      p->appendForMapDescription (inLexique, elementID, s, inIndentation COMMA_THERE) ;
      p = p->nextObject () ;
      elementID ++ ;
    }
  }else{
    s << "not built" ;
  }
  s << "\n" ;
  s.writeStringMultiple ("| ", inIndentation) ;
  s << ">" ;
  return GGS_string (true, s) ;
}

//---------------------------------------------------------------------------*

/* const */ GGS_lstring  & GGS_xmlAttributeMap::cEnumerator::_value (LOCATION_ARGS) const {
  return ((cElement *) mObjectArray (mCurrentIndex COMMA_THERE))->mInfo.value ;
}

//---------------------------------------------------------------------------*
//                                                                           *
//                           class 'cPtr_xmlNode'                            *
//                                                                           *
//---------------------------------------------------------------------------*

cPtr_xmlNode::
cPtr_xmlNode (const GGS_xmlNodeType& argument_0,
                                const GGS_lstring & argument_1,
                                const GGS_xmlAttributeMap & argument_2,
                                const GGS_xmlNodeList & argument_3
                                COMMA_LOCATION_ARGS)
:cPtr__AC_galgas_class (THERE),
type (argument_0),
name (argument_1),
attributeMap (argument_2),
nodeList (argument_3) {
}

//---------------------------------------------------------------------------*

#ifndef DO_NOT_GENERATE_CHECKINGS
  cPtr_xmlNode * GGS_xmlNode::
  operator () (LOCATION_ARGS) const {
    macroValidPointerThere (mPointer) ;
    MF_Assert (dynamic_cast <cPtr_xmlNode *> (mPointer) != NULL,
               "dynamic cast error", 0, 0) ;
    return (cPtr_xmlNode *) mPointer ;
  }
#endif

//---------------------------------------------------------------------------*

bool cPtr_xmlNode::
isEqualToObject (const cPtr__AC_galgas_class * inOperand) const {
  bool equal = typeid (this) == typeid (inOperand) ;
  if (equal) {
    const cPtr_xmlNode * ptr = dynamic_cast <const cPtr_xmlNode *> (inOperand) ;
    macroValidPointer (ptr) ;
    equal = type.operator_isEqual (ptr->type).boolValue ()
         && name.operator_isEqual (ptr->name).boolValue ()
         && attributeMap.operator_isEqual (ptr->attributeMap).boolValue ()
         && nodeList.operator_isEqual (ptr->nodeList).boolValue () ;
  }
  return equal ;
}

//---------------------------------------------------------------------------*

void cPtr_xmlNode::
appendForDescription (C_Compiler & inLexique,
                      C_String & ioString,
                      const sint32 inIndentation
                      COMMA_LOCATION_ARGS) const {
  ioString << "->@xmlNode:"
           << type.reader_description  (inLexique COMMA_THERE, inIndentation + 1)
           << name.reader_description  (inLexique COMMA_THERE, inIndentation + 1)
           << attributeMap.reader_description  (inLexique COMMA_THERE, inIndentation + 1)
           << nodeList.reader_description  (inLexique COMMA_THERE, inIndentation + 1) ;
}

//---------------------------------------------------------------------------*
//                                                                           *
//                              Class message                                *
//                                                                           *
//---------------------------------------------------------------------------*

const char * cPtr_xmlNode::
_message (void) const {
  return "" ;
}

//---------------------------------------------------------------------------*

const char * cPtr_xmlNode::
_static_message (void) {
  return "" ;
}

//---------------------------------------------------------------------------*

C_galgas_class_inspector _gInspectorFor_xmlNode (& typeid (cPtr_xmlNode), NULL, "") ;

//---------------------------------------------------------------------------*

AC_galgasClassRunTimeInformation * cPtr_xmlNode::galgasRTTI (void) const {
  return & gClassInfoFor__xmlNode ;
}

//---------------------------------------------------------------------------*

cPtr__AC_galgas_class * cPtr_xmlNode::makeClone (void) const {
  cPtr__AC_galgas_class * result = NULL ;
  macroMyNew (result, cPtr_xmlNode (type, name, attributeMap, nodeList COMMA_HERE)) ;
  return result ;
}

//---------------------------------------------------------------------------*
//                                                                           *
//                        GALGAS class 'GGS_xmlNode'                         *
//                                                                           *
//---------------------------------------------------------------------------*

GGS_xmlNode::
GGS_xmlNode (cPtr__AC_galgas_class * inPointer) {
  macroAssignPointer (mPointer, inPointer) ;
}

//---------------------------------------------------------------------------*

GGS_xmlNode::
GGS_xmlNode (cPtr__AC_galgas_class & inObject) {
  macroAssignPointer (mPointer, & inObject) ;
}

//---------------------------------------------------------------------------*

//--- _castFrom class method (implements cast expression)
GGS_xmlNode GGS_xmlNode::
_castFrom (C_Compiler & inLexique,
           cPtr__AC_galgas_class * inPointer,
           const bool inUseKindOfClass,
           const GGS_location & inErrorLocation
           COMMA_LOCATION_ARGS) {
  GGS_xmlNode _result ;
  if (inPointer != NULL) {
    macroValidPointer (inPointer) ;
    const bool ok = inUseKindOfClass
      ? (dynamic_cast <cPtr_xmlNode *> (inPointer) != NULL)
      : (typeid (cPtr_xmlNode) == typeid (*inPointer)) ;
    if (ok) {
      _result = GGS_xmlNode (inPointer) ;
    }else{
      inErrorLocation.signalCastError (inLexique,
                                       & typeid (cPtr_xmlNode),
                                       inUseKindOfClass,
                                       inPointer->_message ()
                                       COMMA_THERE) ;
    }
  }
  return _result ;
}

//---------------------------------------------------------------------------*

GGS_xmlNode GGS_xmlNode::
constructor_new (C_Compiler & /* inLexique */,
                 const GGS_xmlNodeType& argument_0,
                 const GGS_lstring & argument_1,
                 const GGS_xmlAttributeMap & argument_2,
                 const GGS_xmlNodeList & argument_3
                                COMMA_LOCATION_ARGS) {
  GGS_xmlNode result ;
  macroMyNew (result.mPointer, cPtr_xmlNode (argument_0,
                                argument_1,
                                argument_2,
                                argument_3 COMMA_THERE)) ;
  return result ;
}

//---------------------------------------------------------------------------*

GGS_xmlNodeType GGS_xmlNode::
reader_type (C_Compiler & /* inLexique */ COMMA_UNUSED_LOCATION_ARGS) const {
  GGS_xmlNodeType  result ;
  if (mPointer != NULL) {
    macroValidPointer (mPointer) ;
    MF_Assert (dynamic_cast <cPtr_xmlNode *> (mPointer) != NULL,
               "dynamic cast error", 0, 0) ;
    result = ((cPtr_xmlNode *) mPointer)->type ;
  }
  return result ;
}

//---------------------------------------------------------------------------*

GGS_lstring  GGS_xmlNode::
reader_name (C_Compiler & /* inLexique */ COMMA_UNUSED_LOCATION_ARGS) const {
  GGS_lstring   result ;
  if (mPointer != NULL) {
    macroValidPointer (mPointer) ;
    MF_Assert (dynamic_cast <cPtr_xmlNode *> (mPointer) != NULL,
               "dynamic cast error", 0, 0) ;
    result = ((cPtr_xmlNode *) mPointer)->name ;
  }
  return result ;
}

//---------------------------------------------------------------------------*

GGS_xmlAttributeMap  GGS_xmlNode::
reader_attributeMap (C_Compiler & /* inLexique */ COMMA_UNUSED_LOCATION_ARGS) const {
  GGS_xmlAttributeMap   result ;
  if (mPointer != NULL) {
    macroValidPointer (mPointer) ;
    MF_Assert (dynamic_cast <cPtr_xmlNode *> (mPointer) != NULL,
               "dynamic cast error", 0, 0) ;
    result = ((cPtr_xmlNode *) mPointer)->attributeMap ;
  }
  return result ;
}

//---------------------------------------------------------------------------*

GGS_xmlNodeList  GGS_xmlNode::
reader_nodeList (C_Compiler & /* inLexique */ COMMA_UNUSED_LOCATION_ARGS) const {
  GGS_xmlNodeList   result ;
  if (mPointer != NULL) {
    macroValidPointer (mPointer) ;
    MF_Assert (dynamic_cast <cPtr_xmlNode *> (mPointer) != NULL,
               "dynamic cast error", 0, 0) ;
    result = ((cPtr_xmlNode *) mPointer)->nodeList ;
  }
  return result ;
}

//---------------------------------------------------------------------------*

const char * GGS_xmlNode::actualTypeName (void) const {
  return "xmlNode" ;
}

//---------------------------------------------------------------------------*

AC_galgasClassRunTimeInformation * GGS_xmlNode::_galgasObjectRunTimeInfo (void) const {
  AC_galgasClassRunTimeInformation * result = NULL ;
  if (mPointer != NULL) {
    result = mPointer->galgasRTTI () ;
  }
  return result ;
}

//---------------------------------------------------------------------------*

C_galgasRootClassRunTimeInformation gClassInfoFor__xmlNode ("xmlNode") ;

//---------------------------------------------------------------------------*
//                                                                           *
//                      Element of list '@xmlNodeList'                       *
//                                                                           *
//---------------------------------------------------------------------------*

elementOf_GGS_xmlNodeList::
elementOf_GGS_xmlNodeList (const GGS_xmlNode & argument_0
                                COMMA_LOCATION_ARGS) :
AC_galgas_list::cListElement (THERE),
node (argument_0) {
}

//---------------------------------------------------------------------------*

bool elementOf_GGS_xmlNodeList::
isEqualToObject (const cListElement * inOperand) const {
  bool equal = inOperand == this ;
  if (! equal) {
    const elementOf_GGS_xmlNodeList * ptr = dynamic_cast <const elementOf_GGS_xmlNodeList *> (inOperand) ;
    macroValidPointer (ptr) ;
    equal = node.operator_isEqual (ptr->node).boolValue () ;
  }
  return equal ;
}

//---------------------------------------------------------------------------*

void elementOf_GGS_xmlNodeList::
appendForDescription (C_Compiler & inLexique,
                          C_String & ioString,
                          const sint32 inIndentation
                          COMMA_LOCATION_ARGS) const {
  ioString << "\n" ;
  ioString.writeStringMultiple ("| ", inIndentation) ;
  ioString << "|-" ;
  ioString << node.reader_description  (inLexique COMMA_THERE, inIndentation) ;
}

//---------------------------------------------------------------------------*
//                                                                           *
//                           List '@xmlNodeList'                             *
//                                                                           *
//---------------------------------------------------------------------------*

void GGS_xmlNodeList::
_internalAppendValues (const GGS_xmlNode & argument_0
                    COMMA_LOCATION_ARGS) {
  cElement * nouvelElement = (cElement *) NULL ;
  macroMyNew (nouvelElement, cElement (argument_0
                                COMMA_THERE)) ;
  _internalAppendItem (nouvelElement) ;
}

//---------------------------------------------------------------------------*

void GGS_xmlNodeList::
_internalPrependValues (const GGS_xmlNode & argument_0
                    COMMA_LOCATION_ARGS) {
  cElement * nouvelElement = (cElement *) NULL ;
  macroMyNew (nouvelElement, cElement (argument_0
                                COMMA_THERE)) ;
  _internalPrependItem (nouvelElement) ;
}

//---------------------------------------------------------------------------*

void GGS_xmlNodeList::
_addAssign_operation (const GGS_xmlNode & argument_0) {
  if (isBuilt ()&& argument_0.isBuilt ()) {
    _insulateList () ;
    _internalAppendValues (argument_0
                                COMMA_HERE) ;
  }
}

//---------------------------------------------------------------------------*

GGS_xmlNodeList GGS_xmlNodeList::
operator_concat (const GGS_xmlNodeList & inOperand) const {
  GGS_xmlNodeList result = * this ;
  result.dotAssign_operation (inOperand) ;
  return result ;
}

//---------------------------------------------------------------------------*

void GGS_xmlNodeList::
dotAssign_operation (const GGS_xmlNodeList inOperand) {
  if (isBuilt () && inOperand.isBuilt ()) {
    if (count () == 0) {
      * this = inOperand ;
    }else{
      if (inOperand.count () > 0) {
        _insulateList () ;
        elementOf_GGS_xmlNodeList * p = inOperand.firstObject () ;
        while (p != NULL) {
          macroValidPointer (p) ;
          GGS_xmlNode  p_0 = p->node ;
          _internalAppendValues (p_0 COMMA_HERE) ;
          p = p->nextObject () ;
        }
      }
    }
  }
}

//---------------------------------------------------------------------------*

void GGS_xmlNodeList::
modifier_prependValue (C_Compiler & /* inLexique */,
                     const GGS_xmlNode & argument_0
                     COMMA_UNUSED_LOCATION_ARGS) {
  if (isBuilt ()) {
    _insulateList () ;
    _internalPrependValues (argument_0
                                COMMA_HERE) ;
  }
}

//---------------------------------------------------------------------------*

void GGS_xmlNodeList::
_insulateList (void) {
  if (_shared ()) {
    cElement * ptr = firstObject () ;
    alloc () ;
    while (ptr != NULL) {
      macroValidPointer (ptr) ;
      _internalAppendValues (ptr->node
                                COMMA_HERE) ;
      ptr = ptr->nextObject () ;
    }
  }
}

//---------------------------------------------------------------------------*

GGS_xmlNodeList  GGS_xmlNodeList::
constructor_emptyList (void) {
  GGS_xmlNodeList result ;
  result.alloc () ;
  return result ;
}

//---------------------------------------------------------------------------*

GGS_xmlNodeList  GGS_xmlNodeList::
constructor_listWithValue (const GGS_xmlNode & argument_0) {
  GGS_xmlNodeList result ;
  result.alloc () ;
  result._addAssign_operation (argument_0) ;
  return result ;
}

//---------------------------------------------------------------------------*

void GGS_xmlNodeList::
internalSubListWithRange (GGS_xmlNodeList & ioList,
                          const sint32 inFirstIndex,
                          const sint32 inCount) const {
  ioList.alloc () ;
  if (inCount > 0) {
    cElement * ptr = firstObject () ;
    for (sint32 i=0 ; i<inFirstIndex ; i++) {
      macroValidPointer (ptr) ;
      ptr = ptr->nextObject () ;
    }
    for (sint32 i=0 ; i<inCount ; i++) {
      macroValidPointer (ptr) ;
      ioList._addAssign_operation (ptr->node) ;
      ptr = ptr->nextObject () ;
    }
  }
}

//---------------------------------------------------------------------------*

GGS_xmlNodeList GGS_xmlNodeList::
reader_subListWithRange (C_Compiler & inLexique,
                         const GGS_uint & inFirstIndex,
                         const GGS_uint & inCount
                         COMMA_LOCATION_ARGS) const {
  GGS_xmlNodeList result ;
  if (isBuilt () && inFirstIndex.isBuilt () && inCount.isBuilt ()) {
    const sint32 firstIndex = (sint32) inFirstIndex.uintValue () ;
    const sint32 rangeCount = (sint32) inCount.uintValue () ;
    if ((firstIndex + rangeCount) > count ()) {
      inLexique.onTheFlyRunTimeError ("'subListWithRange' method invoked with upper bound greater than list object count" COMMA_THERE) ;
    }else{
      internalSubListWithRange (result, firstIndex, rangeCount) ;
    }
  }
  return result ;
}

//---------------------------------------------------------------------------*

GGS_xmlNodeList GGS_xmlNodeList::
reader_subListFromIndex (C_Compiler & inLexique,
                         const GGS_uint & inIndex
                         COMMA_LOCATION_ARGS) const {
  GGS_xmlNodeList result ;
  if (isBuilt () && inIndex.isBuilt ()) {
    const sint32 startIndex = (sint32) inIndex.uintValue () ;
    if (startIndex > count ()) {
      inLexique.onTheFlyRunTimeError ("'subListFromIndex' method invoked with start index greater than list object count" COMMA_THERE) ;
    }else{
      internalSubListWithRange (result, startIndex, count () - startIndex) ;
    }
  }
  return result ;
}

//---------------------------------------------------------------------------*

GGS_string GGS_xmlNodeList::
reader_description (C_Compiler & inLexique
                    COMMA_LOCATION_ARGS,
                    const sint32 inIndentation) const {
  return _description (inLexique, "@xmlNodeList", inIndentation COMMA_THERE) ;
}

//---------------------------------------------------------------------------*

void GGS_xmlNodeList::
method_first (C_Compiler & inLexique,
              GGS_xmlNode & _out_0
              COMMA_LOCATION_ARGS) const {
  cElement * ptr = NULL ;
  if (isBuilt ()) {
    ptr = firstObject () ;
    if (ptr == NULL) {
      inLexique.onTheFlyRunTimeError ("'first' method invoked on an empty list" COMMA_THERE) ;
    }
  }
  if (ptr != NULL) {
    _out_0 = ptr->node ;
  }else{
    _out_0.drop () ;
  }
}

//---------------------------------------------------------------------------*

void GGS_xmlNodeList::
method_last (C_Compiler & inLexique,
             GGS_xmlNode & _out_0
             COMMA_LOCATION_ARGS) const {
  cElement * ptr = NULL ;
  if (isBuilt ()) {
    ptr = lastObject () ;
    if (ptr == NULL) {
      inLexique.onTheFlyRunTimeError ("'last' method invoked on an empty list" COMMA_THERE) ;
    }
  }
  if (ptr != NULL) {
    _out_0 = ptr->node ;
  }else{
    _out_0.drop () ;
  }
}

//---------------------------------------------------------------------------*

void GGS_xmlNodeList::
modifier_popFirst (C_Compiler & inLexique,
                 GGS_xmlNode & _out_0
                 COMMA_LOCATION_ARGS) {
  cElement * ptr = NULL ;
  if (isBuilt ()) {
    ptr = firstObject () ;
    if (ptr == NULL) {
      inLexique.onTheFlyRunTimeError ("'popFirst' modifier invoked on an empty list" COMMA_THERE) ;
    }
  }
  if (ptr != NULL) {
    _out_0 = ptr->node ;
    _insulateList () ;
    _internalRemoveFirst () ;
  }else{
    _out_0.drop () ;
  }
}

//---------------------------------------------------------------------------*

void GGS_xmlNodeList::
modifier_popLast (C_Compiler & inLexique,
                GGS_xmlNode & _out_0
                COMMA_LOCATION_ARGS) {
  cElement * ptr = NULL ;
  if (isBuilt ()) {
    ptr = lastObject () ;
    if (ptr == NULL) {
      inLexique.onTheFlyRunTimeError ("'popLast' modifier invoked on an empty list" COMMA_THERE) ;
    }
  }
  if (ptr != NULL) {
    _out_0 = ptr->node ;
    _insulateList () ;
    _internalRemoveLast () ;
  }else{
    _out_0.drop () ;
  }
}

//---------------------------------------------------------------------------*

GGS_xmlNode  GGS_xmlNodeList::
reader_nodeAtIndex (C_Compiler & inLexique, const GGS_uint & inIndex COMMA_LOCATION_ARGS) const {
  GGS_xmlNode  result ;
  if (isBuilt () && inIndex.isBuilt ()) {
    cElement * object = (cElement *) objectAtIndex (inLexique, inIndex.uintValue () COMMA_THERE) ;
    if (object != NULL) {
      result = object->node ;
    }
  }
  return result ;
}

//---------------------------------------------------------------------------*

void GGS_xmlNodeList::
modifier_setNodeAtIndex (C_Compiler & inLexique,
                              const GGS_xmlNode  & inObject,
                              const GGS_uint & inIndex
                              COMMA_LOCATION_ARGS) const {
  if (isBuilt () && inIndex.isBuilt ()) {
    cElement * object = (cElement *) objectAtIndex (inLexique, inIndex.uintValue () COMMA_THERE) ;
    if (object != NULL) {
      object->node = inObject ;
    }
  }
}

//---------------------------------------------------------------------------*

/* const */ GGS_xmlNode  & GGS_xmlNodeList::cEnumerator::_node (LOCATION_ARGS) const {
  macroValidPointerThere (mCurrentEnumeratedObject) ;
  return ((cElement *) mCurrentEnumeratedObject)->node ;
}

//---------------------------------------------------------------------------*
//                                                                           *
//             Implementation of routine "internal_logXMLNodes"              *
//                                                                           *
//---------------------------------------------------------------------------*

void routine_internal_logXMLNodes (C_Compiler & inLexique,
                                const GGS_xmlNodeList   var_cas_inNodeList,
                                const GGS_string  var_cas_inIndentationString,
                                GGS_string & var_cas_ioString COMMA_UNUSED_LOCATION_ARGS) {
  #ifdef DEBUG_TRACE_ENABLED
    printf ("ENTER routine_internal_logXMLNodes at %s:%d\n", __FILE__, __LINE__) ;
  #endif
  {
    GGS_xmlNodeList::cEnumerator enumerator_989 (var_cas_inNodeList, true) ;
    const GGS_xmlNodeList::cElement * operand_989 = NULL ;
    while (((operand_989 = enumerator_989.nextObject ()))) {
      macroValidPointer (operand_989) ;
      var_cas_ioString.dotAssign_operation (var_cas_inIndentationString) ;
      switch (operand_989->node.reader_type (inLexique COMMA_SOURCE_FILE_AT_LINE (46)).enumValue ()) {
      case GGS_xmlNodeType::enum_element:
        {
        var_cas_ioString.appendCString ("ELEMENT '") ;
        var_cas_ioString.dotAssign_operation (operand_989->node.reader_name (inLexique COMMA_SOURCE_FILE_AT_LINE (48))) ;
        var_cas_ioString.appendCString ("' ") ;
        var_cas_ioString.dotAssign_operation (operand_989->node.reader_name (inLexique COMMA_SOURCE_FILE_AT_LINE (49)).reader_location (inLexique COMMA_SOURCE_FILE_AT_LINE (49)).reader_line (inLexique COMMA_SOURCE_FILE_AT_LINE (49)).reader_string (inLexique COMMA_SOURCE_FILE_AT_LINE (49))) ;
        var_cas_ioString.appendCString (":") ;
        var_cas_ioString.dotAssign_operation (operand_989->node.reader_name (inLexique COMMA_SOURCE_FILE_AT_LINE (50)).reader_location (inLexique COMMA_SOURCE_FILE_AT_LINE (50)).reader_column (inLexique COMMA_SOURCE_FILE_AT_LINE (50)).reader_string (inLexique COMMA_SOURCE_FILE_AT_LINE (50))) ;
        var_cas_ioString.appendCString (":") ;
        var_cas_ioString.dotAssign_operation (operand_989->node.reader_name (inLexique COMMA_SOURCE_FILE_AT_LINE (51)).reader_location (inLexique COMMA_SOURCE_FILE_AT_LINE (51)).reader_locationIndex (inLexique COMMA_SOURCE_FILE_AT_LINE (51)).reader_string (inLexique COMMA_SOURCE_FILE_AT_LINE (51))) ;
        var_cas_ioString.appendCString (" {") ;
        {
          GGS_xmlAttributeMap::cEnumerator enumerator_1347 (operand_989->node.reader_attributeMap (inLexique COMMA_SOURCE_FILE_AT_LINE (52)), true) ;
          const GGS_xmlAttributeMap::cElement * operand_1347 = enumerator_1347.nextObject () ;
          if ((operand_1347 != NULL)) {
            bool _foreach_loop_1347 ;
            do{
              macroValidPointer (operand_1347) ;
              var_cas_ioString.appendCString ("'") ;
              var_cas_ioString.dotAssign_operation (operand_1347->mKey) ;
              var_cas_ioString.appendCString ("' ") ;
              var_cas_ioString.dotAssign_operation (operand_1347->mKey.reader_location (inLexique COMMA_SOURCE_FILE_AT_LINE (54)).reader_line (inLexique COMMA_SOURCE_FILE_AT_LINE (54)).reader_string (inLexique COMMA_SOURCE_FILE_AT_LINE (54))) ;
              var_cas_ioString.appendCString (":") ;
              var_cas_ioString.dotAssign_operation (operand_1347->mKey.reader_location (inLexique COMMA_SOURCE_FILE_AT_LINE (55)).reader_column (inLexique COMMA_SOURCE_FILE_AT_LINE (55)).reader_string (inLexique COMMA_SOURCE_FILE_AT_LINE (55))) ;
              var_cas_ioString.appendCString (":") ;
              var_cas_ioString.dotAssign_operation (operand_1347->mKey.reader_location (inLexique COMMA_SOURCE_FILE_AT_LINE (56)).reader_locationIndex (inLexique COMMA_SOURCE_FILE_AT_LINE (56)).reader_string (inLexique COMMA_SOURCE_FILE_AT_LINE (56))) ;
              var_cas_ioString.appendCString (" -> '") ;
              var_cas_ioString.dotAssign_operation (operand_1347->mInfo.value) ;
              var_cas_ioString.appendCString ("' ") ;
              var_cas_ioString.dotAssign_operation (operand_1347->mInfo.value.reader_location (inLexique COMMA_SOURCE_FILE_AT_LINE (58)).reader_line (inLexique COMMA_SOURCE_FILE_AT_LINE (58)).reader_string (inLexique COMMA_SOURCE_FILE_AT_LINE (58))) ;
              var_cas_ioString.appendCString (":") ;
              var_cas_ioString.dotAssign_operation (operand_1347->mInfo.value.reader_location (inLexique COMMA_SOURCE_FILE_AT_LINE (59)).reader_column (inLexique COMMA_SOURCE_FILE_AT_LINE (59)).reader_string (inLexique COMMA_SOURCE_FILE_AT_LINE (59))) ;
              var_cas_ioString.appendCString (":") ;
              var_cas_ioString.dotAssign_operation (operand_1347->mInfo.value.reader_location (inLexique COMMA_SOURCE_FILE_AT_LINE (60)).reader_locationIndex (inLexique COMMA_SOURCE_FILE_AT_LINE (60)).reader_string (inLexique COMMA_SOURCE_FILE_AT_LINE (60))) ;
              operand_1347 = enumerator_1347.nextObject () ;
              _foreach_loop_1347 = ((operand_1347 != NULL)) ;
              if (_foreach_loop_1347) {
                var_cas_ioString.appendCString (", ") ;
              }
            }while (_foreach_loop_1347) ;
          }
        }
        var_cas_ioString.appendCString ("}\n") ;
        ::routine_internal_logXMLNodes (inLexique,  operand_989->node.reader_nodeList (inLexique COMMA_SOURCE_FILE_AT_LINE (64)),  (var_cas_inIndentationString).operator_concat (GGS_string (" ")),  var_cas_ioString COMMA_SOURCE_FILE_AT_LINE (64)) ;
        }
        break ;
      case GGS_xmlNodeType::enum_text:
        {
        var_cas_ioString.appendCString ("TEXT '") ;
        var_cas_ioString.dotAssign_operation (operand_989->node.reader_name (inLexique COMMA_SOURCE_FILE_AT_LINE (66))) ;
        var_cas_ioString.appendCString ("' ") ;
        var_cas_ioString.dotAssign_operation (operand_989->node.reader_name (inLexique COMMA_SOURCE_FILE_AT_LINE (67)).reader_location (inLexique COMMA_SOURCE_FILE_AT_LINE (67)).reader_line (inLexique COMMA_SOURCE_FILE_AT_LINE (67)).reader_string (inLexique COMMA_SOURCE_FILE_AT_LINE (67))) ;
        var_cas_ioString.appendCString (":") ;
        var_cas_ioString.dotAssign_operation (operand_989->node.reader_name (inLexique COMMA_SOURCE_FILE_AT_LINE (68)).reader_location (inLexique COMMA_SOURCE_FILE_AT_LINE (68)).reader_column (inLexique COMMA_SOURCE_FILE_AT_LINE (68)).reader_string (inLexique COMMA_SOURCE_FILE_AT_LINE (68))) ;
        var_cas_ioString.appendCString (":") ;
        var_cas_ioString.dotAssign_operation (operand_989->node.reader_name (inLexique COMMA_SOURCE_FILE_AT_LINE (69)).reader_location (inLexique COMMA_SOURCE_FILE_AT_LINE (69)).reader_locationIndex (inLexique COMMA_SOURCE_FILE_AT_LINE (69)).reader_string (inLexique COMMA_SOURCE_FILE_AT_LINE (69))) ;
        var_cas_ioString.appendCString ("\n") ;
        }
        break ;
      case GGS_xmlNodeType::enum_comment:
        {
        var_cas_ioString.appendCString ("COMMENT '") ;
        var_cas_ioString.dotAssign_operation (operand_989->node.reader_name (inLexique COMMA_SOURCE_FILE_AT_LINE (71))) ;
        var_cas_ioString.appendCString ("' ") ;
        var_cas_ioString.dotAssign_operation (operand_989->node.reader_name (inLexique COMMA_SOURCE_FILE_AT_LINE (72)).reader_location (inLexique COMMA_SOURCE_FILE_AT_LINE (72)).reader_line (inLexique COMMA_SOURCE_FILE_AT_LINE (72)).reader_string (inLexique COMMA_SOURCE_FILE_AT_LINE (72))) ;
        var_cas_ioString.appendCString (":") ;
        var_cas_ioString.dotAssign_operation (operand_989->node.reader_name (inLexique COMMA_SOURCE_FILE_AT_LINE (73)).reader_location (inLexique COMMA_SOURCE_FILE_AT_LINE (73)).reader_column (inLexique COMMA_SOURCE_FILE_AT_LINE (73)).reader_string (inLexique COMMA_SOURCE_FILE_AT_LINE (73))) ;
        var_cas_ioString.appendCString (":") ;
        var_cas_ioString.dotAssign_operation (operand_989->node.reader_name (inLexique COMMA_SOURCE_FILE_AT_LINE (74)).reader_location (inLexique COMMA_SOURCE_FILE_AT_LINE (74)).reader_locationIndex (inLexique COMMA_SOURCE_FILE_AT_LINE (74)).reader_string (inLexique COMMA_SOURCE_FILE_AT_LINE (74))) ;
        var_cas_ioString.appendCString ("\n") ;
        }
        break ;
      case GGS_xmlNodeType::enum_void:
        {
        }
        break ;
      case GGS_xmlNodeType::kNotBuilt:
        break ;
      }
    }
  }
  #ifdef DEBUG_TRACE_ENABLED
    printf ("LEAVE routine_internal_logXMLNodes\n") ;
  #endif
}

//---------------------------------------------------------------------------*
//                                                                           *
//                 Implementation of routine "logXMLNodes"                   *
//                                                                           *
//---------------------------------------------------------------------------*

void routine_logXMLNodes (C_Compiler & inLexique,
                                const GGS_xmlNodeList   var_cas_inNodeList COMMA_UNUSED_LOCATION_ARGS) {
  #ifdef DEBUG_TRACE_ENABLED
    printf ("ENTER routine_logXMLNodes at %s:%d\n", __FILE__, __LINE__) ;
  #endif
  GGS_string var_cas_s ;
  var_cas_s = GGS_string ("") ;
  ::routine_internal_logXMLNodes (inLexique,  var_cas_inNodeList,  GGS_string (""),  var_cas_s COMMA_SOURCE_FILE_AT_LINE (84)) ;
  inLexique.printMessage (var_cas_s COMMA_SOURCE_FILE_AT_LINE (85)) ;
  #ifdef DEBUG_TRACE_ENABLED
    printf ("LEAVE routine_logXMLNodes\n") ;
  #endif
}

//---------------------------------------------------------------------------*

