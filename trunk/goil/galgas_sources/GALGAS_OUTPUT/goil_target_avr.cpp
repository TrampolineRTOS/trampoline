//---------------------------------------------------------------------------*
//                                                                           *
//                        File 'goil_target_avr.cpp'                         *
//                        Generated by version 1.9.5                         *
//                    november 26th, 2009, at 11h43'50"                      *
//                                                                           *
//---------------------------------------------------------------------------*

//--- START OF USER ZONE 1


//--- END OF USER ZONE 1

//---------------------------------------------------------------------------*

#include "version_libpm.h"
#if LIBPM_VERSION != 614
  #error "This file has been compiled with a version of GALGAS different than the version of libpm"
#endif

//---------------------------------------------------------------------------*

#include <typeinfo>
#include "utilities/MF_MemoryControl.h"
#include "files/C_TextFileWrite.h"
#include "galgas/C_galgas_CLI_Options.h"
#include "goil_target_avr.h"

//---------------------------------------------------------------------------*

#ifndef DO_NOT_GENERATE_CHECKINGS
  #define SOURCE_FILE_AT_LINE(line) "goil_target_avr.ggs", line
  #define COMMA_SOURCE_FILE_AT_LINE(line) , SOURCE_FILE_AT_LINE(line)
#else
  #define SOURCE_FILE_AT_LINE(line) 
  #define COMMA_SOURCE_FILE_AT_LINE(line) 
#endif


//--- START OF USER ZONE 2


//--- END OF USER ZONE 2

//---------------------------------------------------------------------------*
//                                                                           *
//             Implementation of routine "generate_target_avr"               *
//                                                                           *
//---------------------------------------------------------------------------*

void routine_generate_target_avr (C_Compiler & inLexique,
                                const GGS_lstring   var_cas_name,
                                const GGS_ident_map   var_cas_others,
                                const GGS_oil_obj   var_cas_exe,
                                GGS_string & var_cas_result COMMA_UNUSED_LOCATION_ARGS) {
  #ifdef DEBUG_TRACE_ENABLED
    printf ("ENTER routine_generate_target_avr at %s:%d\n", __FILE__, __LINE__) ;
  #endif
  ::routine_doReplace (inLexique,  var_cas_result,  GGS_string ("$STACK_ZONE$"),  (var_cas_name.reader_string (inLexique COMMA_SOURCE_FILE_AT_LINE (52))).operator_concat (GGS_string ("_stack")) COMMA_SOURCE_FILE_AT_LINE (52)) ;
  ::routine_doReplace (inLexique,  var_cas_result,  GGS_string ("$EXEC_INTEGER_CONTEXT$"),  (var_cas_name.reader_string (inLexique COMMA_SOURCE_FILE_AT_LINE (53))).operator_concat (GGS_string ("_int_context")) COMMA_SOURCE_FILE_AT_LINE (53)) ;
  GGS_uint  var_cas_stack_size ;
  ::routine_additional_int_key_required (inLexique,  GGS_string ("STACKSIZE"),  var_cas_others,  var_cas_name,  var_cas_stack_size COMMA_SOURCE_FILE_AT_LINE (56)) ;
  ::routine_doReplace (inLexique,  var_cas_result,  GGS_string ("$STACK_SIZE$"),  var_cas_stack_size.reader_string (inLexique COMMA_SOURCE_FILE_AT_LINE (57)) COMMA_SOURCE_FILE_AT_LINE (57)) ;
  { const GGS_oil_obj _var_1816 = var_cas_exe ; // CAST instruction
    if (_var_1816.getPtr () != NULL) {
      macroValidPointer (_var_1816.getPtr ()) ;
      if (typeid (cPtr_isr_obj) == typeid (* (_var_1816.getPtr ()))) {
        GGS_string var_cas_trap ;
        ::routine_additional_string_key_required (inLexique,  GGS_string ("TRAP"),  var_cas_others,  var_cas_name,  var_cas_trap COMMA_SOURCE_FILE_AT_LINE (62)) ;
        ::routine_doReplace (inLexique,  var_cas_result,  GGS_string ("$TRAP$"),  var_cas_trap COMMA_SOURCE_FILE_AT_LINE (63)) ;
      }else{
      }
    }
  }
  #ifdef DEBUG_TRACE_ENABLED
    printf ("LEAVE routine_generate_target_avr\n") ;
  #endif
}

//---------------------------------------------------------------------------*
//                                                                           *
//               Implementation of routine "generate_isr_avr"                *
//                                                                           *
//---------------------------------------------------------------------------*

void routine_generate_isr_avr (C_Compiler & inLexique,
                                const GGS_isr_map   var_cas_isrs,
                                GGS_string & var_cas_code COMMA_UNUSED_LOCATION_ARGS) {
  #ifdef DEBUG_TRACE_ENABLED
    printf ("ENTER routine_generate_isr_avr at %s:%d\n", __FILE__, __LINE__) ;
  #endif
  GGS_string var_cas_result = GGS_string ("") ;
  {
    GGS_isr_map::cEnumerator enumerator_1940 (var_cas_isrs, true) ;
    const GGS_isr_map::cElement * operand_1940 = NULL ;
    while (((operand_1940 = enumerator_1940.nextObject ()))) {
      macroValidPointer (operand_1940) ;
      GGS_ident_map  var_cas_others = operand_1940->mInfo.isr.reader_other_fields (inLexique COMMA_SOURCE_FILE_AT_LINE (74)) ;
      GGS_string var_cas_tmp = function_template_string (inLexique, GGS_string ("code"), GGS_string ("isr_list_specific") COMMA_SOURCE_FILE_AT_LINE (77)) ;
      ::routine_doReplace (inLexique,  var_cas_tmp,  GGS_string ("$EXEC_NAME$"),  operand_1940->mKey.reader_string (inLexique COMMA_SOURCE_FILE_AT_LINE (79)) COMMA_SOURCE_FILE_AT_LINE (79)) ;
      var_cas_result.dotAssign_operation (var_cas_tmp) ;
    }
  }
  ::routine_doReplace (inLexique,  var_cas_code,  GGS_string ("$ISR_LIST$"),  var_cas_result COMMA_SOURCE_FILE_AT_LINE (82)) ;
  #ifdef DEBUG_TRACE_ENABLED
    printf ("LEAVE routine_generate_isr_avr\n") ;
  #endif
}

//---------------------------------------------------------------------------*
//                                                                           *
//             Implementation of routine "generate_counter_avr"              *
//                                                                           *
//---------------------------------------------------------------------------*

void routine_generate_counter_avr (C_Compiler & inLexique,
                                const GGS_counter_map   var_cas_counters,
                                GGS_string & var_cas_code COMMA_UNUSED_LOCATION_ARGS) {
  #ifdef DEBUG_TRACE_ENABLED
    printf ("ENTER routine_generate_counter_avr at %s:%d\n", __FILE__, __LINE__) ;
  #endif
  GGS_string var_cas_result = GGS_string ("") ;
  {
    GGS_counter_map::cEnumerator enumerator_2434 (var_cas_counters, true) ;
    const GGS_counter_map::cElement * operand_2434 = NULL ;
    while (((operand_2434 = enumerator_2434.nextObject ()))) {
      macroValidPointer (operand_2434) ;
      { const GGS_counter_type _var_2733 = operand_2434->mInfo.counter.reader_type (inLexique COMMA_SOURCE_FILE_AT_LINE (91)) ; // CAST instruction
        if (_var_2733.getPtr () != NULL) {
          macroValidPointer (_var_2733.getPtr ()) ;
          if (typeid (cPtr_software_counter) == typeid (* (_var_2733.getPtr ()))) {
          }else{
            GGS_string var_cas_tmp = function_template_string (inLexique, GGS_string ("code"), GGS_string ("counter_list_specific") COMMA_SOURCE_FILE_AT_LINE (94)) ;
            ::routine_doReplace (inLexique,  var_cas_tmp,  GGS_string ("$COUNTER$"),  (operand_2434->mKey.reader_string (inLexique COMMA_SOURCE_FILE_AT_LINE (95))).operator_concat (GGS_string ("_counter_desc")) COMMA_SOURCE_FILE_AT_LINE (95)) ;
            var_cas_result.dotAssign_operation (var_cas_tmp) ;
          }
        }
      }
    }
  }
  ::routine_doReplace (inLexique,  var_cas_code,  GGS_string ("$COUNTER_LIST$"),  var_cas_result COMMA_SOURCE_FILE_AT_LINE (100)) ;
  #ifdef DEBUG_TRACE_ENABLED
    printf ("LEAVE routine_generate_counter_avr\n") ;
  #endif
}

//---------------------------------------------------------------------------*

