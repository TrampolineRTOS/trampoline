//---------------------------------------------------------------------------*
//                                                                           *
//                          File 'api_parser.cpp'                            *
//                       Generated by version 1.9.10                         *
//                      april 13th, 2010, at 10h15'58"                       *
//                                                                           *
//---------------------------------------------------------------------------*

//--- START OF USER ZONE 1


//--- END OF USER ZONE 1

//---------------------------------------------------------------------------*

#include "version_libpm.h"
#if LIBPM_VERSION != 688
  #error "This file has been compiled with a version of GALGAS different than the version of libpm"
#endif

//---------------------------------------------------------------------------*

#include <typeinfo>
#include "utilities/MF_MemoryControl.h"
#include "files/C_TextFileWrite.h"
#include "galgas/C_galgas_CLI_Options.h"
#include "api_parser.h"

//---------------------------------------------------------------------------*

#ifndef DO_NOT_GENERATE_CHECKINGS
  #define SOURCE_FILE_AT_LINE(line) "api_parser.gSyntax", line
  #define COMMA_SOURCE_FILE_AT_LINE(line) , SOURCE_FILE_AT_LINE(line)
#else
  #define SOURCE_FILE_AT_LINE(line) 
  #define COMMA_SOURCE_FILE_AT_LINE(line) 
#endif


//--- START OF USER ZONE 2


//--- END OF USER ZONE 2

//---------------------------------------------------------------------------*
//                                                                           *
//              Implementation of production rule 'api_start'                *
//                                                                           *
//---------------------------------------------------------------------------*

void api_parser::rule_api_5F_parser_api_5F_start_i0_ (C_Lexique_api_5F_scanner & inLexique,
                                GGS_goilTemplateVariableMap  &var_cas_cfg) {
  GGS_goilTemplateValue var_cas_value ;
  GGS_goilTemplateType automatic_var_709_0 ;
  const GGS_goilTemplateVariableMap  temp_666 = var_cas_cfg ;
  if (temp_666.isBuilt ()) {
    temp_666 (HERE)->method_searchKey (inLexique, GGS_lstring ::constructor_new (inLexique, GGS_string ("USECOM"), GGS_location (inLexique) COMMA_HERE), automatic_var_709_0, var_cas_value COMMA_SOURCE_FILE_AT_LINE (29)) ;
  }
  GGS_bool var_cas_usecom = (var_cas_value.reader_mUnsigned64Value (inLexique COMMA_SOURCE_FILE_AT_LINE (30))).operator_isEqual (GGS_uint64 (1ULL)) ;
  GGS_goilTemplateType automatic_var_823_0 ;
  const GGS_goilTemplateVariableMap  temp_779 = var_cas_cfg ;
  if (temp_779.isBuilt ()) {
    temp_779 (HERE)->method_searchKey (inLexique, GGS_lstring ::constructor_new (inLexique, GGS_string ("AUTOSAR"), GGS_location (inLexique) COMMA_HERE), automatic_var_823_0, var_cas_value COMMA_SOURCE_FILE_AT_LINE (31)) ;
  }
  GGS_bool var_cas_autosar = (var_cas_value.reader_mUnsigned64Value (inLexique COMMA_SOURCE_FILE_AT_LINE (32))).operator_isEqual (GGS_uint64 (1ULL)) ;
  GGS_goilTemplateType automatic_var_947_0 ;
  const GGS_goilTemplateVariableMap  temp_894 = var_cas_cfg ;
  if (temp_894.isBuilt ()) {
    temp_894 (HERE)->method_searchKey (inLexique, GGS_lstring ::constructor_new (inLexique, GGS_string ("SCALABILITYCLASS"), GGS_location (inLexique) COMMA_HERE), automatic_var_947_0, var_cas_value COMMA_SOURCE_FILE_AT_LINE (33)) ;
  }
  GGS_uint64  var_cas_scalabilityclass = var_cas_value.reader_mUnsigned64Value (inLexique COMMA_SOURCE_FILE_AT_LINE (34)) ;
  GGS_goilTemplateFieldMap  var_cas_api = GGS_goilTemplateFieldMap ::constructor_emptyMap (inLexique COMMA_HERE) ;
  GGS_goilTemplateFieldMapList  var_cas_usedFiles = GGS_goilTemplateFieldMapList ::constructor_emptyList () ;
  GGS_goilTemplateFieldMapList  var_cas_usedApi = GGS_goilTemplateFieldMapList ::constructor_emptyList () ;
  { bool syntaxRepeat_0 = true ;
    while (syntaxRepeat_0) {
      switch (select_api_5F_parser_0 (inLexique)) {
        case 2 : {
          GGS_lstring  var_cas_sectionName ;
          GGS_goilTemplateFieldMapList  var_cas_section ;
          inLexique.assignFromAttribute_att_5F_token (var_cas_sectionName) ;
          inLexique.acceptTerminal (ACCEPT_TERMINAL (C_Lexique_api_5F_scanner::kToken_idf) COMMA_HERE) ;
          GGS_string var_cas_sn = var_cas_sectionName.reader_string (inLexique COMMA_SOURCE_FILE_AT_LINE (44)) ;
          GGS_bool var_cas_valid = ((((((var_cas_sn).operator_isEqual (GGS_string ("COM"))).operator_and (var_cas_usecom)).operator_or (((((var_cas_sn).operator_isEqual (GGS_string ("ISR"))).operator_or ((var_cas_sn).operator_isEqual (GGS_string ("COUNTER")))).operator_or ((var_cas_sn).operator_isEqual (GGS_string ("SCHEDULETABLE")))).operator_and (var_cas_autosar))).operator_or (((var_cas_sn).operator_isEqual (GGS_string ("GLOBALTIME"))).operator_and (((var_cas_scalabilityclass).operator_isEqual (GGS_uint64 (2ULL))).operator_or ((var_cas_scalabilityclass).operator_isEqual (GGS_uint64 (4ULL)))))).operator_or ((((((var_cas_sn).operator_isEqual (GGS_string ("OSAPPLICATION"))).operator_or ((var_cas_sn).operator_isEqual (GGS_string ("MEMORYPROTECTION")))).operator_or ((var_cas_sn).operator_isEqual (GGS_string ("SERVICEPROTECTION")))).operator_or ((var_cas_sn).operator_isEqual (GGS_string ("TRUSTEDFUNCTION")))).operator_and (((var_cas_scalabilityclass).operator_isEqual (GGS_uint64 (3ULL))).operator_or ((var_cas_scalabilityclass).operator_isEqual (GGS_uint64 (4ULL)))))).operator_or (((((((var_cas_sn).operator_isEqual (GGS_string ("TASK"))).operator_or ((var_cas_sn).operator_isEqual (GGS_string ("INTERRUPT")))).operator_or ((var_cas_sn).operator_isEqual (GGS_string ("RESOURCE")))).operator_or ((var_cas_sn).operator_isEqual (GGS_string ("EVENT")))).operator_or ((var_cas_sn).operator_isEqual (GGS_string ("ALARM")))).operator_or ((var_cas_sn).operator_isEqual (GGS_string ("OS")))) ;
          switch (select_api_5F_parser_1 (inLexique)) {
            case 1 : {
              inLexique.acceptTerminal (ACCEPT_TERMINAL (C_Lexique_api_5F_scanner::kToken__28_) COMMA_HERE) ;
              GGS_lstring  var_cas_file ;
              inLexique.assignFromAttribute_att_5F_token (var_cas_file) ;
              inLexique.acceptTerminal (ACCEPT_TERMINAL (C_Lexique_api_5F_scanner::kToken_idf) COMMA_HERE) ;
              inLexique.acceptTerminal (ACCEPT_TERMINAL (C_Lexique_api_5F_scanner::kToken__29_) COMMA_HERE) ;
              ::routine_addLStringFieldValue (inLexique,  var_cas_api,  (var_cas_sn).operator_concat (GGS_string ("FILE")),  var_cas_file COMMA_SOURCE_FILE_AT_LINE (53)) ;
              const GGS_bool cond_2046 = var_cas_valid ;
              if (cond_2046.isBuiltAndTrue ()) {
                GGS_goilTemplateFieldMap  var_cas_fileEntry = GGS_goilTemplateFieldMap ::constructor_emptyMap (inLexique COMMA_HERE) ;
                ::routine_addLStringFieldValue (inLexique,  var_cas_fileEntry,  GGS_string ("FILE"),  var_cas_file COMMA_SOURCE_FILE_AT_LINE (56)) ;
                var_cas_usedFiles.addAssign_operation (var_cas_fileEntry) ;
              }
              } break ;
            case 2 : {
              } break ;
            default :
              break ;
          }
          nt_api_5F_section_ (inLexique, var_cas_section) ;
          ::routine_addListFieldValue (inLexique,  var_cas_api,  var_cas_sectionName,  var_cas_section COMMA_SOURCE_FILE_AT_LINE (61)) ;
          const GGS_bool cond_2211 = var_cas_valid ;
          if (cond_2211.isBuiltAndTrue ()) {
            var_cas_usedApi = (var_cas_usedApi).operator_concat (var_cas_section) ;
          }
          } break ;
        default :
          syntaxRepeat_0 = false ;
          break ;
      }
    }
  }
  ::routine_addListFieldValue (inLexique,  var_cas_api,  GGS_lstring ::constructor_new (inLexique, GGS_string ("USEDAPI"), GGS_location (inLexique) COMMA_HERE),  var_cas_usedApi COMMA_SOURCE_FILE_AT_LINE (66)) ;
  ::routine_addListFieldValue (inLexique,  var_cas_api,  GGS_lstring ::constructor_new (inLexique, GGS_string ("USEDFILES"), GGS_location (inLexique) COMMA_HERE),  var_cas_usedFiles COMMA_SOURCE_FILE_AT_LINE (67)) ;
  ::routine_addStructValue (inLexique,  var_cas_cfg,  GGS_lstring ::constructor_new (inLexique, GGS_string ("APICONFIG"), GGS_location (inLexique) COMMA_HERE),  var_cas_api COMMA_SOURCE_FILE_AT_LINE (69)) ;
}

//---------------------------------------------------------------------------*
//                                                                           *
//             Implementation of production rule 'api_section'               *
//                                                                           *
//---------------------------------------------------------------------------*

void api_parser::rule_api_5F_parser_api_5F_section_i1_ (C_Lexique_api_5F_scanner & inLexique,
                                GGS_goilTemplateFieldMapList  &var_cas_outList) {
  inLexique.acceptTerminal (ACCEPT_TERMINAL (C_Lexique_api_5F_scanner::kToken__7B_) COMMA_HERE) ;
  var_cas_outList = GGS_goilTemplateFieldMapList ::constructor_emptyList () ;
  { bool syntaxRepeat_2 = true ;
    while (syntaxRepeat_2) {
      switch (select_api_5F_parser_2 (inLexique)) {
        case 2 : {
          GGS_lstring  var_cas_realApiFct ;
          GGS_lstring  var_cas_apiFct ;
          inLexique.assignFromAttribute_att_5F_token (var_cas_apiFct) ;
          inLexique.acceptTerminal (ACCEPT_TERMINAL (C_Lexique_api_5F_scanner::kToken_idf) COMMA_HERE) ;
          switch (select_api_5F_parser_3 (inLexique)) {
            case 1 : {
              inLexique.acceptTerminal (ACCEPT_TERMINAL (C_Lexique_api_5F_scanner::kToken__28_) COMMA_HERE) ;
              inLexique.assignFromAttribute_att_5F_token (var_cas_realApiFct) ;
              inLexique.acceptTerminal (ACCEPT_TERMINAL (C_Lexique_api_5F_scanner::kToken_idf) COMMA_HERE) ;
              inLexique.acceptTerminal (ACCEPT_TERMINAL (C_Lexique_api_5F_scanner::kToken__29_) COMMA_HERE) ;
              } break ;
            case 2 : {
              var_cas_realApiFct = var_cas_apiFct ;
              } break ;
            default :
              break ;
          }
          inLexique.acceptTerminal (ACCEPT_TERMINAL (C_Lexique_api_5F_scanner::kToken__2D__3E_) COMMA_HERE) ;
          GGS_lstring  var_cas_kernelFct ;
          inLexique.assignFromAttribute_att_5F_token (var_cas_kernelFct) ;
          inLexique.acceptTerminal (ACCEPT_TERMINAL (C_Lexique_api_5F_scanner::kToken_idf) COMMA_HERE) ;
          inLexique.acceptTerminal (ACCEPT_TERMINAL (C_Lexique_api_5F_scanner::kToken__3B_) COMMA_HERE) ;
          GGS_goilTemplateFieldMap  var_cas_apiEntry = GGS_goilTemplateFieldMap ::constructor_emptyMap (inLexique COMMA_HERE) ;
          ::routine_addLStringFieldValue (inLexique,  var_cas_apiEntry,  GGS_string ("API"),  var_cas_apiFct COMMA_SOURCE_FILE_AT_LINE (87)) ;
          ::routine_addLStringFieldValue (inLexique,  var_cas_apiEntry,  GGS_string ("REAL"),  var_cas_realApiFct COMMA_SOURCE_FILE_AT_LINE (88)) ;
          ::routine_addLStringFieldValue (inLexique,  var_cas_apiEntry,  GGS_string ("KERNEL"),  var_cas_kernelFct COMMA_SOURCE_FILE_AT_LINE (89)) ;
          var_cas_outList.addAssign_operation (var_cas_apiEntry) ;
          } break ;
        default :
          syntaxRepeat_2 = false ;
          break ;
      }
    }
  }
  inLexique.acceptTerminal (ACCEPT_TERMINAL (C_Lexique_api_5F_scanner::kToken__7D_) COMMA_HERE) ;
  inLexique.acceptTerminal (ACCEPT_TERMINAL (C_Lexique_api_5F_scanner::kToken__3B_) COMMA_HERE) ;
}

//---------------------------------------------------------------------------*

