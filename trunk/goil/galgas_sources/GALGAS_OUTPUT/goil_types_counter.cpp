//---------------------------------------------------------------------------*
//                                                                           *
//                      File 'goil_types_counter.cpp'                        *
//                    Generated by version version 2.1.4                     *
//                     january 10th, 2011, at 14h31'41"                      *
//                                                                           *
//---------------------------------------------------------------------------*

//--- START OF USER ZONE 1


//--- END OF USER ZONE 1

#include "version_libpm.h"
#if CURRENT_LIBPM_VERSION != 926
  #error "This file has been compiled with a version of GALGAS that uses libpm version 926, different than the current version (CURRENT_LIBPM_VERSION) of libpm"
#endif

//---------------------------------------------------------------------------*

#include "goil_types_counter.h"
#include "galgas2/C_Compiler.h"
#include "galgas2/C_galgas_CLI_Options.h"

//---------------------------------------------------------------------------*


//---------------------------------------------------------------------------*

#ifndef DO_NOT_GENERATE_CHECKINGS
  #define SOURCE_FILE_AT_LINE(line) "goil_types_counter.gSemantics", line
  #define COMMA_SOURCE_FILE_AT_LINE(line) , SOURCE_FILE_AT_LINE(line)
#else
  #define SOURCE_FILE_AT_LINE(line) 
  #define COMMA_SOURCE_FILE_AT_LINE(line) 
#endif

//---------------------------------------------------------------------------*
//                                                                           *
//              Class for element of '@time_5F_constants' list               *
//                                                                           *
//---------------------------------------------------------------------------*

class cCollectionElement_time_5F_constants : public cCollectionElement {
//--- List attributes
  public : GALGAS_basic_5F_type mAttribute_ns ;
  public : GALGAS_lstring mAttribute_const_5F_name ;

//--- Constructor
  public : cCollectionElement_time_5F_constants (const GALGAS_basic_5F_type & in_ns,
                                                 const GALGAS_lstring & in_const_5F_name
                                                 COMMA_LOCATION_ARGS) ;

//--- Virtual method for comparing elements
  public : virtual enumComparisonResult compare (const cCollectionElement * inOperand) const ;

//--- Virtual method that checks that all attributes are valid
  public : virtual bool isValid (void) const ;

//--- Virtual method that returns a copy of current object
  public : virtual cCollectionElement * copy (void) ;

//--- Description
 public : virtual void description (C_String & ioString, const PMSInt32 inIndentation) const ;
} ;

//---------------------------------------------------------------------------*

cCollectionElement_time_5F_constants::cCollectionElement_time_5F_constants (const GALGAS_basic_5F_type & in_ns,
                                                                            const GALGAS_lstring & in_const_5F_name
                                                                            COMMA_LOCATION_ARGS) :
cCollectionElement (THERE),
mAttribute_ns (in_ns),
mAttribute_const_5F_name (in_const_5F_name) {
}

//---------------------------------------------------------------------------*

bool cCollectionElement_time_5F_constants::isValid (void) const {
  return mAttribute_ns.isValid () && mAttribute_const_5F_name.isValid () ;
}

//---------------------------------------------------------------------------*

cCollectionElement * cCollectionElement_time_5F_constants::copy (void) {
  cCollectionElement * result = NULL ;
  macroMyNew (result, cCollectionElement_time_5F_constants (mAttribute_ns, mAttribute_const_5F_name COMMA_HERE)) ;
  return result ;
}

//---------------------------------------------------------------------------*

void cCollectionElement_time_5F_constants::description (C_String & ioString, const PMSInt32 inIndentation) const {
  ioString << "\n" ;
  ioString.writeStringMultiple ("| ", inIndentation) ;
  ioString << "ns" ":" ;
  mAttribute_ns.description (ioString, inIndentation) ;
  ioString << "\n" ;
  ioString.writeStringMultiple ("| ", inIndentation) ;
  ioString << "const_name" ":" ;
  mAttribute_const_5F_name.description (ioString, inIndentation) ;
}

//---------------------------------------------------------------------------*

enumComparisonResult cCollectionElement_time_5F_constants::compare (const cCollectionElement * inOperand) const {
  cCollectionElement_time_5F_constants * operand = (cCollectionElement_time_5F_constants *) inOperand ;
  enumComparisonResult result = kOperandEqual ;
  if (kOperandEqual == result) {
    result = mAttribute_ns.objectCompare (operand->mAttribute_ns) ;
  }
  if (kOperandEqual == result) {
    result = mAttribute_const_5F_name.objectCompare (operand->mAttribute_const_5F_name) ;
  }
  return result ;
}

//---------------------------------------------------------------------------*

GALGAS_time_5F_constants::GALGAS_time_5F_constants (void) :
AC_GALGAS_list () {
}

//---------------------------------------------------------------------------*

GALGAS_time_5F_constants::GALGAS_time_5F_constants (cSharedList * inSharedListPtr) :
AC_GALGAS_list (inSharedListPtr) {
  if (NULL == inSharedListPtr) {
    createNewEmptyList (HERE) ;
  }
}

//---------------------------------------------------------------------------*

GALGAS_time_5F_constants GALGAS_time_5F_constants::constructor_emptyList (LOCATION_ARGS) {
  GALGAS_time_5F_constants result ;
  result.createNewEmptyList (THERE) ;
  return result ;
}

//---------------------------------------------------------------------------*

GALGAS_time_5F_constants GALGAS_time_5F_constants::constructor_listWithValue (const GALGAS_basic_5F_type & inOperand0,
                                                                              const GALGAS_lstring & inOperand1
                                                                              COMMA_LOCATION_ARGS) {
  GALGAS_time_5F_constants result ;
  if (inOperand0.isValid () && inOperand1.isValid ()) {
    result.createNewEmptyList (THERE) ;
    capCollectionElement attributes ;
    GALGAS_time_5F_constants::makeAttributesFromObjects (attributes, inOperand0, inOperand1 COMMA_THERE) ;
    result.addObject (attributes) ;
  }
  return result ;
}

//---------------------------------------------------------------------------*

void GALGAS_time_5F_constants::makeAttributesFromObjects (capCollectionElement & outAttributes,
                                                          const GALGAS_basic_5F_type & in_ns,
                                                          const GALGAS_lstring & in_const_5F_name
                                                          COMMA_LOCATION_ARGS) {
  cCollectionElement_time_5F_constants * p = NULL ;
  macroMyNew (p, cCollectionElement_time_5F_constants (in_ns,
                                                          in_const_5F_name COMMA_THERE)) ;
  outAttributes.setPointer (p) ;
  macroDetachSharedObject (p) ;
}

//---------------------------------------------------------------------------*

void GALGAS_time_5F_constants::addAssign_operation (const GALGAS_basic_5F_type & inOperand0,
                                                    const GALGAS_lstring & inOperand1
                                                    COMMA_LOCATION_ARGS) {
  if (isValid () && inOperand0.isValid () && inOperand1.isValid ()) {
    cCollectionElement * p = NULL ;
    macroMyNew (p, cCollectionElement_time_5F_constants (inOperand0, inOperand1 COMMA_THERE)) ;
    capCollectionElement attributes ;
    attributes.setPointer (p) ;
    macroDetachSharedObject (p) ;
    addObject (attributes) ;
  }
}

//---------------------------------------------------------------------------*

void GALGAS_time_5F_constants::modifier_prependValue (GALGAS_basic_5F_type inOperand0,
                                                      GALGAS_lstring inOperand1
                                                      COMMA_LOCATION_ARGS) {
  if (isValid () && inOperand0.isValid () && inOperand1.isValid ()) {
    cCollectionElement * p = NULL ;
    macroMyNew (p, cCollectionElement_time_5F_constants (inOperand0, inOperand1 COMMA_THERE)) ;
    capCollectionElement attributes ;
    attributes.setPointer (p) ;
    macroDetachSharedObject (p) ;
    prependAttributeArray (attributes) ;
  }
}

//---------------------------------------------------------------------------*

void GALGAS_time_5F_constants::modifier_popFirst (GALGAS_basic_5F_type & outOperand0,
                                                  GALGAS_lstring & outOperand1,
                                                  C_Compiler * inCompiler
                                                  COMMA_LOCATION_ARGS) {
  capCollectionElement attributes ;
  removeFirstObject (attributes, inCompiler COMMA_THERE) ;
  cCollectionElement_time_5F_constants * p = (cCollectionElement_time_5F_constants *) attributes.ptr () ;
  if (NULL == p) {
    outOperand0.drop () ;
    outOperand1.drop () ;
  }else{
    macroValidSharedObject (p, cCollectionElement_time_5F_constants) ;
    outOperand0 = p->mAttribute_ns ;
    outOperand1 = p->mAttribute_const_5F_name ;
  }
}

//---------------------------------------------------------------------------*

void GALGAS_time_5F_constants::modifier_popLast (GALGAS_basic_5F_type & outOperand0,
                                                 GALGAS_lstring & outOperand1,
                                                 C_Compiler * inCompiler
                                                 COMMA_LOCATION_ARGS) {
  capCollectionElement attributes ;
  removeLastObject (attributes, inCompiler COMMA_THERE) ;
  cCollectionElement_time_5F_constants * p = (cCollectionElement_time_5F_constants *) attributes.ptr () ;
  if (NULL == p) {
    outOperand0.drop () ;
    outOperand1.drop () ;
  }else{
    macroValidSharedObject (p, cCollectionElement_time_5F_constants) ;
    outOperand0 = p->mAttribute_ns ;
    outOperand1 = p->mAttribute_const_5F_name ;
  }
}

//---------------------------------------------------------------------------*

void GALGAS_time_5F_constants::method_first (GALGAS_basic_5F_type & outOperand0,
                                             GALGAS_lstring & outOperand1,
                                             C_Compiler * inCompiler
                                             COMMA_LOCATION_ARGS) const {
  capCollectionElement attributes ;
  readFirst (attributes, inCompiler COMMA_THERE) ;
  cCollectionElement_time_5F_constants * p = (cCollectionElement_time_5F_constants *) attributes.ptr () ;
  if (NULL == p) {
    outOperand0.drop () ;
    outOperand1.drop () ;
  }else{
    macroValidSharedObject (p, cCollectionElement_time_5F_constants) ;
    outOperand0 = p->mAttribute_ns ;
    outOperand1 = p->mAttribute_const_5F_name ;
  }
}

//---------------------------------------------------------------------------*

void GALGAS_time_5F_constants::method_last (GALGAS_basic_5F_type & outOperand0,
                                            GALGAS_lstring & outOperand1,
                                            C_Compiler * inCompiler
                                            COMMA_LOCATION_ARGS) const {
  capCollectionElement attributes ;
  readLast (attributes, inCompiler COMMA_THERE) ;
  cCollectionElement_time_5F_constants * p = (cCollectionElement_time_5F_constants *) attributes.ptr () ;
  if (NULL == p) {
    outOperand0.drop () ;
    outOperand1.drop () ;
  }else{
    macroValidSharedObject (p, cCollectionElement_time_5F_constants) ;
    outOperand0 = p->mAttribute_ns ;
    outOperand1 = p->mAttribute_const_5F_name ;
  }
}

//---------------------------------------------------------------------------*

GALGAS_time_5F_constants GALGAS_time_5F_constants::operator_concat (const GALGAS_time_5F_constants & inOperand
                                                                    COMMA_UNUSED_LOCATION_ARGS) const {
  GALGAS_time_5F_constants result ;
  if (isValid () && inOperand.isValid ()) {
    result = *this ;
    result.appendList (inOperand) ;
  }
  return result ;
}

//---------------------------------------------------------------------------*

GALGAS_time_5F_constants GALGAS_time_5F_constants::reader_subListWithRange (const GALGAS_uint & inIndex,
                                                                            const GALGAS_uint & inLength,
                                                                            C_Compiler * inCompiler
                                                                            COMMA_LOCATION_ARGS) const {
  GALGAS_time_5F_constants result = GALGAS_time_5F_constants::constructor_emptyList (THERE) ;
  subListWithRange (result, inIndex, inLength, inCompiler COMMA_THERE) ;
  return result ;
}

//---------------------------------------------------------------------------*

GALGAS_time_5F_constants GALGAS_time_5F_constants::reader_subListFromIndex (const GALGAS_uint & inIndex,
                                                                            C_Compiler * inCompiler
                                                                            COMMA_LOCATION_ARGS) const {
  GALGAS_time_5F_constants result = GALGAS_time_5F_constants::constructor_emptyList (THERE) ;
  subListFromIndex (result, inIndex, inCompiler COMMA_THERE) ;
  return result ;
}

//---------------------------------------------------------------------------*

void GALGAS_time_5F_constants::dotAssign_operation (const GALGAS_time_5F_constants inOperand
                                                    COMMA_UNUSED_LOCATION_ARGS) {
  appendList (inOperand) ;
}

//---------------------------------------------------------------------------*

void GALGAS_time_5F_constants::modifier_setNsAtIndex (GALGAS_basic_5F_type inOperand,
                                                      GALGAS_uint inIndex,
                                                      C_Compiler * inCompiler
                                                      COMMA_LOCATION_ARGS) {
  cCollectionElement_time_5F_constants * p = (cCollectionElement_time_5F_constants *) objectPointerAtIndex (inIndex, inCompiler COMMA_THERE) ;
  if (NULL != p) {
    macroValidSharedObject (p, cCollectionElement_time_5F_constants) ;
    p->mAttribute_ns = inOperand ;
  }
}

//---------------------------------------------------------------------------*

void GALGAS_time_5F_constants::modifier_setConst_5F_nameAtIndex (GALGAS_lstring inOperand,
                                                                 GALGAS_uint inIndex,
                                                                 C_Compiler * inCompiler
                                                                 COMMA_LOCATION_ARGS) {
  cCollectionElement_time_5F_constants * p = (cCollectionElement_time_5F_constants *) objectPointerAtIndex (inIndex, inCompiler COMMA_THERE) ;
  if (NULL != p) {
    macroValidSharedObject (p, cCollectionElement_time_5F_constants) ;
    p->mAttribute_const_5F_name = inOperand ;
  }
}


//---------------------------------------------------------------------------*

GALGAS_basic_5F_type GALGAS_time_5F_constants::reader_nsAtIndex (const GALGAS_uint & inIndex,
                                                                 C_Compiler * inCompiler
                                                                 COMMA_LOCATION_ARGS) const {
  capCollectionElement attributes = readObjectAtIndex (inIndex, inCompiler COMMA_THERE) ;
  cCollectionElement_time_5F_constants * p = (cCollectionElement_time_5F_constants *) attributes.ptr () ;
  GALGAS_basic_5F_type result ;
  if (NULL != p) {
    macroValidSharedObject (p, cCollectionElement_time_5F_constants) ;
    result = p->mAttribute_ns ;
  }
  return result ;
}

//---------------------------------------------------------------------------*

GALGAS_lstring GALGAS_time_5F_constants::reader_const_5F_nameAtIndex (const GALGAS_uint & inIndex,
                                                                      C_Compiler * inCompiler
                                                                      COMMA_LOCATION_ARGS) const {
  capCollectionElement attributes = readObjectAtIndex (inIndex, inCompiler COMMA_THERE) ;
  cCollectionElement_time_5F_constants * p = (cCollectionElement_time_5F_constants *) attributes.ptr () ;
  GALGAS_lstring result ;
  if (NULL != p) {
    macroValidSharedObject (p, cCollectionElement_time_5F_constants) ;
    result = p->mAttribute_const_5F_name ;
  }
  return result ;
}



//---------------------------------------------------------------------------*

cEnumerator_time_5F_constants::cEnumerator_time_5F_constants (const GALGAS_time_5F_constants & inEnumeratedObject,
                                                              const bool inAscending) :
cGenericAbstractEnumerator () {
  inEnumeratedObject.populateEnumerationArray (mEnumerationArray, inAscending) ;
}

//---------------------------------------------------------------------------*

GALGAS_basic_5F_type cEnumerator_time_5F_constants::current_ns (LOCATION_ARGS) const {
  const cCollectionElement_time_5F_constants * p = (const cCollectionElement_time_5F_constants *) currentObjectPtr (THERE) ;
  macroValidSharedObject (p, const cCollectionElement_time_5F_constants) ;
  return p->mAttribute_ns ;
}

//---------------------------------------------------------------------------*

GALGAS_lstring cEnumerator_time_5F_constants::current_const_5F_name (LOCATION_ARGS) const {
  const cCollectionElement_time_5F_constants * p = (const cCollectionElement_time_5F_constants *) currentObjectPtr (THERE) ;
  macroValidSharedObject (p, const cCollectionElement_time_5F_constants) ;
  return p->mAttribute_const_5F_name ;
}




//---------------------------------------------------------------------------*
//                                                                           *
//                           @time_constants type                            *
//                                                                           *
//---------------------------------------------------------------------------*

const C_galgas_type_descriptor
kTypeDescriptor_GALGAS_time_5F_constants ("time_constants",
                                          NULL) ;

//---------------------------------------------------------------------------*

const C_galgas_type_descriptor * GALGAS_time_5F_constants::staticTypeDescriptor (void) const {
  return & kTypeDescriptor_GALGAS_time_5F_constants ;
}

//---------------------------------------------------------------------------*

AC_GALGAS_root * GALGAS_time_5F_constants::clonedObject (void) const {
  AC_GALGAS_root * result = NULL ;
  if (isValid ()) {
    macroMyNew (result, GALGAS_time_5F_constants (*this)) ;
  }
  return result ;
}

//---------------------------------------------------------------------------*

GALGAS_time_5F_constants GALGAS_time_5F_constants::extractObject (const GALGAS_object & inObject,
                                                                  C_Compiler * inCompiler,
                                                                  const GALGAS_location & inErrorLocation
                                                                  COMMA_LOCATION_ARGS) {
  GALGAS_time_5F_constants result ;
  const GALGAS_time_5F_constants * p = (const GALGAS_time_5F_constants *) inObject.embeddedObject () ;
  if (NULL != p) {
    if (NULL != dynamic_cast <const GALGAS_time_5F_constants *> (p)) {
      result = *p ;
    }else{
      inCompiler->extractObjectError (inErrorLocation, "time_constants", p->dynamicTypeDescriptor () COMMA_THERE) ;
    }  
  }
  return result ;
}

//---------------------------------------------------------------------------*

cMapElement_counter_5F_map::cMapElement_counter_5F_map (const GALGAS_lstring & inKey,
                                                        const GALGAS_counter_5F_obj & in_counter
                                                        COMMA_LOCATION_ARGS) :
cMapElement (inKey COMMA_THERE),
mAttribute_counter (in_counter) {
}

//---------------------------------------------------------------------------*

bool cMapElement_counter_5F_map::isValid (void) const {
  return mAttribute_lkey.isValid () && mAttribute_counter.isValid () ;
}

//---------------------------------------------------------------------------*

cMapElement * cMapElement_counter_5F_map::copy (void) {
  cMapElement * result = NULL ;
  macroMyNew (result, cMapElement_counter_5F_map (mAttribute_lkey, mAttribute_counter COMMA_HERE)) ;
  return result ;
}

//---------------------------------------------------------------------------*

void cMapElement_counter_5F_map::description (C_String & ioString, const PMSInt32 inIndentation) const {
  ioString << "\n" ;
  ioString.writeStringMultiple ("| ", inIndentation) ;
  ioString << "counter" ":" ;
  mAttribute_counter.description (ioString, inIndentation) ;
}

//---------------------------------------------------------------------------*

enumComparisonResult cMapElement_counter_5F_map::compare (const cCollectionElement * inOperand) const {
  cMapElement_counter_5F_map * operand = (cMapElement_counter_5F_map *) inOperand ;
  enumComparisonResult result = mAttribute_lkey.objectCompare (operand->mAttribute_lkey) ;
  if (kOperandEqual == result) {
    result = mAttribute_counter.objectCompare (operand->mAttribute_counter) ;
  }
  return result ;
}

//---------------------------------------------------------------------------*

GALGAS_counter_5F_map::GALGAS_counter_5F_map (void) :
AC_GALGAS_map () {
}

//---------------------------------------------------------------------------*

GALGAS_counter_5F_map::GALGAS_counter_5F_map (const GALGAS_counter_5F_map & inSource) :
AC_GALGAS_map (inSource) {
}

//---------------------------------------------------------------------------*

GALGAS_counter_5F_map & GALGAS_counter_5F_map::operator = (const GALGAS_counter_5F_map & inSource) {
  * ((AC_GALGAS_map *) this) = inSource ;
  return * this ;
}

//---------------------------------------------------------------------------*

GALGAS_counter_5F_map GALGAS_counter_5F_map::constructor_emptyMap (LOCATION_ARGS) {
  GALGAS_counter_5F_map result ;
  result.makeNewEmptyMap (THERE) ;
  return result ;
}

//---------------------------------------------------------------------------*

GALGAS_counter_5F_map GALGAS_counter_5F_map::constructor_mapWithMapToOverride (const GALGAS_counter_5F_map & inMapToOverride
                                                                               COMMA_LOCATION_ARGS) {
  GALGAS_counter_5F_map result ;
  result.makeNewEmptyMapWithMapToOverride (inMapToOverride COMMA_THERE) ;
  return result ;
}

//---------------------------------------------------------------------------*

GALGAS_counter_5F_map GALGAS_counter_5F_map::reader_overriddenMap (UNUSED_LOCATION_ARGS) const {
  GALGAS_counter_5F_map result ;
  getOverridenMap (result) ;
  return result ;
}
//---------------------------------------------------------------------------*

void GALGAS_counter_5F_map::modifier_put (GALGAS_lstring inKey,
                                          GALGAS_counter_5F_obj inArgument0,
                                          C_Compiler * inCompiler
                                          COMMA_LOCATION_ARGS) {
  cMapElement_counter_5F_map * p = NULL ;
  macroMyNew (p, cMapElement_counter_5F_map (inKey, inArgument0 COMMA_HERE)) ;
  capCollectionElement attributes ;
  attributes.setPointer (p) ;
  macroDetachSharedObject (p) ;
  const char * kInsertErrorMessage = "Counter %K is duplicated in %L" ;
  const char * kShadowErrorMessage = "" ;
  performInsert (attributes, inCompiler, kInsertErrorMessage, kShadowErrorMessage COMMA_THERE) ;
}

//---------------------------------------------------------------------------*

const char * kSearchErrorMessage_counter_5F_map_getCounter = "Counter %K is not defined" ;

//---------------------------------------------------------------------------*

void GALGAS_counter_5F_map::method_getCounter (GALGAS_lstring inKey,
                                               GALGAS_counter_5F_obj & outArgument0,
                                               C_Compiler * inCompiler
                                               COMMA_LOCATION_ARGS) const {
  const cMapElement_counter_5F_map * p = (const cMapElement_counter_5F_map *) performSearch (inKey,
                                                                                               inCompiler,
                                                                                               kSearchErrorMessage_counter_5F_map_getCounter
                                                                                               COMMA_THERE) ;
  if (NULL == p) {
    outArgument0.drop () ;
  }else{
    macroValidSharedObject (p, const cMapElement_counter_5F_map) ;
    outArgument0 = p->mAttribute_counter ;
  }
}

//---------------------------------------------------------------------------*

void GALGAS_counter_5F_map::modifier_del (GALGAS_lstring inKey,
                                          GALGAS_counter_5F_obj & outArgument0,
                                          C_Compiler * inCompiler
                                          COMMA_LOCATION_ARGS) {
  const char * kRemoveErrorMessage = "Counter %K is not defined" ;
  capCollectionElement attributes ;
  performRemove (inKey, attributes, inCompiler, kRemoveErrorMessage COMMA_THERE) ;
  cMapElement_counter_5F_map * p = (cMapElement_counter_5F_map *) attributes.ptr () ;
  if (NULL != p) {
    macroValidSharedObject (p, cMapElement_counter_5F_map) ;
    outArgument0 = p->mAttribute_counter ;
  }
}

//---------------------------------------------------------------------------*

GALGAS_counter_5F_obj GALGAS_counter_5F_map::reader_counterForKey (const GALGAS_string & inKey,
                                                                   C_Compiler * inCompiler
                                                                   COMMA_LOCATION_ARGS) const {
  const cCollectionElement * attributes = searchForReadingAttribute (inKey, inCompiler COMMA_THERE) ;
  const cMapElement_counter_5F_map * p = (const cMapElement_counter_5F_map *) attributes ;
  GALGAS_counter_5F_obj result ;
  if (NULL != p) {
    macroValidSharedObject (p, const cMapElement_counter_5F_map) ;
    result = p->mAttribute_counter ;
  }
  return result ;
}

//---------------------------------------------------------------------------*

void GALGAS_counter_5F_map::modifier_setCounterForKey (GALGAS_counter_5F_obj inAttributeValue,
                                                       GALGAS_string inKey,
                                                       C_Compiler * inCompiler
                                                       COMMA_LOCATION_ARGS) {
  cCollectionElement * attributes = searchForReadWriteAttribute (inKey, inCompiler COMMA_THERE) ;
  cMapElement_counter_5F_map * p = (cMapElement_counter_5F_map *) attributes ;
  if (NULL != p) {
    macroValidSharedObject (p, cMapElement_counter_5F_map) ;
    p->mAttribute_counter = inAttributeValue ;
  }
}

//---------------------------------------------------------------------------*

cMapElement_counter_5F_map * GALGAS_counter_5F_map::readWriteAccessForWithInstruction_getCounter (C_Compiler * inCompiler,
                                                                                                  const GALGAS_lstring & inKey
                                                                                                  COMMA_LOCATION_ARGS) {
  cMapElement * p = searchForReadWriteAttribute (inKey, inCompiler, kSearchErrorMessage_counter_5F_map_getCounter COMMA_THERE) ;
  cMapElement_counter_5F_map * result = (cMapElement_counter_5F_map *) p ;
  macroNullOrValidSharedObject (result, cMapElement_counter_5F_map) ;
  return result ;
}

//---------------------------------------------------------------------------*

cMapElement_counter_5F_map * GALGAS_counter_5F_map::readWriteAccessForWithInstruction_hasKey (C_Compiler * inCompiler,
                                                                                              const GALGAS_string & inKey
                                                                                              COMMA_LOCATION_ARGS) {
  cMapElement * p = searchForReadWriteAttribute (inKey, inCompiler COMMA_THERE) ;
  cMapElement_counter_5F_map * result = (cMapElement_counter_5F_map *) p ;
  macroNullOrValidSharedObject (result, cMapElement_counter_5F_map) ;
  return result ;
}

//---------------------------------------------------------------------------*

cEnumerator_counter_5F_map::cEnumerator_counter_5F_map (const GALGAS_counter_5F_map & inEnumeratedObject,
                                                        const bool inAscending) :
cGenericAbstractEnumerator () {
  inEnumeratedObject.populateEnumerationArray (mEnumerationArray, inAscending) ;
}

//---------------------------------------------------------------------------*

GALGAS_lstring cEnumerator_counter_5F_map::current_lkey (LOCATION_ARGS) const {
  const cMapElement * p = (const cMapElement *) currentObjectPtr (THERE) ;
  macroValidSharedObject (p, const cMapElement) ;
  return p->mAttribute_lkey ;
}

//---------------------------------------------------------------------------*

GALGAS_counter_5F_obj cEnumerator_counter_5F_map::current_counter (LOCATION_ARGS) const {
  const cMapElement_counter_5F_map * p = (const cMapElement_counter_5F_map *) currentObjectPtr (THERE) ;
  macroValidSharedObject (p, const cMapElement_counter_5F_map) ;
  return p->mAttribute_counter ;
}



//---------------------------------------------------------------------------*
//                                                                           *
//                             @counter_map type                             *
//                                                                           *
//---------------------------------------------------------------------------*

const C_galgas_type_descriptor
kTypeDescriptor_GALGAS_counter_5F_map ("counter_map",
                                       NULL) ;

//---------------------------------------------------------------------------*

const C_galgas_type_descriptor * GALGAS_counter_5F_map::staticTypeDescriptor (void) const {
  return & kTypeDescriptor_GALGAS_counter_5F_map ;
}

//---------------------------------------------------------------------------*

AC_GALGAS_root * GALGAS_counter_5F_map::clonedObject (void) const {
  AC_GALGAS_root * result = NULL ;
  if (isValid ()) {
    macroMyNew (result, GALGAS_counter_5F_map (*this)) ;
  }
  return result ;
}

//---------------------------------------------------------------------------*

GALGAS_counter_5F_map GALGAS_counter_5F_map::extractObject (const GALGAS_object & inObject,
                                                            C_Compiler * inCompiler,
                                                            const GALGAS_location & inErrorLocation
                                                            COMMA_LOCATION_ARGS) {
  GALGAS_counter_5F_map result ;
  const GALGAS_counter_5F_map * p = (const GALGAS_counter_5F_map *) inObject.embeddedObject () ;
  if (NULL != p) {
    if (NULL != dynamic_cast <const GALGAS_counter_5F_map *> (p)) {
      result = *p ;
    }else{
      inCompiler->extractObjectError (inErrorLocation, "counter_map", p->dynamicTypeDescriptor () COMMA_THERE) ;
    }  
  }
  return result ;
}

//---------------------------------------------------------------------------*
//                                                                           *
//        Class for element of '@counter_5F_by_5F_source' sorted list        *
//                                                                           *
//---------------------------------------------------------------------------*

class cSortedListElement_counter_5F_by_5F_source : public cSortedListElement {
//--- List attributes
  public : GALGAS_string mAttribute_source ;
  public : GALGAS_lstring mAttribute_name ;
  public : GALGAS_counter_5F_obj mAttribute_counter ;

//--- Constructor
  public : cSortedListElement_counter_5F_by_5F_source (const GALGAS_string & in_source,
                                                       const GALGAS_lstring & in_name,
                                                       const GALGAS_counter_5F_obj & in_counter
                                                       COMMA_LOCATION_ARGS) ;

//--- Virtual method that checks that all attributes are valid
  public : virtual bool isValid (void) const ;

//--- Virtual method that returns a copy of current object
  public : virtual cSortedListElement * copy (void) ;

//--- Virtual method for comparing elements
  public : virtual enumComparisonResult compare (const cCollectionElement * inOperand) const ;

//--- Description
 public : virtual void description (C_String & ioString, const PMSInt32 inIndentation) const ;

//--- Virtual method that comparing element for sorting
  public : virtual enumComparisonResult compareForSorting (const cSortedListElement * inOperand) const ;
} ;

//---------------------------------------------------------------------------*

cSortedListElement_counter_5F_by_5F_source::cSortedListElement_counter_5F_by_5F_source (const GALGAS_string & in_source,
                                                                                        const GALGAS_lstring & in_name,
                                                                                        const GALGAS_counter_5F_obj & in_counter
                                                                                        COMMA_LOCATION_ARGS) :
cSortedListElement (THERE),
mAttribute_source (in_source),
mAttribute_name (in_name),
mAttribute_counter (in_counter) {
}

//---------------------------------------------------------------------------*

bool cSortedListElement_counter_5F_by_5F_source::isValid (void) const {
  return mAttribute_source.isValid () && mAttribute_name.isValid () && mAttribute_counter.isValid () ;
}

//---------------------------------------------------------------------------*

cSortedListElement * cSortedListElement_counter_5F_by_5F_source::copy (void) {
  cSortedListElement * result = NULL ;
  macroMyNew (result, cSortedListElement_counter_5F_by_5F_source (mAttribute_source, mAttribute_name, mAttribute_counter COMMA_HERE)) ;
  return result ;
}

//---------------------------------------------------------------------------*

void cSortedListElement_counter_5F_by_5F_source::description (C_String & ioString, const PMSInt32 inIndentation) const {
  ioString << "\n" ;
  ioString.writeStringMultiple ("| ", inIndentation) ;
  ioString << "source" ":" ;
  mAttribute_source.description (ioString, inIndentation) ;
  ioString << "\n" ;
  ioString.writeStringMultiple ("| ", inIndentation) ;
  ioString << "name" ":" ;
  mAttribute_name.description (ioString, inIndentation) ;
  ioString << "\n" ;
  ioString.writeStringMultiple ("| ", inIndentation) ;
  ioString << "counter" ":" ;
  mAttribute_counter.description (ioString, inIndentation) ;
}

//---------------------------------------------------------------------------*

enumComparisonResult cSortedListElement_counter_5F_by_5F_source::compare (const cCollectionElement * inOperand) const {
  enumComparisonResult result = kOperandNotValid ;
  if (NULL != inOperand) {
    result = kOperandEqual ;
    cSortedListElement_counter_5F_by_5F_source * operand = (cSortedListElement_counter_5F_by_5F_source *) inOperand ;
    macroValidSharedObject (operand, cSortedListElement_counter_5F_by_5F_source) ;
    if (kOperandEqual == result) {
      result = mAttribute_source.objectCompare (operand->mAttribute_source) ;
    }
    if (kOperandEqual == result) {
      result = mAttribute_name.objectCompare (operand->mAttribute_name) ;
    }
    if (kOperandEqual == result) {
      result = mAttribute_counter.objectCompare (operand->mAttribute_counter) ;
    }
  }
  return result ;
}

//---------------------------------------------------------------------------*

GALGAS_counter_5F_by_5F_source::GALGAS_counter_5F_by_5F_source (void) :
AC_GALGAS_sortedlist () {
}

//---------------------------------------------------------------------------*

enumComparisonResult cSortedListElement_counter_5F_by_5F_source::compareForSorting (const cSortedListElement * inOperand) const {
  enumComparisonResult result = kOperandEqual ;
  const cSortedListElement_counter_5F_by_5F_source * operand = (const cSortedListElement_counter_5F_by_5F_source *) inOperand ;
  macroValidSharedObject (operand, const cSortedListElement_counter_5F_by_5F_source) ;
  if (result == kOperandEqual) {
    result = operand->mAttribute_source.objectCompare (mAttribute_source) ;
  }
  return result ;
}

//---------------------------------------------------------------------------*

GALGAS_counter_5F_by_5F_source GALGAS_counter_5F_by_5F_source::constructor_emptySortedList (LOCATION_ARGS) {
  GALGAS_counter_5F_by_5F_source result ;
  result.createNewEmptySortedList (THERE) ;
  return result ;
}

//---------------------------------------------------------------------------*

GALGAS_counter_5F_by_5F_source GALGAS_counter_5F_by_5F_source::constructor_sortedListWithValue (const GALGAS_string & inOperand0,
                                                                                                const GALGAS_lstring & inOperand1,
                                                                                                const GALGAS_counter_5F_obj & inOperand2
                                                                                                COMMA_LOCATION_ARGS) {
  GALGAS_counter_5F_by_5F_source result = constructor_emptySortedList (THERE) ;
  cSortedListElement * p = NULL ;
  macroMyNew (p, cSortedListElement_counter_5F_by_5F_source (inOperand0, inOperand1, inOperand2 COMMA_THERE)) ;
  capSortedListElement attributes ;
  attributes.setPointer (p) ;
  macroDetachSharedObject (p) ;
  result.addObject (attributes) ;
  return result ;
}

//---------------------------------------------------------------------------*

void GALGAS_counter_5F_by_5F_source::addAssign_operation (const GALGAS_string & inOperand0,
                                                          const GALGAS_lstring & inOperand1,
                                                          const GALGAS_counter_5F_obj & inOperand2
                                                          COMMA_LOCATION_ARGS) {
  if (isValid ()) {
    cSortedListElement * p = NULL ;
    macroMyNew (p, cSortedListElement_counter_5F_by_5F_source (inOperand0, inOperand1, inOperand2 COMMA_THERE)) ;
    capSortedListElement attributes ;
    attributes.setPointer (p) ;
    macroDetachSharedObject (p) ;
    addObject (attributes) ;
  }
}

//---------------------------------------------------------------------------*

void GALGAS_counter_5F_by_5F_source::dotAssign_operation (const GALGAS_counter_5F_by_5F_source inOperand
                                                          COMMA_UNUSED_LOCATION_ARGS) {
  if (isValid ()) {
    appendSortedList (inOperand) ;
  }
}

//---------------------------------------------------------------------------*

GALGAS_counter_5F_by_5F_source GALGAS_counter_5F_by_5F_source::operator_concat (const GALGAS_counter_5F_by_5F_source & inOperand
                                                                                COMMA_LOCATION_ARGS) const {
  GALGAS_counter_5F_by_5F_source result ;
  if (isValid () && inOperand.isValid ()) {
    result = constructor_emptySortedList (THERE) ;
    result = *this ;
    result.appendSortedList (inOperand) ;
  }
  return result ;
}

//---------------------------------------------------------------------------*

void GALGAS_counter_5F_by_5F_source::modifier_popSmallest (GALGAS_string & outOperand0,
                                                           GALGAS_lstring & outOperand1,
                                                           GALGAS_counter_5F_obj & outOperand2,
                                                           C_Compiler * inCompiler
                                                           COMMA_LOCATION_ARGS) {
  capSortedListElement attributes ;
  removeSmallestObject (attributes, inCompiler COMMA_THERE) ;
  cSortedListElement_counter_5F_by_5F_source * p = (cSortedListElement_counter_5F_by_5F_source *) attributes.ptr () ;
  if (NULL == p) {
    outOperand0.drop () ;
    outOperand1.drop () ;
    outOperand2.drop () ;
  }else{
    macroValidSharedObject (p, cSortedListElement_counter_5F_by_5F_source) ;
    outOperand0 = p->mAttribute_source ;
    outOperand1 = p->mAttribute_name ;
    outOperand2 = p->mAttribute_counter ;
  }
}

//---------------------------------------------------------------------------*

void GALGAS_counter_5F_by_5F_source::modifier_popGreatest (GALGAS_string & outOperand0,
                                                           GALGAS_lstring & outOperand1,
                                                           GALGAS_counter_5F_obj & outOperand2,
                                                           C_Compiler * inCompiler
                                                           COMMA_LOCATION_ARGS) {
  capSortedListElement attributes ;
  removeGreatestObject (attributes, inCompiler COMMA_THERE) ;
  cSortedListElement_counter_5F_by_5F_source * p = (cSortedListElement_counter_5F_by_5F_source *) attributes.ptr () ;
  if (NULL == p) {
    outOperand0.drop () ;
    outOperand1.drop () ;
    outOperand2.drop () ;
  }else{
    macroValidSharedObject (p, cSortedListElement_counter_5F_by_5F_source) ;
    outOperand0 = p->mAttribute_source ;
    outOperand1 = p->mAttribute_name ;
    outOperand2 = p->mAttribute_counter ;
  }
}

//---------------------------------------------------------------------------*

void GALGAS_counter_5F_by_5F_source::method_smallest (GALGAS_string & outOperand0,
                                                      GALGAS_lstring & outOperand1,
                                                      GALGAS_counter_5F_obj & outOperand2,
                                                      C_Compiler * inCompiler
                                                      COMMA_LOCATION_ARGS) const {
  capSortedListElement attributes ;
  smallestObjectAttributeList (attributes, inCompiler COMMA_THERE) ;
  cSortedListElement_counter_5F_by_5F_source * p = (cSortedListElement_counter_5F_by_5F_source *) attributes.ptr () ;
  if (NULL == p) {
    outOperand0.drop () ;
    outOperand1.drop () ;
    outOperand2.drop () ;
  }else{
    macroValidSharedObject (p, cSortedListElement_counter_5F_by_5F_source) ;
    outOperand0 = p->mAttribute_source ;
    outOperand1 = p->mAttribute_name ;
    outOperand2 = p->mAttribute_counter ;
  }
}

//---------------------------------------------------------------------------*

void GALGAS_counter_5F_by_5F_source::method_greatest (GALGAS_string & outOperand0,
                                                      GALGAS_lstring & outOperand1,
                                                      GALGAS_counter_5F_obj & outOperand2,
                                                      C_Compiler * inCompiler
                                                      COMMA_LOCATION_ARGS) const {
  capSortedListElement attributes ;
  greatestObjectAttributeList (attributes, inCompiler COMMA_THERE) ;
  cSortedListElement_counter_5F_by_5F_source * p = (cSortedListElement_counter_5F_by_5F_source *) attributes.ptr () ;
  if (NULL == p) {
    outOperand0.drop () ;
    outOperand1.drop () ;
    outOperand2.drop () ;
  }else{
    macroValidSharedObject (p, cSortedListElement_counter_5F_by_5F_source) ;
    outOperand0 = p->mAttribute_source ;
    outOperand1 = p->mAttribute_name ;
    outOperand2 = p->mAttribute_counter ;
  }
}

//---------------------------------------------------------------------------*

cEnumerator_counter_5F_by_5F_source::cEnumerator_counter_5F_by_5F_source (const GALGAS_counter_5F_by_5F_source & inEnumeratedObject,
                                                                          const bool inAscending) :
cGenericAbstractEnumerator () {
  inEnumeratedObject.populateEnumerationArray (mEnumerationArray, inAscending) ;
}

//---------------------------------------------------------------------------*

GALGAS_string cEnumerator_counter_5F_by_5F_source::current_source (LOCATION_ARGS) const {
  const cSortedListElement_counter_5F_by_5F_source * p = (const cSortedListElement_counter_5F_by_5F_source *) currentObjectPtr (THERE) ;
  macroValidSharedObject (p, const cSortedListElement_counter_5F_by_5F_source) ;
  return p->mAttribute_source ;
}

//---------------------------------------------------------------------------*

GALGAS_lstring cEnumerator_counter_5F_by_5F_source::current_name (LOCATION_ARGS) const {
  const cSortedListElement_counter_5F_by_5F_source * p = (const cSortedListElement_counter_5F_by_5F_source *) currentObjectPtr (THERE) ;
  macroValidSharedObject (p, const cSortedListElement_counter_5F_by_5F_source) ;
  return p->mAttribute_name ;
}

//---------------------------------------------------------------------------*

GALGAS_counter_5F_obj cEnumerator_counter_5F_by_5F_source::current_counter (LOCATION_ARGS) const {
  const cSortedListElement_counter_5F_by_5F_source * p = (const cSortedListElement_counter_5F_by_5F_source *) currentObjectPtr (THERE) ;
  macroValidSharedObject (p, const cSortedListElement_counter_5F_by_5F_source) ;
  return p->mAttribute_counter ;
}



//---------------------------------------------------------------------------*
//                                                                           *
//                          @counter_by_source type                          *
//                                                                           *
//---------------------------------------------------------------------------*

const C_galgas_type_descriptor
kTypeDescriptor_GALGAS_counter_5F_by_5F_source ("counter_by_source",
                                                NULL) ;

//---------------------------------------------------------------------------*

const C_galgas_type_descriptor * GALGAS_counter_5F_by_5F_source::staticTypeDescriptor (void) const {
  return & kTypeDescriptor_GALGAS_counter_5F_by_5F_source ;
}

//---------------------------------------------------------------------------*

AC_GALGAS_root * GALGAS_counter_5F_by_5F_source::clonedObject (void) const {
  AC_GALGAS_root * result = NULL ;
  if (isValid ()) {
    macroMyNew (result, GALGAS_counter_5F_by_5F_source (*this)) ;
  }
  return result ;
}

//---------------------------------------------------------------------------*

GALGAS_counter_5F_by_5F_source GALGAS_counter_5F_by_5F_source::extractObject (const GALGAS_object & inObject,
                                                                              C_Compiler * inCompiler,
                                                                              const GALGAS_location & inErrorLocation
                                                                              COMMA_LOCATION_ARGS) {
  GALGAS_counter_5F_by_5F_source result ;
  const GALGAS_counter_5F_by_5F_source * p = (const GALGAS_counter_5F_by_5F_source *) inObject.embeddedObject () ;
  if (NULL != p) {
    if (NULL != dynamic_cast <const GALGAS_counter_5F_by_5F_source *> (p)) {
      result = *p ;
    }else{
      inCompiler->extractObjectError (inErrorLocation, "counter_by_source", p->dynamicTypeDescriptor () COMMA_THERE) ;
    }  
  }
  return result ;
}

//---------------------------------------------------------------------------*
//                                                                           *
//                        Function 'maxAllowedValue'                         *
//                                                                           *
//---------------------------------------------------------------------------*

GALGAS_uint_36__34_ function_maxAllowedValue (const GALGAS_counter_5F_obj & constinArgument_counter,
                                              C_Compiler * inCompiler
                                              COMMA_UNUSED_LOCATION_ARGS) {
  GALGAS_uint_36__34_ result_uint_36__34_ ; // Returned variable
  //-------- @assignmentInstructionForGeneration
  result_uint_36__34_ = GALGAS_uint_36__34_ ((PMUInt64) 0ULL) ;
  //-------- @structuredCastInstructionForGeneration
  if (constinArgument_counter.reader_max_5F_allowed_5F_value (SOURCE_FILE_AT_LINE (68)).isValid ()) {
    if (constinArgument_counter.reader_max_5F_allowed_5F_value (SOURCE_FILE_AT_LINE (68)).dynamicTypeDescriptor () == & kTypeDescriptor_GALGAS_uint_33__32__5F_class) {
      GALGAS_uint_33__32__5F_class cast_1537_max ((cPtr_uint_33__32__5F_class *) constinArgument_counter.reader_max_5F_allowed_5F_value (SOURCE_FILE_AT_LINE (68)).ptr ()) ;
      //-------- @assignmentInstructionForGeneration
      result_uint_36__34_ = cast_1537_max.reader_value (SOURCE_FILE_AT_LINE (69)).reader_uint_36__34_ (SOURCE_FILE_AT_LINE (69)) ;
    }else{
      //-------- @errorInstructionForGeneration
      inCompiler->emitSemanticError (constinArgument_counter.reader_max_5F_allowed_5F_value (SOURCE_FILE_AT_LINE (70)).reader_location (SOURCE_FILE_AT_LINE (70)), GALGAS_string ("internal, wrong type for MAXALLOWEDVALUE") COMMA_SOURCE_FILE_AT_LINE (70)) ;
    }
  }
//---
  return result_uint_36__34_ ;
}


//---------------------------------------------------------------------------*
//  Function introspection                                                   *
//---------------------------------------------------------------------------*

static const C_galgas_type_descriptor * functionArgs_maxAllowedValue [2] = {
  & kTypeDescriptor_GALGAS_counter_5F_obj,
  NULL
} ;

//---------------------------------------------------------------------------*

static GALGAS_object functionWithGenericHeader_maxAllowedValue (C_Compiler * inCompiler,
                                                                const cObjectArray & inEffectiveParameterArray,
                                                                const GALGAS_location & inErrorLocation
                                                                COMMA_LOCATION_ARGS) {
  const GALGAS_counter_5F_obj operand0 = GALGAS_counter_5F_obj::extractObject (inEffectiveParameterArray.objectAtIndex (0 COMMA_HERE), inCompiler, inErrorLocation COMMA_THERE) ;
  return function_maxAllowedValue (operand0, inCompiler COMMA_THERE).reader_object (THERE) ;
}

//---------------------------------------------------------------------------*

C_galgas_function_descriptor functionDescriptor_maxAllowedValue ("maxAllowedValue",
                                                                 functionWithGenericHeader_maxAllowedValue,
                                                                 & kTypeDescriptor_GALGAS_uint_36__34_,
                                                                 1,
                                                                 functionArgs_maxAllowedValue) ;

//---------------------------------------------------------------------------*
//                                                                           *
//                            Function 'minCycle'                            *
//                                                                           *
//---------------------------------------------------------------------------*

GALGAS_uint_36__34_ function_minCycle (const GALGAS_counter_5F_obj & constinArgument_counter,
                                       C_Compiler * inCompiler
                                       COMMA_UNUSED_LOCATION_ARGS) {
  GALGAS_uint_36__34_ result_uint_36__34_ ; // Returned variable
  //-------- @assignmentInstructionForGeneration
  result_uint_36__34_ = GALGAS_uint_36__34_ ((PMUInt64) 0ULL) ;
  //-------- @structuredCastInstructionForGeneration
  if (constinArgument_counter.reader_min_5F_cycle (SOURCE_FILE_AT_LINE (76)).isValid ()) {
    if (constinArgument_counter.reader_min_5F_cycle (SOURCE_FILE_AT_LINE (76)).dynamicTypeDescriptor () == & kTypeDescriptor_GALGAS_uint_33__32__5F_class) {
      GALGAS_uint_33__32__5F_class cast_1827_min ((cPtr_uint_33__32__5F_class *) constinArgument_counter.reader_min_5F_cycle (SOURCE_FILE_AT_LINE (76)).ptr ()) ;
      //-------- @assignmentInstructionForGeneration
      result_uint_36__34_ = cast_1827_min.reader_value (SOURCE_FILE_AT_LINE (77)).reader_uint_36__34_ (SOURCE_FILE_AT_LINE (77)) ;
    }else{
      //-------- @errorInstructionForGeneration
      inCompiler->emitSemanticError (constinArgument_counter.reader_min_5F_cycle (SOURCE_FILE_AT_LINE (78)).reader_location (SOURCE_FILE_AT_LINE (78)), GALGAS_string ("internal, wrong type for MINCYCLE") COMMA_SOURCE_FILE_AT_LINE (78)) ;
    }
  }
//---
  return result_uint_36__34_ ;
}


//---------------------------------------------------------------------------*
//  Function introspection                                                   *
//---------------------------------------------------------------------------*

static const C_galgas_type_descriptor * functionArgs_minCycle [2] = {
  & kTypeDescriptor_GALGAS_counter_5F_obj,
  NULL
} ;

//---------------------------------------------------------------------------*

static GALGAS_object functionWithGenericHeader_minCycle (C_Compiler * inCompiler,
                                                         const cObjectArray & inEffectiveParameterArray,
                                                         const GALGAS_location & inErrorLocation
                                                         COMMA_LOCATION_ARGS) {
  const GALGAS_counter_5F_obj operand0 = GALGAS_counter_5F_obj::extractObject (inEffectiveParameterArray.objectAtIndex (0 COMMA_HERE), inCompiler, inErrorLocation COMMA_THERE) ;
  return function_minCycle (operand0, inCompiler COMMA_THERE).reader_object (THERE) ;
}

//---------------------------------------------------------------------------*

C_galgas_function_descriptor functionDescriptor_minCycle ("minCycle",
                                                          functionWithGenericHeader_minCycle,
                                                          & kTypeDescriptor_GALGAS_uint_36__34_,
                                                          1,
                                                          functionArgs_minCycle) ;

//---------------------------------------------------------------------------*
//                                                                           *
//                          Function 'ticksPerBase'                          *
//                                                                           *
//---------------------------------------------------------------------------*

GALGAS_uint_36__34_ function_ticksPerBase (const GALGAS_counter_5F_obj & constinArgument_counter,
                                           C_Compiler * inCompiler
                                           COMMA_UNUSED_LOCATION_ARGS) {
  GALGAS_uint_36__34_ result_uint_36__34_ ; // Returned variable
  //-------- @assignmentInstructionForGeneration
  result_uint_36__34_ = GALGAS_uint_36__34_ ((PMUInt64) 0ULL) ;
  //-------- @structuredCastInstructionForGeneration
  if (constinArgument_counter.reader_ticks_5F_per_5F_base (SOURCE_FILE_AT_LINE (84)).isValid ()) {
    if (constinArgument_counter.reader_ticks_5F_per_5F_base (SOURCE_FILE_AT_LINE (84)).dynamicTypeDescriptor () == & kTypeDescriptor_GALGAS_uint_33__32__5F_class) {
      GALGAS_uint_33__32__5F_class cast_2113_ticks ((cPtr_uint_33__32__5F_class *) constinArgument_counter.reader_ticks_5F_per_5F_base (SOURCE_FILE_AT_LINE (84)).ptr ()) ;
      //-------- @assignmentInstructionForGeneration
      result_uint_36__34_ = cast_2113_ticks.reader_value (SOURCE_FILE_AT_LINE (85)).reader_uint_36__34_ (SOURCE_FILE_AT_LINE (85)) ;
    }else{
      //-------- @errorInstructionForGeneration
      inCompiler->emitSemanticError (constinArgument_counter.reader_ticks_5F_per_5F_base (SOURCE_FILE_AT_LINE (86)).reader_location (SOURCE_FILE_AT_LINE (86)), GALGAS_string ("internal, wrong type for TICKSPERBASE") COMMA_SOURCE_FILE_AT_LINE (86)) ;
    }
  }
//---
  return result_uint_36__34_ ;
}


//---------------------------------------------------------------------------*
//  Function introspection                                                   *
//---------------------------------------------------------------------------*

static const C_galgas_type_descriptor * functionArgs_ticksPerBase [2] = {
  & kTypeDescriptor_GALGAS_counter_5F_obj,
  NULL
} ;

//---------------------------------------------------------------------------*

static GALGAS_object functionWithGenericHeader_ticksPerBase (C_Compiler * inCompiler,
                                                             const cObjectArray & inEffectiveParameterArray,
                                                             const GALGAS_location & inErrorLocation
                                                             COMMA_LOCATION_ARGS) {
  const GALGAS_counter_5F_obj operand0 = GALGAS_counter_5F_obj::extractObject (inEffectiveParameterArray.objectAtIndex (0 COMMA_HERE), inCompiler, inErrorLocation COMMA_THERE) ;
  return function_ticksPerBase (operand0, inCompiler COMMA_THERE).reader_object (THERE) ;
}

//---------------------------------------------------------------------------*

C_galgas_function_descriptor functionDescriptor_ticksPerBase ("ticksPerBase",
                                                              functionWithGenericHeader_ticksPerBase,
                                                              & kTypeDescriptor_GALGAS_uint_36__34_,
                                                              1,
                                                              functionArgs_ticksPerBase) ;

//---------------------------------------------------------------------------*

enumComparisonResult GALGAS_counter_5F_driver::objectCompare (const GALGAS_counter_5F_driver & inOperand) const {
  enumComparisonResult result = kOperandEqual ;
  const cPtr_counter_5F_driver * p = (const cPtr_counter_5F_driver *) mObjectPtr ;
  macroNullOrValidSharedObject (p, const cPtr_counter_5F_driver) ;
  const cPtr_counter_5F_driver * q = (const cPtr_counter_5F_driver *) inOperand.mObjectPtr ;
  macroNullOrValidSharedObject (q, const cPtr_counter_5F_driver) ;
  if (kOperandEqual == result) {
    result = p->mAttribute_location.objectCompare (q->mAttribute_location) ;
  }
  return result ;
}


//---------------------------------------------------------------------------*

GALGAS_counter_5F_driver::GALGAS_counter_5F_driver (void) :
AC_GALGAS_class () {
}

//---------------------------------------------------------------------------*

GALGAS_counter_5F_driver::GALGAS_counter_5F_driver (const cPtr_counter_5F_driver * inSourcePtr) :
AC_GALGAS_class (inSourcePtr) {
  macroNullOrValidSharedObject (inSourcePtr, const cPtr_counter_5F_driver) ;
}

//---------------------------------------------------------------------------*

GALGAS_location GALGAS_counter_5F_driver::reader_location (UNUSED_LOCATION_ARGS) const {
  GALGAS_location result ;
  if (NULL != mObjectPtr) {
    const cPtr_counter_5F_driver * p = (const cPtr_counter_5F_driver *) mObjectPtr ;
    macroValidSharedObject (p, const cPtr_counter_5F_driver) ;
    result = p->mAttribute_location ;
  }
  return result ;
}

//---------------------------------------------------------------------------*
//                  Pointer class for @counter_driver class                  *
//---------------------------------------------------------------------------*

cPtr_counter_5F_driver::cPtr_counter_5F_driver (const GALGAS_location & in_location
                                                COMMA_LOCATION_ARGS) :
acPtr_class (THERE),
mAttribute_location (in_location) {
}



//---------------------------------------------------------------------------*
//                                                                           *
//                           @counter_driver type                            *
//                                                                           *
//---------------------------------------------------------------------------*

const C_galgas_type_descriptor
kTypeDescriptor_GALGAS_counter_5F_driver ("counter_driver",
                                          NULL) ;

//---------------------------------------------------------------------------*

const C_galgas_type_descriptor * GALGAS_counter_5F_driver::staticTypeDescriptor (void) const {
  return & kTypeDescriptor_GALGAS_counter_5F_driver ;
}

//---------------------------------------------------------------------------*

AC_GALGAS_root * GALGAS_counter_5F_driver::clonedObject (void) const {
  AC_GALGAS_root * result = NULL ;
  if (isValid ()) {
    macroMyNew (result, GALGAS_counter_5F_driver (*this)) ;
  }
  return result ;
}

//---------------------------------------------------------------------------*

GALGAS_counter_5F_driver GALGAS_counter_5F_driver::extractObject (const GALGAS_object & inObject,
                                                                  C_Compiler * inCompiler,
                                                                  const GALGAS_location & inErrorLocation
                                                                  COMMA_LOCATION_ARGS) {
  GALGAS_counter_5F_driver result ;
  const GALGAS_counter_5F_driver * p = (const GALGAS_counter_5F_driver *) inObject.embeddedObject () ;
  if (NULL != p) {
    if (NULL != dynamic_cast <const GALGAS_counter_5F_driver *> (p)) {
      result = *p ;
    }else{
      inCompiler->extractObjectError (inErrorLocation, "counter_driver", p->dynamicTypeDescriptor () COMMA_THERE) ;
    }  
  }
  return result ;
}

//---------------------------------------------------------------------------*

enumComparisonResult GALGAS_gpt_5F_driver::objectCompare (const GALGAS_gpt_5F_driver & inOperand) const {
  enumComparisonResult result = GALGAS_counter_5F_driver::objectCompare (inOperand) ;
  const cPtr_gpt_5F_driver * p = (const cPtr_gpt_5F_driver *) mObjectPtr ;
  macroNullOrValidSharedObject (p, const cPtr_gpt_5F_driver) ;
  const cPtr_gpt_5F_driver * q = (const cPtr_gpt_5F_driver *) inOperand.mObjectPtr ;
  macroNullOrValidSharedObject (q, const cPtr_gpt_5F_driver) ;
  if (kOperandEqual == result) {
    result = p->mAttribute_ns_5F_per_5F_hw_5F_tick.objectCompare (q->mAttribute_ns_5F_per_5F_hw_5F_tick) ;
  }
  if (kOperandEqual == result) {
    result = p->mAttribute_gpt_5F_channel_5F_name.objectCompare (q->mAttribute_gpt_5F_channel_5F_name) ;
  }
  return result ;
}


//---------------------------------------------------------------------------*

GALGAS_gpt_5F_driver::GALGAS_gpt_5F_driver (void) :
GALGAS_counter_5F_driver () {
}

//---------------------------------------------------------------------------*

GALGAS_gpt_5F_driver::GALGAS_gpt_5F_driver (const cPtr_gpt_5F_driver * inSourcePtr) :
GALGAS_counter_5F_driver (inSourcePtr) {
  macroNullOrValidSharedObject (inSourcePtr, const cPtr_gpt_5F_driver) ;
}

//---------------------------------------------------------------------------*

GALGAS_gpt_5F_driver GALGAS_gpt_5F_driver::constructor_new (const GALGAS_location & inAttribute_location,
                                                            const GALGAS_basic_5F_type & inAttribute_ns_5F_per_5F_hw_5F_tick,
                                                            const GALGAS_lstring & inAttribute_gpt_5F_channel_5F_name
                                                            COMMA_LOCATION_ARGS) {
  GALGAS_gpt_5F_driver result ;
  if (inAttribute_location.isValid () && inAttribute_ns_5F_per_5F_hw_5F_tick.isValid () && inAttribute_gpt_5F_channel_5F_name.isValid ()) {
    macroMyNew (result.mObjectPtr, cPtr_gpt_5F_driver (inAttribute_location, inAttribute_ns_5F_per_5F_hw_5F_tick, inAttribute_gpt_5F_channel_5F_name COMMA_THERE)) ;
  }
  return result ;
}

//---------------------------------------------------------------------------*

void GALGAS_gpt_5F_driver::insulate (LOCATION_ARGS) {
  if (isValid () && (mObjectPtr->retainCount () > 1)) {
    cPtr_gpt_5F_driver * p = (cPtr_gpt_5F_driver *) mObjectPtr ;
    macroValidSharedObject (p, cPtr_gpt_5F_driver) ;
    cPtr_gpt_5F_driver * r = NULL ;
    macroMyNew (r, cPtr_gpt_5F_driver (p->mAttribute_location, p->mAttribute_ns_5F_per_5F_hw_5F_tick, p->mAttribute_gpt_5F_channel_5F_name COMMA_THERE)) ;
    macroAssignSharedObject (mObjectPtr, r) ;
    macroDetachSharedObject (r) ;
  }
}

//---------------------------------------------------------------------------*

GALGAS_basic_5F_type GALGAS_gpt_5F_driver::reader_ns_5F_per_5F_hw_5F_tick (UNUSED_LOCATION_ARGS) const {
  GALGAS_basic_5F_type result ;
  if (NULL != mObjectPtr) {
    const cPtr_gpt_5F_driver * p = (const cPtr_gpt_5F_driver *) mObjectPtr ;
    macroValidSharedObject (p, const cPtr_gpt_5F_driver) ;
    result = p->mAttribute_ns_5F_per_5F_hw_5F_tick ;
  }
  return result ;
}

//---------------------------------------------------------------------------*

GALGAS_lstring GALGAS_gpt_5F_driver::reader_gpt_5F_channel_5F_name (UNUSED_LOCATION_ARGS) const {
  GALGAS_lstring result ;
  if (NULL != mObjectPtr) {
    const cPtr_gpt_5F_driver * p = (const cPtr_gpt_5F_driver *) mObjectPtr ;
    macroValidSharedObject (p, const cPtr_gpt_5F_driver) ;
    result = p->mAttribute_gpt_5F_channel_5F_name ;
  }
  return result ;
}

//---------------------------------------------------------------------------*
//                    Pointer class for @gpt_driver class                    *
//---------------------------------------------------------------------------*

cPtr_gpt_5F_driver::cPtr_gpt_5F_driver (const GALGAS_location & in_location,
                                        const GALGAS_basic_5F_type & in_ns_5F_per_5F_hw_5F_tick,
                                        const GALGAS_lstring & in_gpt_5F_channel_5F_name
                                        COMMA_LOCATION_ARGS) :
cPtr_counter_5F_driver (in_location COMMA_THERE),
mAttribute_ns_5F_per_5F_hw_5F_tick (in_ns_5F_per_5F_hw_5F_tick),
mAttribute_gpt_5F_channel_5F_name (in_gpt_5F_channel_5F_name) {
}

//---------------------------------------------------------------------------*

const C_galgas_type_descriptor * cPtr_gpt_5F_driver::classDescriptor (void) const {
  return & kTypeDescriptor_GALGAS_gpt_5F_driver ;
}

void cPtr_gpt_5F_driver::description (C_String & ioString,
                                      const PMSInt32 inIndentation) const {
  ioString << "[@gpt_driver:" ;
  mAttribute_location.description (ioString, inIndentation+1) ;
  ioString << ", " ;
  mAttribute_ns_5F_per_5F_hw_5F_tick.description (ioString, inIndentation+1) ;
  ioString << ", " ;
  mAttribute_gpt_5F_channel_5F_name.description (ioString, inIndentation+1) ;
  ioString << "]" ;
}



//---------------------------------------------------------------------------*
//                                                                           *
//                             @gpt_driver type                              *
//                                                                           *
//---------------------------------------------------------------------------*

const C_galgas_type_descriptor
kTypeDescriptor_GALGAS_gpt_5F_driver ("gpt_driver",
                                      & kTypeDescriptor_GALGAS_counter_5F_driver) ;

//---------------------------------------------------------------------------*

const C_galgas_type_descriptor * GALGAS_gpt_5F_driver::staticTypeDescriptor (void) const {
  return & kTypeDescriptor_GALGAS_gpt_5F_driver ;
}

//---------------------------------------------------------------------------*

AC_GALGAS_root * GALGAS_gpt_5F_driver::clonedObject (void) const {
  AC_GALGAS_root * result = NULL ;
  if (isValid ()) {
    macroMyNew (result, GALGAS_gpt_5F_driver (*this)) ;
  }
  return result ;
}

//---------------------------------------------------------------------------*

GALGAS_gpt_5F_driver GALGAS_gpt_5F_driver::extractObject (const GALGAS_object & inObject,
                                                          C_Compiler * inCompiler,
                                                          const GALGAS_location & inErrorLocation
                                                          COMMA_LOCATION_ARGS) {
  GALGAS_gpt_5F_driver result ;
  const GALGAS_gpt_5F_driver * p = (const GALGAS_gpt_5F_driver *) inObject.embeddedObject () ;
  if (NULL != p) {
    if (NULL != dynamic_cast <const GALGAS_gpt_5F_driver *> (p)) {
      result = *p ;
    }else{
      inCompiler->extractObjectError (inErrorLocation, "gpt_driver", p->dynamicTypeDescriptor () COMMA_THERE) ;
    }  
  }
  return result ;
}

//---------------------------------------------------------------------------*

enumComparisonResult GALGAS_os_5F_internal_5F_driver::objectCompare (const GALGAS_os_5F_internal_5F_driver & inOperand) const {
  return (isValid () && inOperand.isValid ()) ? kOperandEqual : kOperandNotValid ;
}


//---------------------------------------------------------------------------*

GALGAS_os_5F_internal_5F_driver::GALGAS_os_5F_internal_5F_driver (void) :
GALGAS_counter_5F_driver () {
}

//---------------------------------------------------------------------------*

GALGAS_os_5F_internal_5F_driver::GALGAS_os_5F_internal_5F_driver (const cPtr_os_5F_internal_5F_driver * inSourcePtr) :
GALGAS_counter_5F_driver (inSourcePtr) {
  macroNullOrValidSharedObject (inSourcePtr, const cPtr_os_5F_internal_5F_driver) ;
}

//---------------------------------------------------------------------------*

GALGAS_os_5F_internal_5F_driver GALGAS_os_5F_internal_5F_driver::constructor_new (const GALGAS_location & inAttribute_location
                                                                                  COMMA_LOCATION_ARGS) {
  GALGAS_os_5F_internal_5F_driver result ;
  if (inAttribute_location.isValid ()) {
    macroMyNew (result.mObjectPtr, cPtr_os_5F_internal_5F_driver (inAttribute_location COMMA_THERE)) ;
  }
  return result ;
}

//---------------------------------------------------------------------------*

void GALGAS_os_5F_internal_5F_driver::insulate (LOCATION_ARGS) {
  if (isValid () && (mObjectPtr->retainCount () > 1)) {
    cPtr_os_5F_internal_5F_driver * p = (cPtr_os_5F_internal_5F_driver *) mObjectPtr ;
    macroValidSharedObject (p, cPtr_os_5F_internal_5F_driver) ;
    cPtr_os_5F_internal_5F_driver * r = NULL ;
    macroMyNew (r, cPtr_os_5F_internal_5F_driver (p->mAttribute_location COMMA_THERE)) ;
    macroAssignSharedObject (mObjectPtr, r) ;
    macroDetachSharedObject (r) ;
  }
}

//---------------------------------------------------------------------------*
//                Pointer class for @os_internal_driver class                *
//---------------------------------------------------------------------------*

cPtr_os_5F_internal_5F_driver::cPtr_os_5F_internal_5F_driver (const GALGAS_location & in_location
                                                              COMMA_LOCATION_ARGS) :
cPtr_counter_5F_driver (in_location COMMA_THERE) {
}

//---------------------------------------------------------------------------*

const C_galgas_type_descriptor * cPtr_os_5F_internal_5F_driver::classDescriptor (void) const {
  return & kTypeDescriptor_GALGAS_os_5F_internal_5F_driver ;
}

void cPtr_os_5F_internal_5F_driver::description (C_String & ioString,
                                                 const PMSInt32 inIndentation) const {
  ioString << "[@os_internal_driver:" ;
  mAttribute_location.description (ioString, inIndentation+1) ;
  ioString << "]" ;
}



//---------------------------------------------------------------------------*
//                                                                           *
//                         @os_internal_driver type                          *
//                                                                           *
//---------------------------------------------------------------------------*

const C_galgas_type_descriptor
kTypeDescriptor_GALGAS_os_5F_internal_5F_driver ("os_internal_driver",
                                                 & kTypeDescriptor_GALGAS_counter_5F_driver) ;

//---------------------------------------------------------------------------*

const C_galgas_type_descriptor * GALGAS_os_5F_internal_5F_driver::staticTypeDescriptor (void) const {
  return & kTypeDescriptor_GALGAS_os_5F_internal_5F_driver ;
}

//---------------------------------------------------------------------------*

AC_GALGAS_root * GALGAS_os_5F_internal_5F_driver::clonedObject (void) const {
  AC_GALGAS_root * result = NULL ;
  if (isValid ()) {
    macroMyNew (result, GALGAS_os_5F_internal_5F_driver (*this)) ;
  }
  return result ;
}

//---------------------------------------------------------------------------*

GALGAS_os_5F_internal_5F_driver GALGAS_os_5F_internal_5F_driver::extractObject (const GALGAS_object & inObject,
                                                                                C_Compiler * inCompiler,
                                                                                const GALGAS_location & inErrorLocation
                                                                                COMMA_LOCATION_ARGS) {
  GALGAS_os_5F_internal_5F_driver result ;
  const GALGAS_os_5F_internal_5F_driver * p = (const GALGAS_os_5F_internal_5F_driver *) inObject.embeddedObject () ;
  if (NULL != p) {
    if (NULL != dynamic_cast <const GALGAS_os_5F_internal_5F_driver *> (p)) {
      result = *p ;
    }else{
      inCompiler->extractObjectError (inErrorLocation, "os_internal_driver", p->dynamicTypeDescriptor () COMMA_THERE) ;
    }  
  }
  return result ;
}

//---------------------------------------------------------------------------*

enumComparisonResult GALGAS_void_5F_driver::objectCompare (const GALGAS_void_5F_driver & inOperand) const {
  return (isValid () && inOperand.isValid ()) ? kOperandEqual : kOperandNotValid ;
}


//---------------------------------------------------------------------------*

GALGAS_void_5F_driver::GALGAS_void_5F_driver (void) :
GALGAS_counter_5F_driver () {
}

//---------------------------------------------------------------------------*

GALGAS_void_5F_driver::GALGAS_void_5F_driver (const cPtr_void_5F_driver * inSourcePtr) :
GALGAS_counter_5F_driver (inSourcePtr) {
  macroNullOrValidSharedObject (inSourcePtr, const cPtr_void_5F_driver) ;
}

//---------------------------------------------------------------------------*

GALGAS_void_5F_driver GALGAS_void_5F_driver::constructor_new (const GALGAS_location & inAttribute_location
                                                              COMMA_LOCATION_ARGS) {
  GALGAS_void_5F_driver result ;
  if (inAttribute_location.isValid ()) {
    macroMyNew (result.mObjectPtr, cPtr_void_5F_driver (inAttribute_location COMMA_THERE)) ;
  }
  return result ;
}

//---------------------------------------------------------------------------*

void GALGAS_void_5F_driver::insulate (LOCATION_ARGS) {
  if (isValid () && (mObjectPtr->retainCount () > 1)) {
    cPtr_void_5F_driver * p = (cPtr_void_5F_driver *) mObjectPtr ;
    macroValidSharedObject (p, cPtr_void_5F_driver) ;
    cPtr_void_5F_driver * r = NULL ;
    macroMyNew (r, cPtr_void_5F_driver (p->mAttribute_location COMMA_THERE)) ;
    macroAssignSharedObject (mObjectPtr, r) ;
    macroDetachSharedObject (r) ;
  }
}

//---------------------------------------------------------------------------*
//                   Pointer class for @void_driver class                    *
//---------------------------------------------------------------------------*

cPtr_void_5F_driver::cPtr_void_5F_driver (const GALGAS_location & in_location
                                          COMMA_LOCATION_ARGS) :
cPtr_counter_5F_driver (in_location COMMA_THERE) {
}

//---------------------------------------------------------------------------*

const C_galgas_type_descriptor * cPtr_void_5F_driver::classDescriptor (void) const {
  return & kTypeDescriptor_GALGAS_void_5F_driver ;
}

void cPtr_void_5F_driver::description (C_String & ioString,
                                       const PMSInt32 inIndentation) const {
  ioString << "[@void_driver:" ;
  mAttribute_location.description (ioString, inIndentation+1) ;
  ioString << "]" ;
}



//---------------------------------------------------------------------------*
//                                                                           *
//                             @void_driver type                             *
//                                                                           *
//---------------------------------------------------------------------------*

const C_galgas_type_descriptor
kTypeDescriptor_GALGAS_void_5F_driver ("void_driver",
                                       & kTypeDescriptor_GALGAS_counter_5F_driver) ;

//---------------------------------------------------------------------------*

const C_galgas_type_descriptor * GALGAS_void_5F_driver::staticTypeDescriptor (void) const {
  return & kTypeDescriptor_GALGAS_void_5F_driver ;
}

//---------------------------------------------------------------------------*

AC_GALGAS_root * GALGAS_void_5F_driver::clonedObject (void) const {
  AC_GALGAS_root * result = NULL ;
  if (isValid ()) {
    macroMyNew (result, GALGAS_void_5F_driver (*this)) ;
  }
  return result ;
}

//---------------------------------------------------------------------------*

GALGAS_void_5F_driver GALGAS_void_5F_driver::extractObject (const GALGAS_object & inObject,
                                                            C_Compiler * inCompiler,
                                                            const GALGAS_location & inErrorLocation
                                                            COMMA_LOCATION_ARGS) {
  GALGAS_void_5F_driver result ;
  const GALGAS_void_5F_driver * p = (const GALGAS_void_5F_driver *) inObject.embeddedObject () ;
  if (NULL != p) {
    if (NULL != dynamic_cast <const GALGAS_void_5F_driver *> (p)) {
      result = *p ;
    }else{
      inCompiler->extractObjectError (inErrorLocation, "void_driver", p->dynamicTypeDescriptor () COMMA_THERE) ;
    }  
  }
  return result ;
}

//---------------------------------------------------------------------------*

enumComparisonResult GALGAS_counter_5F_type::objectCompare (const GALGAS_counter_5F_type & inOperand) const {
  enumComparisonResult result = kOperandEqual ;
  const cPtr_counter_5F_type * p = (const cPtr_counter_5F_type *) mObjectPtr ;
  macroNullOrValidSharedObject (p, const cPtr_counter_5F_type) ;
  const cPtr_counter_5F_type * q = (const cPtr_counter_5F_type *) inOperand.mObjectPtr ;
  macroNullOrValidSharedObject (q, const cPtr_counter_5F_type) ;
  if (kOperandEqual == result) {
    result = p->mAttribute_location.objectCompare (q->mAttribute_location) ;
  }
  return result ;
}


//---------------------------------------------------------------------------*

GALGAS_counter_5F_type::GALGAS_counter_5F_type (void) :
AC_GALGAS_class () {
}

//---------------------------------------------------------------------------*

GALGAS_counter_5F_type::GALGAS_counter_5F_type (const cPtr_counter_5F_type * inSourcePtr) :
AC_GALGAS_class (inSourcePtr) {
  macroNullOrValidSharedObject (inSourcePtr, const cPtr_counter_5F_type) ;
}

//---------------------------------------------------------------------------*

GALGAS_location GALGAS_counter_5F_type::reader_location (UNUSED_LOCATION_ARGS) const {
  GALGAS_location result ;
  if (NULL != mObjectPtr) {
    const cPtr_counter_5F_type * p = (const cPtr_counter_5F_type *) mObjectPtr ;
    macroValidSharedObject (p, const cPtr_counter_5F_type) ;
    result = p->mAttribute_location ;
  }
  return result ;
}

//---------------------------------------------------------------------------*
//                   Pointer class for @counter_type class                   *
//---------------------------------------------------------------------------*

cPtr_counter_5F_type::cPtr_counter_5F_type (const GALGAS_location & in_location
                                            COMMA_LOCATION_ARGS) :
acPtr_class (THERE),
mAttribute_location (in_location) {
}



//---------------------------------------------------------------------------*
//                                                                           *
//                            @counter_type type                             *
//                                                                           *
//---------------------------------------------------------------------------*

const C_galgas_type_descriptor
kTypeDescriptor_GALGAS_counter_5F_type ("counter_type",
                                        NULL) ;

//---------------------------------------------------------------------------*

const C_galgas_type_descriptor * GALGAS_counter_5F_type::staticTypeDescriptor (void) const {
  return & kTypeDescriptor_GALGAS_counter_5F_type ;
}

//---------------------------------------------------------------------------*

AC_GALGAS_root * GALGAS_counter_5F_type::clonedObject (void) const {
  AC_GALGAS_root * result = NULL ;
  if (isValid ()) {
    macroMyNew (result, GALGAS_counter_5F_type (*this)) ;
  }
  return result ;
}

//---------------------------------------------------------------------------*

GALGAS_counter_5F_type GALGAS_counter_5F_type::extractObject (const GALGAS_object & inObject,
                                                              C_Compiler * inCompiler,
                                                              const GALGAS_location & inErrorLocation
                                                              COMMA_LOCATION_ARGS) {
  GALGAS_counter_5F_type result ;
  const GALGAS_counter_5F_type * p = (const GALGAS_counter_5F_type *) inObject.embeddedObject () ;
  if (NULL != p) {
    if (NULL != dynamic_cast <const GALGAS_counter_5F_type *> (p)) {
      result = *p ;
    }else{
      inCompiler->extractObjectError (inErrorLocation, "counter_type", p->dynamicTypeDescriptor () COMMA_THERE) ;
    }  
  }
  return result ;
}

//---------------------------------------------------------------------------*

enumComparisonResult GALGAS_hardware_5F_counter::objectCompare (const GALGAS_hardware_5F_counter & inOperand) const {
  enumComparisonResult result = GALGAS_counter_5F_type::objectCompare (inOperand) ;
  const cPtr_hardware_5F_counter * p = (const cPtr_hardware_5F_counter *) mObjectPtr ;
  macroNullOrValidSharedObject (p, const cPtr_hardware_5F_counter) ;
  const cPtr_hardware_5F_counter * q = (const cPtr_hardware_5F_counter *) inOperand.mObjectPtr ;
  macroNullOrValidSharedObject (q, const cPtr_hardware_5F_counter) ;
  if (kOperandEqual == result) {
    result = p->mAttribute_driver.objectCompare (q->mAttribute_driver) ;
  }
  if (kOperandEqual == result) {
    result = p->mAttribute_time_5F_consts.objectCompare (q->mAttribute_time_5F_consts) ;
  }
  return result ;
}


//---------------------------------------------------------------------------*

GALGAS_hardware_5F_counter::GALGAS_hardware_5F_counter (void) :
GALGAS_counter_5F_type () {
}

//---------------------------------------------------------------------------*

GALGAS_hardware_5F_counter::GALGAS_hardware_5F_counter (const cPtr_hardware_5F_counter * inSourcePtr) :
GALGAS_counter_5F_type (inSourcePtr) {
  macroNullOrValidSharedObject (inSourcePtr, const cPtr_hardware_5F_counter) ;
}

//---------------------------------------------------------------------------*

GALGAS_hardware_5F_counter GALGAS_hardware_5F_counter::constructor_new (const GALGAS_location & inAttribute_location,
                                                                        const GALGAS_counter_5F_driver & inAttribute_driver,
                                                                        const GALGAS_time_5F_constants & inAttribute_time_5F_consts
                                                                        COMMA_LOCATION_ARGS) {
  GALGAS_hardware_5F_counter result ;
  if (inAttribute_location.isValid () && inAttribute_driver.isValid () && inAttribute_time_5F_consts.isValid ()) {
    macroMyNew (result.mObjectPtr, cPtr_hardware_5F_counter (inAttribute_location, inAttribute_driver, inAttribute_time_5F_consts COMMA_THERE)) ;
  }
  return result ;
}

//---------------------------------------------------------------------------*

void GALGAS_hardware_5F_counter::insulate (LOCATION_ARGS) {
  if (isValid () && (mObjectPtr->retainCount () > 1)) {
    cPtr_hardware_5F_counter * p = (cPtr_hardware_5F_counter *) mObjectPtr ;
    macroValidSharedObject (p, cPtr_hardware_5F_counter) ;
    cPtr_hardware_5F_counter * r = NULL ;
    macroMyNew (r, cPtr_hardware_5F_counter (p->mAttribute_location, p->mAttribute_driver, p->mAttribute_time_5F_consts COMMA_THERE)) ;
    macroAssignSharedObject (mObjectPtr, r) ;
    macroDetachSharedObject (r) ;
  }
}

//---------------------------------------------------------------------------*

GALGAS_counter_5F_driver GALGAS_hardware_5F_counter::reader_driver (UNUSED_LOCATION_ARGS) const {
  GALGAS_counter_5F_driver result ;
  if (NULL != mObjectPtr) {
    const cPtr_hardware_5F_counter * p = (const cPtr_hardware_5F_counter *) mObjectPtr ;
    macroValidSharedObject (p, const cPtr_hardware_5F_counter) ;
    result = p->mAttribute_driver ;
  }
  return result ;
}

//---------------------------------------------------------------------------*

GALGAS_time_5F_constants GALGAS_hardware_5F_counter::reader_time_5F_consts (UNUSED_LOCATION_ARGS) const {
  GALGAS_time_5F_constants result ;
  if (NULL != mObjectPtr) {
    const cPtr_hardware_5F_counter * p = (const cPtr_hardware_5F_counter *) mObjectPtr ;
    macroValidSharedObject (p, const cPtr_hardware_5F_counter) ;
    result = p->mAttribute_time_5F_consts ;
  }
  return result ;
}

//---------------------------------------------------------------------------*
//                 Pointer class for @hardware_counter class                 *
//---------------------------------------------------------------------------*

cPtr_hardware_5F_counter::cPtr_hardware_5F_counter (const GALGAS_location & in_location,
                                                    const GALGAS_counter_5F_driver & in_driver,
                                                    const GALGAS_time_5F_constants & in_time_5F_consts
                                                    COMMA_LOCATION_ARGS) :
cPtr_counter_5F_type (in_location COMMA_THERE),
mAttribute_driver (in_driver),
mAttribute_time_5F_consts (in_time_5F_consts) {
}

//---------------------------------------------------------------------------*

const C_galgas_type_descriptor * cPtr_hardware_5F_counter::classDescriptor (void) const {
  return & kTypeDescriptor_GALGAS_hardware_5F_counter ;
}

void cPtr_hardware_5F_counter::description (C_String & ioString,
                                            const PMSInt32 inIndentation) const {
  ioString << "[@hardware_counter:" ;
  mAttribute_location.description (ioString, inIndentation+1) ;
  ioString << ", " ;
  mAttribute_driver.description (ioString, inIndentation+1) ;
  ioString << ", " ;
  mAttribute_time_5F_consts.description (ioString, inIndentation+1) ;
  ioString << "]" ;
}



//---------------------------------------------------------------------------*
//                                                                           *
//                          @hardware_counter type                           *
//                                                                           *
//---------------------------------------------------------------------------*

const C_galgas_type_descriptor
kTypeDescriptor_GALGAS_hardware_5F_counter ("hardware_counter",
                                            & kTypeDescriptor_GALGAS_counter_5F_type) ;

//---------------------------------------------------------------------------*

const C_galgas_type_descriptor * GALGAS_hardware_5F_counter::staticTypeDescriptor (void) const {
  return & kTypeDescriptor_GALGAS_hardware_5F_counter ;
}

//---------------------------------------------------------------------------*

AC_GALGAS_root * GALGAS_hardware_5F_counter::clonedObject (void) const {
  AC_GALGAS_root * result = NULL ;
  if (isValid ()) {
    macroMyNew (result, GALGAS_hardware_5F_counter (*this)) ;
  }
  return result ;
}

//---------------------------------------------------------------------------*

GALGAS_hardware_5F_counter GALGAS_hardware_5F_counter::extractObject (const GALGAS_object & inObject,
                                                                      C_Compiler * inCompiler,
                                                                      const GALGAS_location & inErrorLocation
                                                                      COMMA_LOCATION_ARGS) {
  GALGAS_hardware_5F_counter result ;
  const GALGAS_hardware_5F_counter * p = (const GALGAS_hardware_5F_counter *) inObject.embeddedObject () ;
  if (NULL != p) {
    if (NULL != dynamic_cast <const GALGAS_hardware_5F_counter *> (p)) {
      result = *p ;
    }else{
      inCompiler->extractObjectError (inErrorLocation, "hardware_counter", p->dynamicTypeDescriptor () COMMA_THERE) ;
    }  
  }
  return result ;
}

//---------------------------------------------------------------------------*

enumComparisonResult GALGAS_software_5F_counter::objectCompare (const GALGAS_software_5F_counter & inOperand) const {
  return (isValid () && inOperand.isValid ()) ? kOperandEqual : kOperandNotValid ;
}


//---------------------------------------------------------------------------*

GALGAS_software_5F_counter::GALGAS_software_5F_counter (void) :
GALGAS_counter_5F_type () {
}

//---------------------------------------------------------------------------*

GALGAS_software_5F_counter::GALGAS_software_5F_counter (const cPtr_software_5F_counter * inSourcePtr) :
GALGAS_counter_5F_type (inSourcePtr) {
  macroNullOrValidSharedObject (inSourcePtr, const cPtr_software_5F_counter) ;
}

//---------------------------------------------------------------------------*

GALGAS_software_5F_counter GALGAS_software_5F_counter::constructor_new (const GALGAS_location & inAttribute_location
                                                                        COMMA_LOCATION_ARGS) {
  GALGAS_software_5F_counter result ;
  if (inAttribute_location.isValid ()) {
    macroMyNew (result.mObjectPtr, cPtr_software_5F_counter (inAttribute_location COMMA_THERE)) ;
  }
  return result ;
}

//---------------------------------------------------------------------------*

void GALGAS_software_5F_counter::insulate (LOCATION_ARGS) {
  if (isValid () && (mObjectPtr->retainCount () > 1)) {
    cPtr_software_5F_counter * p = (cPtr_software_5F_counter *) mObjectPtr ;
    macroValidSharedObject (p, cPtr_software_5F_counter) ;
    cPtr_software_5F_counter * r = NULL ;
    macroMyNew (r, cPtr_software_5F_counter (p->mAttribute_location COMMA_THERE)) ;
    macroAssignSharedObject (mObjectPtr, r) ;
    macroDetachSharedObject (r) ;
  }
}

//---------------------------------------------------------------------------*
//                 Pointer class for @software_counter class                 *
//---------------------------------------------------------------------------*

cPtr_software_5F_counter::cPtr_software_5F_counter (const GALGAS_location & in_location
                                                    COMMA_LOCATION_ARGS) :
cPtr_counter_5F_type (in_location COMMA_THERE) {
}

//---------------------------------------------------------------------------*

const C_galgas_type_descriptor * cPtr_software_5F_counter::classDescriptor (void) const {
  return & kTypeDescriptor_GALGAS_software_5F_counter ;
}

void cPtr_software_5F_counter::description (C_String & ioString,
                                            const PMSInt32 inIndentation) const {
  ioString << "[@software_counter:" ;
  mAttribute_location.description (ioString, inIndentation+1) ;
  ioString << "]" ;
}



//---------------------------------------------------------------------------*
//                                                                           *
//                          @software_counter type                           *
//                                                                           *
//---------------------------------------------------------------------------*

const C_galgas_type_descriptor
kTypeDescriptor_GALGAS_software_5F_counter ("software_counter",
                                            & kTypeDescriptor_GALGAS_counter_5F_type) ;

//---------------------------------------------------------------------------*

const C_galgas_type_descriptor * GALGAS_software_5F_counter::staticTypeDescriptor (void) const {
  return & kTypeDescriptor_GALGAS_software_5F_counter ;
}

//---------------------------------------------------------------------------*

AC_GALGAS_root * GALGAS_software_5F_counter::clonedObject (void) const {
  AC_GALGAS_root * result = NULL ;
  if (isValid ()) {
    macroMyNew (result, GALGAS_software_5F_counter (*this)) ;
  }
  return result ;
}

//---------------------------------------------------------------------------*

GALGAS_software_5F_counter GALGAS_software_5F_counter::extractObject (const GALGAS_object & inObject,
                                                                      C_Compiler * inCompiler,
                                                                      const GALGAS_location & inErrorLocation
                                                                      COMMA_LOCATION_ARGS) {
  GALGAS_software_5F_counter result ;
  const GALGAS_software_5F_counter * p = (const GALGAS_software_5F_counter *) inObject.embeddedObject () ;
  if (NULL != p) {
    if (NULL != dynamic_cast <const GALGAS_software_5F_counter *> (p)) {
      result = *p ;
    }else{
      inCompiler->extractObjectError (inErrorLocation, "software_counter", p->dynamicTypeDescriptor () COMMA_THERE) ;
    }  
  }
  return result ;
}

//---------------------------------------------------------------------------*

enumComparisonResult GALGAS_void_5F_counter::objectCompare (const GALGAS_void_5F_counter & inOperand) const {
  return (isValid () && inOperand.isValid ()) ? kOperandEqual : kOperandNotValid ;
}


//---------------------------------------------------------------------------*

GALGAS_void_5F_counter::GALGAS_void_5F_counter (void) :
GALGAS_counter_5F_type () {
}

//---------------------------------------------------------------------------*

GALGAS_void_5F_counter::GALGAS_void_5F_counter (const cPtr_void_5F_counter * inSourcePtr) :
GALGAS_counter_5F_type (inSourcePtr) {
  macroNullOrValidSharedObject (inSourcePtr, const cPtr_void_5F_counter) ;
}

//---------------------------------------------------------------------------*

GALGAS_void_5F_counter GALGAS_void_5F_counter::constructor_new (const GALGAS_location & inAttribute_location
                                                                COMMA_LOCATION_ARGS) {
  GALGAS_void_5F_counter result ;
  if (inAttribute_location.isValid ()) {
    macroMyNew (result.mObjectPtr, cPtr_void_5F_counter (inAttribute_location COMMA_THERE)) ;
  }
  return result ;
}

//---------------------------------------------------------------------------*

void GALGAS_void_5F_counter::insulate (LOCATION_ARGS) {
  if (isValid () && (mObjectPtr->retainCount () > 1)) {
    cPtr_void_5F_counter * p = (cPtr_void_5F_counter *) mObjectPtr ;
    macroValidSharedObject (p, cPtr_void_5F_counter) ;
    cPtr_void_5F_counter * r = NULL ;
    macroMyNew (r, cPtr_void_5F_counter (p->mAttribute_location COMMA_THERE)) ;
    macroAssignSharedObject (mObjectPtr, r) ;
    macroDetachSharedObject (r) ;
  }
}

//---------------------------------------------------------------------------*
//                   Pointer class for @void_counter class                   *
//---------------------------------------------------------------------------*

cPtr_void_5F_counter::cPtr_void_5F_counter (const GALGAS_location & in_location
                                            COMMA_LOCATION_ARGS) :
cPtr_counter_5F_type (in_location COMMA_THERE) {
}

//---------------------------------------------------------------------------*

const C_galgas_type_descriptor * cPtr_void_5F_counter::classDescriptor (void) const {
  return & kTypeDescriptor_GALGAS_void_5F_counter ;
}

void cPtr_void_5F_counter::description (C_String & ioString,
                                        const PMSInt32 inIndentation) const {
  ioString << "[@void_counter:" ;
  mAttribute_location.description (ioString, inIndentation+1) ;
  ioString << "]" ;
}



//---------------------------------------------------------------------------*
//                                                                           *
//                            @void_counter type                             *
//                                                                           *
//---------------------------------------------------------------------------*

const C_galgas_type_descriptor
kTypeDescriptor_GALGAS_void_5F_counter ("void_counter",
                                        & kTypeDescriptor_GALGAS_counter_5F_type) ;

//---------------------------------------------------------------------------*

const C_galgas_type_descriptor * GALGAS_void_5F_counter::staticTypeDescriptor (void) const {
  return & kTypeDescriptor_GALGAS_void_5F_counter ;
}

//---------------------------------------------------------------------------*

AC_GALGAS_root * GALGAS_void_5F_counter::clonedObject (void) const {
  AC_GALGAS_root * result = NULL ;
  if (isValid ()) {
    macroMyNew (result, GALGAS_void_5F_counter (*this)) ;
  }
  return result ;
}

//---------------------------------------------------------------------------*

GALGAS_void_5F_counter GALGAS_void_5F_counter::extractObject (const GALGAS_object & inObject,
                                                              C_Compiler * inCompiler,
                                                              const GALGAS_location & inErrorLocation
                                                              COMMA_LOCATION_ARGS) {
  GALGAS_void_5F_counter result ;
  const GALGAS_void_5F_counter * p = (const GALGAS_void_5F_counter *) inObject.embeddedObject () ;
  if (NULL != p) {
    if (NULL != dynamic_cast <const GALGAS_void_5F_counter *> (p)) {
      result = *p ;
    }else{
      inCompiler->extractObjectError (inErrorLocation, "void_counter", p->dynamicTypeDescriptor () COMMA_THERE) ;
    }  
  }
  return result ;
}

//---------------------------------------------------------------------------*

enumComparisonResult GALGAS_counter_5F_obj::objectCompare (const GALGAS_counter_5F_obj & inOperand) const {
  enumComparisonResult result = GALGAS_oil_5F_obj::objectCompare (inOperand) ;
  const cPtr_counter_5F_obj * p = (const cPtr_counter_5F_obj *) mObjectPtr ;
  macroNullOrValidSharedObject (p, const cPtr_counter_5F_obj) ;
  const cPtr_counter_5F_obj * q = (const cPtr_counter_5F_obj *) inOperand.mObjectPtr ;
  macroNullOrValidSharedObject (q, const cPtr_counter_5F_obj) ;
  if (kOperandEqual == result) {
    result = p->mAttribute_max_5F_allowed_5F_value.objectCompare (q->mAttribute_max_5F_allowed_5F_value) ;
  }
  if (kOperandEqual == result) {
    result = p->mAttribute_ticks_5F_per_5F_base.objectCompare (q->mAttribute_ticks_5F_per_5F_base) ;
  }
  if (kOperandEqual == result) {
    result = p->mAttribute_min_5F_cycle.objectCompare (q->mAttribute_min_5F_cycle) ;
  }
  if (kOperandEqual == result) {
    result = p->mAttribute_source.objectCompare (q->mAttribute_source) ;
  }
  if (kOperandEqual == result) {
    result = p->mAttribute_acc_5F_apps.objectCompare (q->mAttribute_acc_5F_apps) ;
  }
  if (kOperandEqual == result) {
    result = p->mAttribute_type.objectCompare (q->mAttribute_type) ;
  }
  if (kOperandEqual == result) {
    result = p->mAttribute_unit.objectCompare (q->mAttribute_unit) ;
  }
  return result ;
}


//---------------------------------------------------------------------------*

GALGAS_counter_5F_obj::GALGAS_counter_5F_obj (void) :
GALGAS_oil_5F_obj () {
}

//---------------------------------------------------------------------------*

GALGAS_counter_5F_obj::GALGAS_counter_5F_obj (const cPtr_counter_5F_obj * inSourcePtr) :
GALGAS_oil_5F_obj (inSourcePtr) {
  macroNullOrValidSharedObject (inSourcePtr, const cPtr_counter_5F_obj) ;
}

//---------------------------------------------------------------------------*

GALGAS_counter_5F_obj GALGAS_counter_5F_obj::constructor_new (const GALGAS_lstring & inAttribute_desc,
                                                              const GALGAS_basic_5F_type & inAttribute_max_5F_allowed_5F_value,
                                                              const GALGAS_basic_5F_type & inAttribute_ticks_5F_per_5F_base,
                                                              const GALGAS_basic_5F_type & inAttribute_min_5F_cycle,
                                                              const GALGAS_lstring & inAttribute_source,
                                                              const GALGAS_lstringlist & inAttribute_acc_5F_apps,
                                                              const GALGAS_counter_5F_type & inAttribute_type,
                                                              const GALGAS_lstring & inAttribute_unit
                                                              COMMA_LOCATION_ARGS) {
  GALGAS_counter_5F_obj result ;
  if (inAttribute_desc.isValid () && inAttribute_max_5F_allowed_5F_value.isValid () && inAttribute_ticks_5F_per_5F_base.isValid () && inAttribute_min_5F_cycle.isValid () && inAttribute_source.isValid () && inAttribute_acc_5F_apps.isValid () && inAttribute_type.isValid () && inAttribute_unit.isValid ()) {
    macroMyNew (result.mObjectPtr, cPtr_counter_5F_obj (inAttribute_desc, inAttribute_max_5F_allowed_5F_value, inAttribute_ticks_5F_per_5F_base, inAttribute_min_5F_cycle, inAttribute_source, inAttribute_acc_5F_apps, inAttribute_type, inAttribute_unit COMMA_THERE)) ;
  }
  return result ;
}

//---------------------------------------------------------------------------*

void GALGAS_counter_5F_obj::insulate (LOCATION_ARGS) {
  if (isValid () && (mObjectPtr->retainCount () > 1)) {
    cPtr_counter_5F_obj * p = (cPtr_counter_5F_obj *) mObjectPtr ;
    macroValidSharedObject (p, cPtr_counter_5F_obj) ;
    cPtr_counter_5F_obj * r = NULL ;
    macroMyNew (r, cPtr_counter_5F_obj (p->mAttribute_desc, p->mAttribute_max_5F_allowed_5F_value, p->mAttribute_ticks_5F_per_5F_base, p->mAttribute_min_5F_cycle, p->mAttribute_source, p->mAttribute_acc_5F_apps, p->mAttribute_type, p->mAttribute_unit COMMA_THERE)) ;
    macroAssignSharedObject (mObjectPtr, r) ;
    macroDetachSharedObject (r) ;
  }
}

//---------------------------------------------------------------------------*

GALGAS_basic_5F_type GALGAS_counter_5F_obj::reader_max_5F_allowed_5F_value (UNUSED_LOCATION_ARGS) const {
  GALGAS_basic_5F_type result ;
  if (NULL != mObjectPtr) {
    const cPtr_counter_5F_obj * p = (const cPtr_counter_5F_obj *) mObjectPtr ;
    macroValidSharedObject (p, const cPtr_counter_5F_obj) ;
    result = p->mAttribute_max_5F_allowed_5F_value ;
  }
  return result ;
}

//---------------------------------------------------------------------------*

GALGAS_basic_5F_type GALGAS_counter_5F_obj::reader_ticks_5F_per_5F_base (UNUSED_LOCATION_ARGS) const {
  GALGAS_basic_5F_type result ;
  if (NULL != mObjectPtr) {
    const cPtr_counter_5F_obj * p = (const cPtr_counter_5F_obj *) mObjectPtr ;
    macroValidSharedObject (p, const cPtr_counter_5F_obj) ;
    result = p->mAttribute_ticks_5F_per_5F_base ;
  }
  return result ;
}

//---------------------------------------------------------------------------*

GALGAS_basic_5F_type GALGAS_counter_5F_obj::reader_min_5F_cycle (UNUSED_LOCATION_ARGS) const {
  GALGAS_basic_5F_type result ;
  if (NULL != mObjectPtr) {
    const cPtr_counter_5F_obj * p = (const cPtr_counter_5F_obj *) mObjectPtr ;
    macroValidSharedObject (p, const cPtr_counter_5F_obj) ;
    result = p->mAttribute_min_5F_cycle ;
  }
  return result ;
}

//---------------------------------------------------------------------------*

GALGAS_lstring GALGAS_counter_5F_obj::reader_source (UNUSED_LOCATION_ARGS) const {
  GALGAS_lstring result ;
  if (NULL != mObjectPtr) {
    const cPtr_counter_5F_obj * p = (const cPtr_counter_5F_obj *) mObjectPtr ;
    macroValidSharedObject (p, const cPtr_counter_5F_obj) ;
    result = p->mAttribute_source ;
  }
  return result ;
}

//---------------------------------------------------------------------------*

GALGAS_lstringlist GALGAS_counter_5F_obj::reader_acc_5F_apps (UNUSED_LOCATION_ARGS) const {
  GALGAS_lstringlist result ;
  if (NULL != mObjectPtr) {
    const cPtr_counter_5F_obj * p = (const cPtr_counter_5F_obj *) mObjectPtr ;
    macroValidSharedObject (p, const cPtr_counter_5F_obj) ;
    result = p->mAttribute_acc_5F_apps ;
  }
  return result ;
}

//---------------------------------------------------------------------------*

GALGAS_counter_5F_type GALGAS_counter_5F_obj::reader_type (UNUSED_LOCATION_ARGS) const {
  GALGAS_counter_5F_type result ;
  if (NULL != mObjectPtr) {
    const cPtr_counter_5F_obj * p = (const cPtr_counter_5F_obj *) mObjectPtr ;
    macroValidSharedObject (p, const cPtr_counter_5F_obj) ;
    result = p->mAttribute_type ;
  }
  return result ;
}

//---------------------------------------------------------------------------*

GALGAS_lstring GALGAS_counter_5F_obj::reader_unit (UNUSED_LOCATION_ARGS) const {
  GALGAS_lstring result ;
  if (NULL != mObjectPtr) {
    const cPtr_counter_5F_obj * p = (const cPtr_counter_5F_obj *) mObjectPtr ;
    macroValidSharedObject (p, const cPtr_counter_5F_obj) ;
    result = p->mAttribute_unit ;
  }
  return result ;
}

//---------------------------------------------------------------------------*

void GALGAS_counter_5F_obj::modifier_setMax_5F_allowed_5F_value (GALGAS_basic_5F_type inValue
                                                                 COMMA_UNUSED_LOCATION_ARGS) {
  if (NULL != mObjectPtr) {
    cPtr_counter_5F_obj * p = (cPtr_counter_5F_obj *) mObjectPtr ;
    macroValidSharedObject (p, cPtr_counter_5F_obj) ;
    p->mAttribute_max_5F_allowed_5F_value = inValue ;
  }
}

//---------------------------------------------------------------------------*

void GALGAS_counter_5F_obj::modifier_setTicks_5F_per_5F_base (GALGAS_basic_5F_type inValue
                                                              COMMA_UNUSED_LOCATION_ARGS) {
  if (NULL != mObjectPtr) {
    cPtr_counter_5F_obj * p = (cPtr_counter_5F_obj *) mObjectPtr ;
    macroValidSharedObject (p, cPtr_counter_5F_obj) ;
    p->mAttribute_ticks_5F_per_5F_base = inValue ;
  }
}

//---------------------------------------------------------------------------*

void GALGAS_counter_5F_obj::modifier_setMin_5F_cycle (GALGAS_basic_5F_type inValue
                                                      COMMA_UNUSED_LOCATION_ARGS) {
  if (NULL != mObjectPtr) {
    cPtr_counter_5F_obj * p = (cPtr_counter_5F_obj *) mObjectPtr ;
    macroValidSharedObject (p, cPtr_counter_5F_obj) ;
    p->mAttribute_min_5F_cycle = inValue ;
  }
}

//---------------------------------------------------------------------------*

void GALGAS_counter_5F_obj::modifier_setAcc_5F_apps (GALGAS_lstringlist inValue
                                                     COMMA_UNUSED_LOCATION_ARGS) {
  if (NULL != mObjectPtr) {
    cPtr_counter_5F_obj * p = (cPtr_counter_5F_obj *) mObjectPtr ;
    macroValidSharedObject (p, cPtr_counter_5F_obj) ;
    p->mAttribute_acc_5F_apps = inValue ;
  }
}

//---------------------------------------------------------------------------*
//                   Pointer class for @counter_obj class                    *
//---------------------------------------------------------------------------*

cPtr_counter_5F_obj::cPtr_counter_5F_obj (const GALGAS_lstring & in_desc,
                                          const GALGAS_basic_5F_type & in_max_5F_allowed_5F_value,
                                          const GALGAS_basic_5F_type & in_ticks_5F_per_5F_base,
                                          const GALGAS_basic_5F_type & in_min_5F_cycle,
                                          const GALGAS_lstring & in_source,
                                          const GALGAS_lstringlist & in_acc_5F_apps,
                                          const GALGAS_counter_5F_type & in_type,
                                          const GALGAS_lstring & in_unit
                                          COMMA_LOCATION_ARGS) :
cPtr_oil_5F_obj (in_desc COMMA_THERE),
mAttribute_max_5F_allowed_5F_value (in_max_5F_allowed_5F_value),
mAttribute_ticks_5F_per_5F_base (in_ticks_5F_per_5F_base),
mAttribute_min_5F_cycle (in_min_5F_cycle),
mAttribute_source (in_source),
mAttribute_acc_5F_apps (in_acc_5F_apps),
mAttribute_type (in_type),
mAttribute_unit (in_unit) {
}

//---------------------------------------------------------------------------*

const C_galgas_type_descriptor * cPtr_counter_5F_obj::classDescriptor (void) const {
  return & kTypeDescriptor_GALGAS_counter_5F_obj ;
}

void cPtr_counter_5F_obj::description (C_String & ioString,
                                       const PMSInt32 inIndentation) const {
  ioString << "[@counter_obj:" ;
  mAttribute_desc.description (ioString, inIndentation+1) ;
  ioString << ", " ;
  mAttribute_max_5F_allowed_5F_value.description (ioString, inIndentation+1) ;
  ioString << ", " ;
  mAttribute_ticks_5F_per_5F_base.description (ioString, inIndentation+1) ;
  ioString << ", " ;
  mAttribute_min_5F_cycle.description (ioString, inIndentation+1) ;
  ioString << ", " ;
  mAttribute_source.description (ioString, inIndentation+1) ;
  ioString << ", " ;
  mAttribute_acc_5F_apps.description (ioString, inIndentation+1) ;
  ioString << ", " ;
  mAttribute_type.description (ioString, inIndentation+1) ;
  ioString << ", " ;
  mAttribute_unit.description (ioString, inIndentation+1) ;
  ioString << "]" ;
}



//---------------------------------------------------------------------------*
//                                                                           *
//                             @counter_obj type                             *
//                                                                           *
//---------------------------------------------------------------------------*

const C_galgas_type_descriptor
kTypeDescriptor_GALGAS_counter_5F_obj ("counter_obj",
                                       & kTypeDescriptor_GALGAS_oil_5F_obj) ;

//---------------------------------------------------------------------------*

const C_galgas_type_descriptor * GALGAS_counter_5F_obj::staticTypeDescriptor (void) const {
  return & kTypeDescriptor_GALGAS_counter_5F_obj ;
}

//---------------------------------------------------------------------------*

AC_GALGAS_root * GALGAS_counter_5F_obj::clonedObject (void) const {
  AC_GALGAS_root * result = NULL ;
  if (isValid ()) {
    macroMyNew (result, GALGAS_counter_5F_obj (*this)) ;
  }
  return result ;
}

//---------------------------------------------------------------------------*

GALGAS_counter_5F_obj GALGAS_counter_5F_obj::extractObject (const GALGAS_object & inObject,
                                                            C_Compiler * inCompiler,
                                                            const GALGAS_location & inErrorLocation
                                                            COMMA_LOCATION_ARGS) {
  GALGAS_counter_5F_obj result ;
  const GALGAS_counter_5F_obj * p = (const GALGAS_counter_5F_obj *) inObject.embeddedObject () ;
  if (NULL != p) {
    if (NULL != dynamic_cast <const GALGAS_counter_5F_obj *> (p)) {
      result = *p ;
    }else{
      inCompiler->extractObjectError (inErrorLocation, "counter_obj", p->dynamicTypeDescriptor () COMMA_THERE) ;
    }  
  }
  return result ;
}

//--- START OF USER ZONE 2


//--- END OF USER ZONE 2


