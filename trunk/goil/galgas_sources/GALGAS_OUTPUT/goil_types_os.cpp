//---------------------------------------------------------------------------*
//                                                                           *
//                         File 'goil_types_os.cpp'                          *
//                 Generated by version GALGAS_BETA_VERSION                  *
//                       june 21th, 2010, at 21h3'58"                        *
//                                                                           *
//---------------------------------------------------------------------------*

//--- START OF USER ZONE 1


//--- END OF USER ZONE 1

#include "version_libpm.h"
#if CURRENT_LIBPM_VERSION != VERSION_OF_LIBPM_USED_BY_GALGAS_COMPILER
  #error "This file has been compiled with a version of GALGAS that uses libpm version VERSION_OF_LIBPM_USED_BY_GALGAS_COMPILER, different than the current version (CURRENT_LIBPM_VERSION) of libpm"
#endif

//---------------------------------------------------------------------------*

#include "goil_types_os.h"
#include "galgas-utilities/C_Compiler.h"
#include "galgas/C_galgas_CLI_Options.h"

//---------------------------------------------------------------------------*

#include "goil_options.h"

//---------------------------------------------------------------------------*

#ifndef DO_NOT_GENERATE_CHECKINGS
  #define SOURCE_FILE_AT_LINE(line) "goil_types_os.gSemantics", line
  #define COMMA_SOURCE_FILE_AT_LINE(line) , SOURCE_FILE_AT_LINE(line)
#else
  #define SOURCE_FILE_AT_LINE(line) 
  #define COMMA_SOURCE_FILE_AT_LINE(line) 
#endif

//---------------------------------------------------------------------------*
//                                                                           *
//                        @trace_method auto ptr type                        *
//                                                                           *
//---------------------------------------------------------------------------*

GALGASap_trace_5F_method::GALGASap_trace_5F_method (const GALGASap_trace_5F_method & inSource) :
GALGASap_class (inSource) {
}

//---------------------------------------------------------------------------*

GALGASap_trace_5F_method::GALGASap_trace_5F_method (const GALGASap_object & inSource) :
GALGASap_class (inSource) {
  macroNullOrValidObject (mPtr, GALGAS_trace_5F_method) ;
}

//---------------------------------------------------------------------------*

GALGASap_trace_5F_method & GALGASap_trace_5F_method::operator = (const GALGASap_trace_5F_method & inSource) {
  macroAssignObject (mPtr, inSource.mPtr) ;
  return * this ;
}

//---------------------------------------------------------------------------*

GALGASap_location GALGASap_trace_5F_method::readerCall_loc (LOCATION_ARGS) const {
  GALGASap_location result ;
  if (isValid ()) {
    result = ptr (HERE)->reader_loc (THERE) ;
  }
  return result ;
}

//---------------------------------------------------------------------------*

#ifndef DO_NOT_GENERATE_CHECKINGS
  GALGAS_trace_5F_method * GALGASap_trace_5F_method::ptr (LOCATION_ARGS) {
    macroValidObjectThere (mPtr, GALGAS_trace_5F_method) ;
    return (GALGAS_trace_5F_method *) mPtr ;
  }
#endif

//---------------------------------------------------------------------------*

#ifndef DO_NOT_GENERATE_CHECKINGS
  const GALGAS_trace_5F_method * GALGASap_trace_5F_method::ptr (LOCATION_ARGS) const {
    macroValidObjectThere (mPtr, const GALGAS_trace_5F_method) ;
    return (const GALGAS_trace_5F_method *) mPtr ;
  }
#endif

//---------------------------------------------------------------------------*

GALGASap_trace_5F_method::GALGASap_trace_5F_method (const GALGAS_trace_5F_method * inSourcePtr) :
GALGASap_class (inSourcePtr) {
}

//---------------------------------------------------------------------------*

GALGASap_trace_5F_method & GALGASap_trace_5F_method::operator = (GALGAS_trace_5F_method * inSourcePtr) {
  macroAssignObject (mPtr, inSourcePtr) ;
  return *this ;
}

//---------------------------------------------------------------------------*

enumComparisonResult GALGASap_trace_5F_method::objectCompare (const GALGASap_trace_5F_method & inOperand1,
                                                              const GALGASap_trace_5F_method & inOperand2) {
  enumComparisonResult result = (inOperand1.isValid () && inOperand2.isValid ()) ? kOperandEqual : kOperandNotValid ;
  if (kOperandEqual == result) {
    result = GALGASap_location::objectCompare (inOperand1.ptr (HERE)->mAttribute_loc, inOperand2.ptr (HERE)->mAttribute_loc) ;
  }
  return result ;
}


//---------------------------------------------------------------------------*

GALGAS_trace_5F_method::GALGAS_trace_5F_method (const GALGASap_location & constinAttribute_loc
                                                COMMA_LOCATION_ARGS) :
GALGAS_class (THERE),
mAttribute_loc (constinAttribute_loc) {
}

//---------------------------------------------------------------------------*

GALGAS_trace_5F_method::~GALGAS_trace_5F_method (void) {
}

//---------------------------------------------------------------------------*

GALGASap_location GALGAS_trace_5F_method::reader_loc (UNUSED_LOCATION_ARGS) const {
  return mAttribute_loc ;
}

//---------------------------------------------------------------------------*
//                                                                           *
//                         @trace_method class type                          *
//                                                                           *
//---------------------------------------------------------------------------*

const C_galgas_type_descriptor
kTypeDescriptor_GALGAS_trace_5F_method ("trace_method",
                                        & kTypeDescriptor_GALGAS_class) ;


//---------------------------------------------------------------------------*

const C_galgas_type_descriptor * GALGAS_trace_5F_method::typeDescriptor (void) const {
  return & kTypeDescriptor_GALGAS_trace_5F_method ;
}
//---------------------------------------------------------------------------*
//                                                                           *
//                         @trace_void auto ptr type                         *
//                                                                           *
//---------------------------------------------------------------------------*

GALGASap_trace_5F_void::GALGASap_trace_5F_void (const GALGASap_trace_5F_void & inSource) :
GALGASap_trace_5F_method (inSource) {
}

//---------------------------------------------------------------------------*

GALGASap_trace_5F_void::GALGASap_trace_5F_void (const GALGASap_object & inSource) :
GALGASap_trace_5F_method (inSource) {
  macroNullOrValidObject (mPtr, GALGAS_trace_5F_void) ;
}

//---------------------------------------------------------------------------*

GALGASap_trace_5F_void & GALGASap_trace_5F_void::operator = (const GALGASap_trace_5F_void & inSource) {
  macroAssignObject (mPtr, inSource.mPtr) ;
  return * this ;
}

//---------------------------------------------------------------------------*

#ifndef DO_NOT_GENERATE_CHECKINGS
  GALGAS_trace_5F_void * GALGASap_trace_5F_void::ptr (LOCATION_ARGS) {
    macroValidObjectThere (mPtr, GALGAS_trace_5F_void) ;
    return (GALGAS_trace_5F_void *) mPtr ;
  }
#endif

//---------------------------------------------------------------------------*

#ifndef DO_NOT_GENERATE_CHECKINGS
  const GALGAS_trace_5F_void * GALGASap_trace_5F_void::ptr (LOCATION_ARGS) const {
    macroValidObjectThere (mPtr, const GALGAS_trace_5F_void) ;
    return (const GALGAS_trace_5F_void *) mPtr ;
  }
#endif

//---------------------------------------------------------------------------*

GALGASap_trace_5F_void::GALGASap_trace_5F_void (const GALGAS_trace_5F_void * inSourcePtr) :
GALGASap_trace_5F_method (inSourcePtr) {
}

//---------------------------------------------------------------------------*

GALGASap_trace_5F_void & GALGASap_trace_5F_void::operator = (GALGAS_trace_5F_void * inSourcePtr) {
  macroAssignObject (mPtr, inSourcePtr) ;
  return *this ;
}

//---------------------------------------------------------------------------*

enumComparisonResult GALGASap_trace_5F_void::objectCompare (const GALGASap_trace_5F_void & inOperand1,
                                                            const GALGASap_trace_5F_void & inOperand2) {
  return (inOperand1.isValid () && inOperand2.isValid ()) ? kOperandEqual : kOperandNotValid ;
}


//---------------------------------------------------------------------------*

GALGAS_trace_5F_void::GALGAS_trace_5F_void (const GALGASap_location & constinAttribute_loc
                                            COMMA_LOCATION_ARGS) :
GALGAS_trace_5F_method (constinAttribute_loc COMMA_THERE) {
}

//---------------------------------------------------------------------------*

GALGASap_trace_5F_void GALGASap_trace_5F_void::constructor_new (GALGASap_location & inAttribute_loc
                                                                COMMA_LOCATION_ARGS) {
  GALGAS_trace_5F_void * result = NULL ;
  if (inAttribute_loc.isValid ()) {
    macroMyNew (result, GALGAS_trace_5F_void (inAttribute_loc COMMA_THERE)) ;
  }
  return result ;
}

//---------------------------------------------------------------------------*

void GALGAS_trace_5F_void::description (C_String & ioString,
                                        const PMSInt32 /* inIndentation */) const {
  ioString << "<class @"
           << typeDescriptor ()->mGalgasTypeName
           << ":" ;
  ioString << ">" ;
}

//---------------------------------------------------------------------------*

GALGAS_trace_5F_void::~GALGAS_trace_5F_void (void) {
}

//---------------------------------------------------------------------------*

void GALGASap_trace_5F_void::insulate (LOCATION_ARGS) {
  if (isValid () && (ptr (HERE)->retainCount () > 1)) {
    GALGASap_trace_5F_void p = constructor_new (ptr (HERE)->mAttribute_loc COMMA_THERE) ;
    *this = p ;
  }
}

//---------------------------------------------------------------------------*

void GALGAS_trace_5F_void::modifier_setLoc (GALGASap_location inValue
                                            COMMA_UNUSED_LOCATION_ARGS) {
  mAttribute_loc = inValue ;
}

//---------------------------------------------------------------------------*
//                                                                           *
//                          @trace_void class type                           *
//                                                                           *
//---------------------------------------------------------------------------*

const C_galgas_type_descriptor
kTypeDescriptor_GALGAS_trace_5F_void ("trace_void",
                                      & kTypeDescriptor_GALGAS_trace_5F_method) ;


//---------------------------------------------------------------------------*

const C_galgas_type_descriptor * GALGAS_trace_5F_void::typeDescriptor (void) const {
  return & kTypeDescriptor_GALGAS_trace_5F_void ;
}
//---------------------------------------------------------------------------*

void GALGASap_trace_5F_void::modifierCall_setLoc (GALGASap_location inArgument0
                                                  COMMA_LOCATION_ARGS) {
//--- Release 'output' arguments
//---
  if (isValid ()) {
    insulate (THERE) ;
    ptr (HERE)->modifier_setLoc (inArgument0 COMMA_THERE) ;
  }
}

//---------------------------------------------------------------------------*
//                                                                           *
//                         @trace_file auto ptr type                         *
//                                                                           *
//---------------------------------------------------------------------------*

GALGASap_trace_5F_file::GALGASap_trace_5F_file (const GALGASap_trace_5F_file & inSource) :
GALGASap_trace_5F_method (inSource) {
}

//---------------------------------------------------------------------------*

GALGASap_trace_5F_file::GALGASap_trace_5F_file (const GALGASap_object & inSource) :
GALGASap_trace_5F_method (inSource) {
  macroNullOrValidObject (mPtr, GALGAS_trace_5F_file) ;
}

//---------------------------------------------------------------------------*

GALGASap_trace_5F_file & GALGASap_trace_5F_file::operator = (const GALGASap_trace_5F_file & inSource) {
  macroAssignObject (mPtr, inSource.mPtr) ;
  return * this ;
}

//---------------------------------------------------------------------------*

GALGASap_lstring GALGASap_trace_5F_file::readerCall_name (LOCATION_ARGS) const {
  GALGASap_lstring result ;
  if (isValid ()) {
    result = ptr (HERE)->reader_name (THERE) ;
  }
  return result ;
}

//---------------------------------------------------------------------------*

#ifndef DO_NOT_GENERATE_CHECKINGS
  GALGAS_trace_5F_file * GALGASap_trace_5F_file::ptr (LOCATION_ARGS) {
    macroValidObjectThere (mPtr, GALGAS_trace_5F_file) ;
    return (GALGAS_trace_5F_file *) mPtr ;
  }
#endif

//---------------------------------------------------------------------------*

#ifndef DO_NOT_GENERATE_CHECKINGS
  const GALGAS_trace_5F_file * GALGASap_trace_5F_file::ptr (LOCATION_ARGS) const {
    macroValidObjectThere (mPtr, const GALGAS_trace_5F_file) ;
    return (const GALGAS_trace_5F_file *) mPtr ;
  }
#endif

//---------------------------------------------------------------------------*

GALGASap_trace_5F_file::GALGASap_trace_5F_file (const GALGAS_trace_5F_file * inSourcePtr) :
GALGASap_trace_5F_method (inSourcePtr) {
}

//---------------------------------------------------------------------------*

GALGASap_trace_5F_file & GALGASap_trace_5F_file::operator = (GALGAS_trace_5F_file * inSourcePtr) {
  macroAssignObject (mPtr, inSourcePtr) ;
  return *this ;
}

//---------------------------------------------------------------------------*

enumComparisonResult GALGASap_trace_5F_file::objectCompare (const GALGASap_trace_5F_file & inOperand1,
                                                            const GALGASap_trace_5F_file & inOperand2) {
  enumComparisonResult result = GALGASap_trace_5F_method::objectCompare (inOperand1, inOperand2) ;
  if (kOperandEqual == result) {
    result = GALGASap_lstring::objectCompare (inOperand1.ptr (HERE)->mAttribute_name, inOperand2.ptr (HERE)->mAttribute_name) ;
  }
  return result ;
}


//---------------------------------------------------------------------------*

GALGAS_trace_5F_file::GALGAS_trace_5F_file (const GALGASap_location & constinAttribute_loc,
                                            const GALGASap_lstring & constinAttribute_name
                                            COMMA_LOCATION_ARGS) :
GALGAS_trace_5F_method (constinAttribute_loc COMMA_THERE),
mAttribute_name (constinAttribute_name) {
}

//---------------------------------------------------------------------------*

GALGASap_trace_5F_file GALGASap_trace_5F_file::constructor_new (GALGASap_location & inAttribute_loc,
                                                                GALGASap_lstring & inAttribute_name
                                                                COMMA_LOCATION_ARGS) {
  GALGAS_trace_5F_file * result = NULL ;
  if (inAttribute_loc.isValid () && inAttribute_name.isValid ()) {
    macroMyNew (result, GALGAS_trace_5F_file (inAttribute_loc, inAttribute_name COMMA_THERE)) ;
  }
  return result ;
}

//---------------------------------------------------------------------------*

void GALGAS_trace_5F_file::description (C_String & ioString,
                                        const PMSInt32 /* inIndentation */) const {
  ioString << "<class @"
           << typeDescriptor ()->mGalgasTypeName
           << ":" ;
//  mAttribute_name->description (ioString, inIndentation + 1) ;
  ioString << ">" ;
}

//---------------------------------------------------------------------------*

GALGAS_trace_5F_file::~GALGAS_trace_5F_file (void) {
}

//---------------------------------------------------------------------------*

void GALGASap_trace_5F_file::insulate (LOCATION_ARGS) {
  if (isValid () && (ptr (HERE)->retainCount () > 1)) {
    GALGASap_trace_5F_file p = constructor_new (ptr (HERE)->mAttribute_loc, ptr (HERE)->mAttribute_name COMMA_THERE) ;
    *this = p ;
  }
}

//---------------------------------------------------------------------------*

GALGASap_lstring GALGAS_trace_5F_file::reader_name (UNUSED_LOCATION_ARGS) const {
  return mAttribute_name ;
}

//---------------------------------------------------------------------------*

void GALGAS_trace_5F_file::modifier_setLoc (GALGASap_location inValue
                                            COMMA_UNUSED_LOCATION_ARGS) {
  mAttribute_loc = inValue ;
}

//---------------------------------------------------------------------------*

void GALGAS_trace_5F_file::modifier_setName (GALGASap_lstring inValue
                                             COMMA_UNUSED_LOCATION_ARGS) {
  mAttribute_name = inValue ;
}

//---------------------------------------------------------------------------*
//                                                                           *
//                          @trace_file class type                           *
//                                                                           *
//---------------------------------------------------------------------------*

const C_galgas_type_descriptor
kTypeDescriptor_GALGAS_trace_5F_file ("trace_file",
                                      & kTypeDescriptor_GALGAS_trace_5F_method) ;


//---------------------------------------------------------------------------*

const C_galgas_type_descriptor * GALGAS_trace_5F_file::typeDescriptor (void) const {
  return & kTypeDescriptor_GALGAS_trace_5F_file ;
}
//---------------------------------------------------------------------------*

void GALGASap_trace_5F_file::modifierCall_setLoc (GALGASap_location inArgument0
                                                  COMMA_LOCATION_ARGS) {
//--- Release 'output' arguments
//---
  if (isValid ()) {
    insulate (THERE) ;
    ptr (HERE)->modifier_setLoc (inArgument0 COMMA_THERE) ;
  }
}

//---------------------------------------------------------------------------*

void GALGASap_trace_5F_file::modifierCall_setName (GALGASap_lstring inArgument0
                                                   COMMA_LOCATION_ARGS) {
//--- Release 'output' arguments
//---
  if (isValid ()) {
    insulate (THERE) ;
    ptr (HERE)->modifier_setName (inArgument0 COMMA_THERE) ;
  }
}

//---------------------------------------------------------------------------*
//                                                                           *
//                           @trace auto ptr type                            *
//                                                                           *
//---------------------------------------------------------------------------*

GALGASap_trace::GALGASap_trace (const GALGASap_trace & inSource) :
GALGASap_class (inSource) {
}

//---------------------------------------------------------------------------*

GALGASap_trace::GALGASap_trace (const GALGASap_object & inSource) :
GALGASap_class (inSource) {
  macroNullOrValidObject (mPtr, GALGAS_trace) ;
}

//---------------------------------------------------------------------------*

GALGASap_trace & GALGASap_trace::operator = (const GALGASap_trace & inSource) {
  macroAssignObject (mPtr, inSource.mPtr) ;
  return * this ;
}

//---------------------------------------------------------------------------*

GALGASap_location GALGASap_trace::readerCall_loc (LOCATION_ARGS) const {
  GALGASap_location result ;
  if (isValid ()) {
    result = ptr (HERE)->reader_loc (THERE) ;
  }
  return result ;
}

//---------------------------------------------------------------------------*

#ifndef DO_NOT_GENERATE_CHECKINGS
  GALGAS_trace * GALGASap_trace::ptr (LOCATION_ARGS) {
    macroValidObjectThere (mPtr, GALGAS_trace) ;
    return (GALGAS_trace *) mPtr ;
  }
#endif

//---------------------------------------------------------------------------*

#ifndef DO_NOT_GENERATE_CHECKINGS
  const GALGAS_trace * GALGASap_trace::ptr (LOCATION_ARGS) const {
    macroValidObjectThere (mPtr, const GALGAS_trace) ;
    return (const GALGAS_trace *) mPtr ;
  }
#endif

//---------------------------------------------------------------------------*

GALGASap_trace::GALGASap_trace (const GALGAS_trace * inSourcePtr) :
GALGASap_class (inSourcePtr) {
}

//---------------------------------------------------------------------------*

GALGASap_trace & GALGASap_trace::operator = (GALGAS_trace * inSourcePtr) {
  macroAssignObject (mPtr, inSourcePtr) ;
  return *this ;
}

//---------------------------------------------------------------------------*

enumComparisonResult GALGASap_trace::objectCompare (const GALGASap_trace & inOperand1,
                                                    const GALGASap_trace & inOperand2) {
  enumComparisonResult result = (inOperand1.isValid () && inOperand2.isValid ()) ? kOperandEqual : kOperandNotValid ;
  if (kOperandEqual == result) {
    result = GALGASap_location::objectCompare (inOperand1.ptr (HERE)->mAttribute_loc, inOperand2.ptr (HERE)->mAttribute_loc) ;
  }
  return result ;
}


//---------------------------------------------------------------------------*

GALGAS_trace::GALGAS_trace (const GALGASap_location & constinAttribute_loc
                            COMMA_LOCATION_ARGS) :
GALGAS_class (THERE),
mAttribute_loc (constinAttribute_loc) {
}

//---------------------------------------------------------------------------*

GALGASap_trace GALGASap_trace::constructor_new (GALGASap_location & inAttribute_loc
                                                COMMA_LOCATION_ARGS) {
  GALGAS_trace * result = NULL ;
  if (inAttribute_loc.isValid ()) {
    macroMyNew (result, GALGAS_trace (inAttribute_loc COMMA_THERE)) ;
  }
  return result ;
}

//---------------------------------------------------------------------------*

void GALGAS_trace::description (C_String & ioString,
                                const PMSInt32 /* inIndentation */) const {
  ioString << "<class @"
           << typeDescriptor ()->mGalgasTypeName
           << ":" ;
//  mAttribute_loc->description (ioString, inIndentation + 1) ;
  ioString << ">" ;
}

//---------------------------------------------------------------------------*

GALGAS_trace::~GALGAS_trace (void) {
}

//---------------------------------------------------------------------------*

void GALGASap_trace::insulate (LOCATION_ARGS) {
  if (isValid () && (ptr (HERE)->retainCount () > 1)) {
    GALGASap_trace p = constructor_new (ptr (HERE)->mAttribute_loc COMMA_THERE) ;
    *this = p ;
  }
}

//---------------------------------------------------------------------------*

GALGASap_location GALGAS_trace::reader_loc (UNUSED_LOCATION_ARGS) const {
  return mAttribute_loc ;
}

//---------------------------------------------------------------------------*

void GALGAS_trace::modifier_setLoc (GALGASap_location inValue
                                    COMMA_UNUSED_LOCATION_ARGS) {
  mAttribute_loc = inValue ;
}

//---------------------------------------------------------------------------*
//                                                                           *
//                             @trace class type                             *
//                                                                           *
//---------------------------------------------------------------------------*

const C_galgas_type_descriptor
kTypeDescriptor_GALGAS_trace ("trace",
                              & kTypeDescriptor_GALGAS_class) ;


//---------------------------------------------------------------------------*

const C_galgas_type_descriptor * GALGAS_trace::typeDescriptor (void) const {
  return & kTypeDescriptor_GALGAS_trace ;
}
//---------------------------------------------------------------------------*

void GALGASap_trace::modifierCall_setLoc (GALGASap_location inArgument0
                                          COMMA_LOCATION_ARGS) {
//--- Release 'output' arguments
//---
  if (isValid ()) {
    insulate (THERE) ;
    ptr (HERE)->modifier_setLoc (inArgument0 COMMA_THERE) ;
  }
}

//---------------------------------------------------------------------------*
//                                                                           *
//                         @trace_off auto ptr type                          *
//                                                                           *
//---------------------------------------------------------------------------*

GALGASap_trace_5F_off::GALGASap_trace_5F_off (const GALGASap_trace_5F_off & inSource) :
GALGASap_trace (inSource) {
}

//---------------------------------------------------------------------------*

GALGASap_trace_5F_off::GALGASap_trace_5F_off (const GALGASap_object & inSource) :
GALGASap_trace (inSource) {
  macroNullOrValidObject (mPtr, GALGAS_trace_5F_off) ;
}

//---------------------------------------------------------------------------*

GALGASap_trace_5F_off & GALGASap_trace_5F_off::operator = (const GALGASap_trace_5F_off & inSource) {
  macroAssignObject (mPtr, inSource.mPtr) ;
  return * this ;
}

//---------------------------------------------------------------------------*

#ifndef DO_NOT_GENERATE_CHECKINGS
  GALGAS_trace_5F_off * GALGASap_trace_5F_off::ptr (LOCATION_ARGS) {
    macroValidObjectThere (mPtr, GALGAS_trace_5F_off) ;
    return (GALGAS_trace_5F_off *) mPtr ;
  }
#endif

//---------------------------------------------------------------------------*

#ifndef DO_NOT_GENERATE_CHECKINGS
  const GALGAS_trace_5F_off * GALGASap_trace_5F_off::ptr (LOCATION_ARGS) const {
    macroValidObjectThere (mPtr, const GALGAS_trace_5F_off) ;
    return (const GALGAS_trace_5F_off *) mPtr ;
  }
#endif

//---------------------------------------------------------------------------*

GALGASap_trace_5F_off::GALGASap_trace_5F_off (const GALGAS_trace_5F_off * inSourcePtr) :
GALGASap_trace (inSourcePtr) {
}

//---------------------------------------------------------------------------*

GALGASap_trace_5F_off & GALGASap_trace_5F_off::operator = (GALGAS_trace_5F_off * inSourcePtr) {
  macroAssignObject (mPtr, inSourcePtr) ;
  return *this ;
}

//---------------------------------------------------------------------------*

enumComparisonResult GALGASap_trace_5F_off::objectCompare (const GALGASap_trace_5F_off & inOperand1,
                                                           const GALGASap_trace_5F_off & inOperand2) {
  return (inOperand1.isValid () && inOperand2.isValid ()) ? kOperandEqual : kOperandNotValid ;
}


//---------------------------------------------------------------------------*

GALGAS_trace_5F_off::GALGAS_trace_5F_off (const GALGASap_location & constinAttribute_loc
                                          COMMA_LOCATION_ARGS) :
GALGAS_trace (constinAttribute_loc COMMA_THERE) {
}

//---------------------------------------------------------------------------*

GALGASap_trace_5F_off GALGASap_trace_5F_off::constructor_new (GALGASap_location & inAttribute_loc
                                                              COMMA_LOCATION_ARGS) {
  GALGAS_trace_5F_off * result = NULL ;
  if (inAttribute_loc.isValid ()) {
    macroMyNew (result, GALGAS_trace_5F_off (inAttribute_loc COMMA_THERE)) ;
  }
  return result ;
}

//---------------------------------------------------------------------------*

void GALGAS_trace_5F_off::description (C_String & ioString,
                                       const PMSInt32 /* inIndentation */) const {
  ioString << "<class @"
           << typeDescriptor ()->mGalgasTypeName
           << ":" ;
  ioString << ">" ;
}

//---------------------------------------------------------------------------*

GALGAS_trace_5F_off::~GALGAS_trace_5F_off (void) {
}

//---------------------------------------------------------------------------*

void GALGASap_trace_5F_off::insulate (LOCATION_ARGS) {
  if (isValid () && (ptr (HERE)->retainCount () > 1)) {
    GALGASap_trace_5F_off p = constructor_new (ptr (HERE)->mAttribute_loc COMMA_THERE) ;
    *this = p ;
  }
}

//---------------------------------------------------------------------------*

void GALGAS_trace_5F_off::modifier_setLoc (GALGASap_location inValue
                                           COMMA_UNUSED_LOCATION_ARGS) {
  mAttribute_loc = inValue ;
}

//---------------------------------------------------------------------------*
//                                                                           *
//                           @trace_off class type                           *
//                                                                           *
//---------------------------------------------------------------------------*

const C_galgas_type_descriptor
kTypeDescriptor_GALGAS_trace_5F_off ("trace_off",
                                     & kTypeDescriptor_GALGAS_trace) ;


//---------------------------------------------------------------------------*

const C_galgas_type_descriptor * GALGAS_trace_5F_off::typeDescriptor (void) const {
  return & kTypeDescriptor_GALGAS_trace_5F_off ;
}
//---------------------------------------------------------------------------*

void GALGASap_trace_5F_off::modifierCall_setLoc (GALGASap_location inArgument0
                                                 COMMA_LOCATION_ARGS) {
//--- Release 'output' arguments
//---
  if (isValid ()) {
    insulate (THERE) ;
    ptr (HERE)->modifier_setLoc (inArgument0 COMMA_THERE) ;
  }
}

//---------------------------------------------------------------------------*
//                                                                           *
//                          @trace_on auto ptr type                          *
//                                                                           *
//---------------------------------------------------------------------------*

GALGASap_trace_5F_on::GALGASap_trace_5F_on (const GALGASap_trace_5F_on & inSource) :
GALGASap_trace (inSource) {
}

//---------------------------------------------------------------------------*

GALGASap_trace_5F_on::GALGASap_trace_5F_on (const GALGASap_object & inSource) :
GALGASap_trace (inSource) {
  macroNullOrValidObject (mPtr, GALGAS_trace_5F_on) ;
}

//---------------------------------------------------------------------------*

GALGASap_trace_5F_on & GALGASap_trace_5F_on::operator = (const GALGASap_trace_5F_on & inSource) {
  macroAssignObject (mPtr, inSource.mPtr) ;
  return * this ;
}

//---------------------------------------------------------------------------*

GALGASap_basic_5F_type GALGASap_trace_5F_on::readerCall_desc (LOCATION_ARGS) const {
  GALGASap_basic_5F_type result ;
  if (isValid ()) {
    result = ptr (HERE)->reader_desc (THERE) ;
  }
  return result ;
}

//---------------------------------------------------------------------------*

GALGASap_lstring GALGASap_trace_5F_on::readerCall_form (LOCATION_ARGS) const {
  GALGASap_lstring result ;
  if (isValid ()) {
    result = ptr (HERE)->reader_form (THERE) ;
  }
  return result ;
}

//---------------------------------------------------------------------------*

GALGASap_trace_5F_method GALGASap_trace_5F_on::readerCall_meth (LOCATION_ARGS) const {
  GALGASap_trace_5F_method result ;
  if (isValid ()) {
    result = ptr (HERE)->reader_meth (THERE) ;
  }
  return result ;
}

//---------------------------------------------------------------------------*

GALGASap_basic_5F_type GALGASap_trace_5F_on::readerCall_trace_5F_alarm (LOCATION_ARGS) const {
  GALGASap_basic_5F_type result ;
  if (isValid ()) {
    result = ptr (HERE)->reader_trace_5F_alarm (THERE) ;
  }
  return result ;
}

//---------------------------------------------------------------------------*

GALGASap_basic_5F_type GALGASap_trace_5F_on::readerCall_trace_5F_isr (LOCATION_ARGS) const {
  GALGASap_basic_5F_type result ;
  if (isValid ()) {
    result = ptr (HERE)->reader_trace_5F_isr (THERE) ;
  }
  return result ;
}

//---------------------------------------------------------------------------*

GALGASap_basic_5F_type GALGASap_trace_5F_on::readerCall_trace_5F_resource (LOCATION_ARGS) const {
  GALGASap_basic_5F_type result ;
  if (isValid ()) {
    result = ptr (HERE)->reader_trace_5F_resource (THERE) ;
  }
  return result ;
}

//---------------------------------------------------------------------------*

GALGASap_basic_5F_type GALGASap_trace_5F_on::readerCall_trace_5F_task (LOCATION_ARGS) const {
  GALGASap_basic_5F_type result ;
  if (isValid ()) {
    result = ptr (HERE)->reader_trace_5F_task (THERE) ;
  }
  return result ;
}

//---------------------------------------------------------------------------*

GALGASap_basic_5F_type GALGASap_trace_5F_on::readerCall_trace_5F_user_5F_event (LOCATION_ARGS) const {
  GALGASap_basic_5F_type result ;
  if (isValid ()) {
    result = ptr (HERE)->reader_trace_5F_user_5F_event (THERE) ;
  }
  return result ;
}

//---------------------------------------------------------------------------*

#ifndef DO_NOT_GENERATE_CHECKINGS
  GALGAS_trace_5F_on * GALGASap_trace_5F_on::ptr (LOCATION_ARGS) {
    macroValidObjectThere (mPtr, GALGAS_trace_5F_on) ;
    return (GALGAS_trace_5F_on *) mPtr ;
  }
#endif

//---------------------------------------------------------------------------*

#ifndef DO_NOT_GENERATE_CHECKINGS
  const GALGAS_trace_5F_on * GALGASap_trace_5F_on::ptr (LOCATION_ARGS) const {
    macroValidObjectThere (mPtr, const GALGAS_trace_5F_on) ;
    return (const GALGAS_trace_5F_on *) mPtr ;
  }
#endif

//---------------------------------------------------------------------------*

GALGASap_trace_5F_on::GALGASap_trace_5F_on (const GALGAS_trace_5F_on * inSourcePtr) :
GALGASap_trace (inSourcePtr) {
}

//---------------------------------------------------------------------------*

GALGASap_trace_5F_on & GALGASap_trace_5F_on::operator = (GALGAS_trace_5F_on * inSourcePtr) {
  macroAssignObject (mPtr, inSourcePtr) ;
  return *this ;
}

//---------------------------------------------------------------------------*

enumComparisonResult GALGASap_trace_5F_on::objectCompare (const GALGASap_trace_5F_on & inOperand1,
                                                          const GALGASap_trace_5F_on & inOperand2) {
  enumComparisonResult result = GALGASap_trace::objectCompare (inOperand1, inOperand2) ;
  if (kOperandEqual == result) {
    result = GALGASap_lstring::objectCompare (inOperand1.ptr (HERE)->mAttribute_form, inOperand2.ptr (HERE)->mAttribute_form) ;
  }
  if (kOperandEqual == result) {
    result = GALGASap_trace_5F_method::objectCompare (inOperand1.ptr (HERE)->mAttribute_meth, inOperand2.ptr (HERE)->mAttribute_meth) ;
  }
  if (kOperandEqual == result) {
    result = GALGASap_basic_5F_type::objectCompare (inOperand1.ptr (HERE)->mAttribute_trace_5F_task, inOperand2.ptr (HERE)->mAttribute_trace_5F_task) ;
  }
  if (kOperandEqual == result) {
    result = GALGASap_basic_5F_type::objectCompare (inOperand1.ptr (HERE)->mAttribute_trace_5F_isr, inOperand2.ptr (HERE)->mAttribute_trace_5F_isr) ;
  }
  if (kOperandEqual == result) {
    result = GALGASap_basic_5F_type::objectCompare (inOperand1.ptr (HERE)->mAttribute_trace_5F_resource, inOperand2.ptr (HERE)->mAttribute_trace_5F_resource) ;
  }
  if (kOperandEqual == result) {
    result = GALGASap_basic_5F_type::objectCompare (inOperand1.ptr (HERE)->mAttribute_trace_5F_alarm, inOperand2.ptr (HERE)->mAttribute_trace_5F_alarm) ;
  }
  if (kOperandEqual == result) {
    result = GALGASap_basic_5F_type::objectCompare (inOperand1.ptr (HERE)->mAttribute_trace_5F_user_5F_event, inOperand2.ptr (HERE)->mAttribute_trace_5F_user_5F_event) ;
  }
  if (kOperandEqual == result) {
    result = GALGASap_basic_5F_type::objectCompare (inOperand1.ptr (HERE)->mAttribute_desc, inOperand2.ptr (HERE)->mAttribute_desc) ;
  }
  return result ;
}


//---------------------------------------------------------------------------*

GALGAS_trace_5F_on::GALGAS_trace_5F_on (const GALGASap_location & constinAttribute_loc,
                                        const GALGASap_lstring & constinAttribute_form,
                                        const GALGASap_trace_5F_method & constinAttribute_meth,
                                        const GALGASap_basic_5F_type & constinAttribute_trace_5F_task,
                                        const GALGASap_basic_5F_type & constinAttribute_trace_5F_isr,
                                        const GALGASap_basic_5F_type & constinAttribute_trace_5F_resource,
                                        const GALGASap_basic_5F_type & constinAttribute_trace_5F_alarm,
                                        const GALGASap_basic_5F_type & constinAttribute_trace_5F_user_5F_event,
                                        const GALGASap_basic_5F_type & constinAttribute_desc
                                        COMMA_LOCATION_ARGS) :
GALGAS_trace (constinAttribute_loc COMMA_THERE),
mAttribute_form (constinAttribute_form),
mAttribute_meth (constinAttribute_meth),
mAttribute_trace_5F_task (constinAttribute_trace_5F_task),
mAttribute_trace_5F_isr (constinAttribute_trace_5F_isr),
mAttribute_trace_5F_resource (constinAttribute_trace_5F_resource),
mAttribute_trace_5F_alarm (constinAttribute_trace_5F_alarm),
mAttribute_trace_5F_user_5F_event (constinAttribute_trace_5F_user_5F_event),
mAttribute_desc (constinAttribute_desc) {
}

//---------------------------------------------------------------------------*

GALGASap_trace_5F_on GALGASap_trace_5F_on::constructor_new (GALGASap_location & inAttribute_loc,
                                                            GALGASap_lstring & inAttribute_form,
                                                            GALGASap_trace_5F_method & inAttribute_meth,
                                                            GALGASap_basic_5F_type & inAttribute_trace_5F_task,
                                                            GALGASap_basic_5F_type & inAttribute_trace_5F_isr,
                                                            GALGASap_basic_5F_type & inAttribute_trace_5F_resource,
                                                            GALGASap_basic_5F_type & inAttribute_trace_5F_alarm,
                                                            GALGASap_basic_5F_type & inAttribute_trace_5F_user_5F_event,
                                                            GALGASap_basic_5F_type & inAttribute_desc
                                                            COMMA_LOCATION_ARGS) {
  GALGAS_trace_5F_on * result = NULL ;
  if (inAttribute_loc.isValid () && inAttribute_form.isValid () && inAttribute_meth.isValid () && inAttribute_trace_5F_task.isValid () && inAttribute_trace_5F_isr.isValid () && inAttribute_trace_5F_resource.isValid () && inAttribute_trace_5F_alarm.isValid () && inAttribute_trace_5F_user_5F_event.isValid () && inAttribute_desc.isValid ()) {
    macroMyNew (result, GALGAS_trace_5F_on (inAttribute_loc, inAttribute_form, inAttribute_meth, inAttribute_trace_5F_task, inAttribute_trace_5F_isr, inAttribute_trace_5F_resource, inAttribute_trace_5F_alarm, inAttribute_trace_5F_user_5F_event, inAttribute_desc COMMA_THERE)) ;
  }
  return result ;
}

//---------------------------------------------------------------------------*

void GALGAS_trace_5F_on::description (C_String & ioString,
                                      const PMSInt32 /* inIndentation */) const {
  ioString << "<class @"
           << typeDescriptor ()->mGalgasTypeName
           << ":" ;
//  mAttribute_form->description (ioString, inIndentation + 1) ;
  ioString << ", " ;
//  mAttribute_meth->description (ioString, inIndentation + 1) ;
  ioString << ", " ;
//  mAttribute_trace_5F_task->description (ioString, inIndentation + 1) ;
  ioString << ", " ;
//  mAttribute_trace_5F_isr->description (ioString, inIndentation + 1) ;
  ioString << ", " ;
//  mAttribute_trace_5F_resource->description (ioString, inIndentation + 1) ;
  ioString << ", " ;
//  mAttribute_trace_5F_alarm->description (ioString, inIndentation + 1) ;
  ioString << ", " ;
//  mAttribute_trace_5F_user_5F_event->description (ioString, inIndentation + 1) ;
  ioString << ", " ;
//  mAttribute_desc->description (ioString, inIndentation + 1) ;
  ioString << ">" ;
}

//---------------------------------------------------------------------------*

GALGAS_trace_5F_on::~GALGAS_trace_5F_on (void) {
}

//---------------------------------------------------------------------------*

void GALGASap_trace_5F_on::insulate (LOCATION_ARGS) {
  if (isValid () && (ptr (HERE)->retainCount () > 1)) {
    GALGASap_trace_5F_on p = constructor_new (ptr (HERE)->mAttribute_loc, ptr (HERE)->mAttribute_form, ptr (HERE)->mAttribute_meth, ptr (HERE)->mAttribute_trace_5F_task, ptr (HERE)->mAttribute_trace_5F_isr, ptr (HERE)->mAttribute_trace_5F_resource, ptr (HERE)->mAttribute_trace_5F_alarm, ptr (HERE)->mAttribute_trace_5F_user_5F_event, ptr (HERE)->mAttribute_desc COMMA_THERE) ;
    *this = p ;
  }
}

//---------------------------------------------------------------------------*

GALGASap_lstring GALGAS_trace_5F_on::reader_form (UNUSED_LOCATION_ARGS) const {
  return mAttribute_form ;
}

//---------------------------------------------------------------------------*

GALGASap_trace_5F_method GALGAS_trace_5F_on::reader_meth (UNUSED_LOCATION_ARGS) const {
  return mAttribute_meth ;
}

//---------------------------------------------------------------------------*

GALGASap_basic_5F_type GALGAS_trace_5F_on::reader_trace_5F_task (UNUSED_LOCATION_ARGS) const {
  return mAttribute_trace_5F_task ;
}

//---------------------------------------------------------------------------*

GALGASap_basic_5F_type GALGAS_trace_5F_on::reader_trace_5F_isr (UNUSED_LOCATION_ARGS) const {
  return mAttribute_trace_5F_isr ;
}

//---------------------------------------------------------------------------*

GALGASap_basic_5F_type GALGAS_trace_5F_on::reader_trace_5F_resource (UNUSED_LOCATION_ARGS) const {
  return mAttribute_trace_5F_resource ;
}

//---------------------------------------------------------------------------*

GALGASap_basic_5F_type GALGAS_trace_5F_on::reader_trace_5F_alarm (UNUSED_LOCATION_ARGS) const {
  return mAttribute_trace_5F_alarm ;
}

//---------------------------------------------------------------------------*

GALGASap_basic_5F_type GALGAS_trace_5F_on::reader_trace_5F_user_5F_event (UNUSED_LOCATION_ARGS) const {
  return mAttribute_trace_5F_user_5F_event ;
}

//---------------------------------------------------------------------------*

GALGASap_basic_5F_type GALGAS_trace_5F_on::reader_desc (UNUSED_LOCATION_ARGS) const {
  return mAttribute_desc ;
}

//---------------------------------------------------------------------------*

void GALGAS_trace_5F_on::modifier_setLoc (GALGASap_location inValue
                                          COMMA_UNUSED_LOCATION_ARGS) {
  mAttribute_loc = inValue ;
}

//---------------------------------------------------------------------------*

void GALGAS_trace_5F_on::modifier_setForm (GALGASap_lstring inValue
                                           COMMA_UNUSED_LOCATION_ARGS) {
  mAttribute_form = inValue ;
}

//---------------------------------------------------------------------------*

void GALGAS_trace_5F_on::modifier_setMeth (GALGASap_trace_5F_method inValue
                                           COMMA_UNUSED_LOCATION_ARGS) {
  mAttribute_meth = inValue ;
}

//---------------------------------------------------------------------------*

void GALGAS_trace_5F_on::modifier_setTrace_5F_task (GALGASap_basic_5F_type inValue
                                                    COMMA_UNUSED_LOCATION_ARGS) {
  mAttribute_trace_5F_task = inValue ;
}

//---------------------------------------------------------------------------*

void GALGAS_trace_5F_on::modifier_setTrace_5F_isr (GALGASap_basic_5F_type inValue
                                                   COMMA_UNUSED_LOCATION_ARGS) {
  mAttribute_trace_5F_isr = inValue ;
}

//---------------------------------------------------------------------------*

void GALGAS_trace_5F_on::modifier_setTrace_5F_resource (GALGASap_basic_5F_type inValue
                                                        COMMA_UNUSED_LOCATION_ARGS) {
  mAttribute_trace_5F_resource = inValue ;
}

//---------------------------------------------------------------------------*

void GALGAS_trace_5F_on::modifier_setTrace_5F_alarm (GALGASap_basic_5F_type inValue
                                                     COMMA_UNUSED_LOCATION_ARGS) {
  mAttribute_trace_5F_alarm = inValue ;
}

//---------------------------------------------------------------------------*

void GALGAS_trace_5F_on::modifier_setTrace_5F_user_5F_event (GALGASap_basic_5F_type inValue
                                                             COMMA_UNUSED_LOCATION_ARGS) {
  mAttribute_trace_5F_user_5F_event = inValue ;
}

//---------------------------------------------------------------------------*

void GALGAS_trace_5F_on::modifier_setDesc (GALGASap_basic_5F_type inValue
                                           COMMA_UNUSED_LOCATION_ARGS) {
  mAttribute_desc = inValue ;
}

//---------------------------------------------------------------------------*
//                                                                           *
//                           @trace_on class type                            *
//                                                                           *
//---------------------------------------------------------------------------*

const C_galgas_type_descriptor
kTypeDescriptor_GALGAS_trace_5F_on ("trace_on",
                                    & kTypeDescriptor_GALGAS_trace) ;


//---------------------------------------------------------------------------*

const C_galgas_type_descriptor * GALGAS_trace_5F_on::typeDescriptor (void) const {
  return & kTypeDescriptor_GALGAS_trace_5F_on ;
}
//---------------------------------------------------------------------------*

void GALGASap_trace_5F_on::modifierCall_setDesc (GALGASap_basic_5F_type inArgument0
                                                 COMMA_LOCATION_ARGS) {
//--- Release 'output' arguments
//---
  if (isValid ()) {
    insulate (THERE) ;
    ptr (HERE)->modifier_setDesc (inArgument0 COMMA_THERE) ;
  }
}

//---------------------------------------------------------------------------*

void GALGASap_trace_5F_on::modifierCall_setForm (GALGASap_lstring inArgument0
                                                 COMMA_LOCATION_ARGS) {
//--- Release 'output' arguments
//---
  if (isValid ()) {
    insulate (THERE) ;
    ptr (HERE)->modifier_setForm (inArgument0 COMMA_THERE) ;
  }
}

//---------------------------------------------------------------------------*

void GALGASap_trace_5F_on::modifierCall_setLoc (GALGASap_location inArgument0
                                                COMMA_LOCATION_ARGS) {
//--- Release 'output' arguments
//---
  if (isValid ()) {
    insulate (THERE) ;
    ptr (HERE)->modifier_setLoc (inArgument0 COMMA_THERE) ;
  }
}

//---------------------------------------------------------------------------*

void GALGASap_trace_5F_on::modifierCall_setMeth (GALGASap_trace_5F_method inArgument0
                                                 COMMA_LOCATION_ARGS) {
//--- Release 'output' arguments
//---
  if (isValid ()) {
    insulate (THERE) ;
    ptr (HERE)->modifier_setMeth (inArgument0 COMMA_THERE) ;
  }
}

//---------------------------------------------------------------------------*

void GALGASap_trace_5F_on::modifierCall_setTrace_5F_alarm (GALGASap_basic_5F_type inArgument0
                                                           COMMA_LOCATION_ARGS) {
//--- Release 'output' arguments
//---
  if (isValid ()) {
    insulate (THERE) ;
    ptr (HERE)->modifier_setTrace_5F_alarm (inArgument0 COMMA_THERE) ;
  }
}

//---------------------------------------------------------------------------*

void GALGASap_trace_5F_on::modifierCall_setTrace_5F_isr (GALGASap_basic_5F_type inArgument0
                                                         COMMA_LOCATION_ARGS) {
//--- Release 'output' arguments
//---
  if (isValid ()) {
    insulate (THERE) ;
    ptr (HERE)->modifier_setTrace_5F_isr (inArgument0 COMMA_THERE) ;
  }
}

//---------------------------------------------------------------------------*

void GALGASap_trace_5F_on::modifierCall_setTrace_5F_resource (GALGASap_basic_5F_type inArgument0
                                                              COMMA_LOCATION_ARGS) {
//--- Release 'output' arguments
//---
  if (isValid ()) {
    insulate (THERE) ;
    ptr (HERE)->modifier_setTrace_5F_resource (inArgument0 COMMA_THERE) ;
  }
}

//---------------------------------------------------------------------------*

void GALGASap_trace_5F_on::modifierCall_setTrace_5F_task (GALGASap_basic_5F_type inArgument0
                                                          COMMA_LOCATION_ARGS) {
//--- Release 'output' arguments
//---
  if (isValid ()) {
    insulate (THERE) ;
    ptr (HERE)->modifier_setTrace_5F_task (inArgument0 COMMA_THERE) ;
  }
}

//---------------------------------------------------------------------------*

void GALGASap_trace_5F_on::modifierCall_setTrace_5F_user_5F_event (GALGASap_basic_5F_type inArgument0
                                                                   COMMA_LOCATION_ARGS) {
//--- Release 'output' arguments
//---
  if (isValid ()) {
    insulate (THERE) ;
    ptr (HERE)->modifier_setTrace_5F_user_5F_event (inArgument0 COMMA_THERE) ;
  }
}

//---------------------------------------------------------------------------*
//                                                                           *
//                           Routine 'set_method'                            *
//                                                                           *
//---------------------------------------------------------------------------*

void routine_set_5F_method (GALGASap_trace_5F_method & ioArgument_t,
                            GALGASap_trace_5F_method inArgument_s,
                            GALGASap_string inArgument_att,
                            C_Compiler * inCompiler
                            COMMA_UNUSED_LOCATION_ARGS) {
  //-------- @structuredCastInstructionForGeneration
  if (ioArgument_t.isValid ()) {
    if (ioArgument_t.ptr (HERE)->typeDescriptor () == & kTypeDescriptor_GALGAS_trace_5F_void) {
      //-------- @assignmentInstructionForGeneration
      ioArgument_t = inArgument_s ;
    }else{
      //-------- @errorInstructionForGeneration
      //--- @readerCallExpressionForGeneration
      GALGASap_location temp_0 (inArgument_s.readerCall_loc (SOURCE_FILE_AT_LINE (115))) ;
      //--- @concatExpressionForGeneration
      //--- @literalStringExpressionForGeneration
      GALGASap_string temp_1 ("Redefinition of " COMMA_SOURCE_FILE_AT_LINE (115)) ;
      GALGASap_string temp_2 (temp_1.operator_concat (inArgument_att COMMA_SOURCE_FILE_AT_LINE (115))) ;
      inCompiler->emitSemanticError (temp_0, temp_2 COMMA_SOURCE_FILE_AT_LINE (115)) ;
      //-------- @errorInstructionForGeneration
      //--- @readerCallExpressionForGeneration
      GALGASap_location temp_3 (ioArgument_t.readerCall_loc (SOURCE_FILE_AT_LINE (116))) ;
      //--- @literalStringExpressionForGeneration
      GALGASap_string temp_4 ("was defined here" COMMA_SOURCE_FILE_AT_LINE (116)) ;
      inCompiler->emitSemanticError (temp_3, temp_4 COMMA_SOURCE_FILE_AT_LINE (116)) ;
    }
  }
}

//---------------------------------------------------------------------------*
//                                                                           *
//                         @no_linker auto ptr type                          *
//                                                                           *
//---------------------------------------------------------------------------*

GALGASap_no_5F_linker::GALGASap_no_5F_linker (const GALGASap_no_5F_linker & inSource) :
GALGASap_basic_5F_type (inSource) {
}

//---------------------------------------------------------------------------*

GALGASap_no_5F_linker::GALGASap_no_5F_linker (const GALGASap_object & inSource) :
GALGASap_basic_5F_type (inSource) {
  macroNullOrValidObject (mPtr, GALGAS_no_5F_linker) ;
}

//---------------------------------------------------------------------------*

GALGASap_no_5F_linker & GALGASap_no_5F_linker::operator = (const GALGASap_no_5F_linker & inSource) {
  macroAssignObject (mPtr, inSource.mPtr) ;
  return * this ;
}

//---------------------------------------------------------------------------*

#ifndef DO_NOT_GENERATE_CHECKINGS
  GALGAS_no_5F_linker * GALGASap_no_5F_linker::ptr (LOCATION_ARGS) {
    macroValidObjectThere (mPtr, GALGAS_no_5F_linker) ;
    return (GALGAS_no_5F_linker *) mPtr ;
  }
#endif

//---------------------------------------------------------------------------*

#ifndef DO_NOT_GENERATE_CHECKINGS
  const GALGAS_no_5F_linker * GALGASap_no_5F_linker::ptr (LOCATION_ARGS) const {
    macroValidObjectThere (mPtr, const GALGAS_no_5F_linker) ;
    return (const GALGAS_no_5F_linker *) mPtr ;
  }
#endif

//---------------------------------------------------------------------------*

GALGASap_no_5F_linker::GALGASap_no_5F_linker (const GALGAS_no_5F_linker * inSourcePtr) :
GALGASap_basic_5F_type (inSourcePtr) {
}

//---------------------------------------------------------------------------*

GALGASap_no_5F_linker & GALGASap_no_5F_linker::operator = (GALGAS_no_5F_linker * inSourcePtr) {
  macroAssignObject (mPtr, inSourcePtr) ;
  return *this ;
}

//---------------------------------------------------------------------------*

enumComparisonResult GALGASap_no_5F_linker::objectCompare (const GALGASap_no_5F_linker & inOperand1,
                                                           const GALGASap_no_5F_linker & inOperand2) {
  return (inOperand1.isValid () && inOperand2.isValid ()) ? kOperandEqual : kOperandNotValid ;
}


//---------------------------------------------------------------------------*

GALGAS_no_5F_linker::GALGAS_no_5F_linker (const GALGASap_location & constinAttribute_location
                                          COMMA_LOCATION_ARGS) :
GALGAS_basic_5F_type (constinAttribute_location COMMA_THERE) {
}

//---------------------------------------------------------------------------*

GALGASap_no_5F_linker GALGASap_no_5F_linker::constructor_new (GALGASap_location & inAttribute_location
                                                              COMMA_LOCATION_ARGS) {
  GALGAS_no_5F_linker * result = NULL ;
  if (inAttribute_location.isValid ()) {
    macroMyNew (result, GALGAS_no_5F_linker (inAttribute_location COMMA_THERE)) ;
  }
  return result ;
}

//---------------------------------------------------------------------------*

void GALGAS_no_5F_linker::description (C_String & ioString,
                                       const PMSInt32 /* inIndentation */) const {
  ioString << "<class @"
           << typeDescriptor ()->mGalgasTypeName
           << ":" ;
  ioString << ">" ;
}

//---------------------------------------------------------------------------*

GALGAS_no_5F_linker::~GALGAS_no_5F_linker (void) {
}

//---------------------------------------------------------------------------*

void GALGASap_no_5F_linker::insulate (LOCATION_ARGS) {
  if (isValid () && (ptr (HERE)->retainCount () > 1)) {
    GALGASap_no_5F_linker p = constructor_new (ptr (HERE)->mAttribute_location COMMA_THERE) ;
    *this = p ;
  }
}

//---------------------------------------------------------------------------*

void GALGAS_no_5F_linker::modifier_setLocation (GALGASap_location inValue
                                                COMMA_UNUSED_LOCATION_ARGS) {
  mAttribute_location = inValue ;
}

//---------------------------------------------------------------------------*
//                                                                           *
//                           @no_linker class type                           *
//                                                                           *
//---------------------------------------------------------------------------*

const C_galgas_type_descriptor
kTypeDescriptor_GALGAS_no_5F_linker ("no_linker",
                                     & kTypeDescriptor_GALGAS_basic_5F_type) ;


//---------------------------------------------------------------------------*

const C_galgas_type_descriptor * GALGAS_no_5F_linker::typeDescriptor (void) const {
  return & kTypeDescriptor_GALGAS_no_5F_linker ;
}
//---------------------------------------------------------------------------*

void GALGASap_no_5F_linker::modifierCall_setLocation (GALGASap_location inArgument0
                                                      COMMA_LOCATION_ARGS) {
//--- Release 'output' arguments
//---
  if (isValid ()) {
    insulate (THERE) ;
    ptr (HERE)->modifier_setLocation (inArgument0 COMMA_THERE) ;
  }
}

//---------------------------------------------------------------------------*
//                                                                           *
//                         @yes_linker auto ptr type                         *
//                                                                           *
//---------------------------------------------------------------------------*

GALGASap_yes_5F_linker::GALGASap_yes_5F_linker (const GALGASap_yes_5F_linker & inSource) :
GALGASap_basic_5F_type (inSource) {
}

//---------------------------------------------------------------------------*

GALGASap_yes_5F_linker::GALGASap_yes_5F_linker (const GALGASap_object & inSource) :
GALGASap_basic_5F_type (inSource) {
  macroNullOrValidObject (mPtr, GALGAS_yes_5F_linker) ;
}

//---------------------------------------------------------------------------*

GALGASap_yes_5F_linker & GALGASap_yes_5F_linker::operator = (const GALGASap_yes_5F_linker & inSource) {
  macroAssignObject (mPtr, inSource.mPtr) ;
  return * this ;
}

//---------------------------------------------------------------------------*

GALGASap_lstring GALGASap_yes_5F_linker::readerCall_linker (LOCATION_ARGS) const {
  GALGASap_lstring result ;
  if (isValid ()) {
    result = ptr (HERE)->reader_linker (THERE) ;
  }
  return result ;
}

//---------------------------------------------------------------------------*

GALGASap_lstring GALGASap_yes_5F_linker::readerCall_script (LOCATION_ARGS) const {
  GALGASap_lstring result ;
  if (isValid ()) {
    result = ptr (HERE)->reader_script (THERE) ;
  }
  return result ;
}

//---------------------------------------------------------------------------*

#ifndef DO_NOT_GENERATE_CHECKINGS
  GALGAS_yes_5F_linker * GALGASap_yes_5F_linker::ptr (LOCATION_ARGS) {
    macroValidObjectThere (mPtr, GALGAS_yes_5F_linker) ;
    return (GALGAS_yes_5F_linker *) mPtr ;
  }
#endif

//---------------------------------------------------------------------------*

#ifndef DO_NOT_GENERATE_CHECKINGS
  const GALGAS_yes_5F_linker * GALGASap_yes_5F_linker::ptr (LOCATION_ARGS) const {
    macroValidObjectThere (mPtr, const GALGAS_yes_5F_linker) ;
    return (const GALGAS_yes_5F_linker *) mPtr ;
  }
#endif

//---------------------------------------------------------------------------*

GALGASap_yes_5F_linker::GALGASap_yes_5F_linker (const GALGAS_yes_5F_linker * inSourcePtr) :
GALGASap_basic_5F_type (inSourcePtr) {
}

//---------------------------------------------------------------------------*

GALGASap_yes_5F_linker & GALGASap_yes_5F_linker::operator = (GALGAS_yes_5F_linker * inSourcePtr) {
  macroAssignObject (mPtr, inSourcePtr) ;
  return *this ;
}

//---------------------------------------------------------------------------*

enumComparisonResult GALGASap_yes_5F_linker::objectCompare (const GALGASap_yes_5F_linker & inOperand1,
                                                            const GALGASap_yes_5F_linker & inOperand2) {
  enumComparisonResult result = GALGASap_basic_5F_type::objectCompare (inOperand1, inOperand2) ;
  if (kOperandEqual == result) {
    result = GALGASap_lstring::objectCompare (inOperand1.ptr (HERE)->mAttribute_linker, inOperand2.ptr (HERE)->mAttribute_linker) ;
  }
  if (kOperandEqual == result) {
    result = GALGASap_lstring::objectCompare (inOperand1.ptr (HERE)->mAttribute_script, inOperand2.ptr (HERE)->mAttribute_script) ;
  }
  return result ;
}


//---------------------------------------------------------------------------*

GALGAS_yes_5F_linker::GALGAS_yes_5F_linker (const GALGASap_location & constinAttribute_location,
                                            const GALGASap_lstring & constinAttribute_linker,
                                            const GALGASap_lstring & constinAttribute_script
                                            COMMA_LOCATION_ARGS) :
GALGAS_basic_5F_type (constinAttribute_location COMMA_THERE),
mAttribute_linker (constinAttribute_linker),
mAttribute_script (constinAttribute_script) {
}

//---------------------------------------------------------------------------*

GALGASap_yes_5F_linker GALGASap_yes_5F_linker::constructor_new (GALGASap_location & inAttribute_location,
                                                                GALGASap_lstring & inAttribute_linker,
                                                                GALGASap_lstring & inAttribute_script
                                                                COMMA_LOCATION_ARGS) {
  GALGAS_yes_5F_linker * result = NULL ;
  if (inAttribute_location.isValid () && inAttribute_linker.isValid () && inAttribute_script.isValid ()) {
    macroMyNew (result, GALGAS_yes_5F_linker (inAttribute_location, inAttribute_linker, inAttribute_script COMMA_THERE)) ;
  }
  return result ;
}

//---------------------------------------------------------------------------*

void GALGAS_yes_5F_linker::description (C_String & ioString,
                                        const PMSInt32 /* inIndentation */) const {
  ioString << "<class @"
           << typeDescriptor ()->mGalgasTypeName
           << ":" ;
//  mAttribute_linker->description (ioString, inIndentation + 1) ;
  ioString << ", " ;
//  mAttribute_script->description (ioString, inIndentation + 1) ;
  ioString << ">" ;
}

//---------------------------------------------------------------------------*

GALGAS_yes_5F_linker::~GALGAS_yes_5F_linker (void) {
}

//---------------------------------------------------------------------------*

void GALGASap_yes_5F_linker::insulate (LOCATION_ARGS) {
  if (isValid () && (ptr (HERE)->retainCount () > 1)) {
    GALGASap_yes_5F_linker p = constructor_new (ptr (HERE)->mAttribute_location, ptr (HERE)->mAttribute_linker, ptr (HERE)->mAttribute_script COMMA_THERE) ;
    *this = p ;
  }
}

//---------------------------------------------------------------------------*

GALGASap_lstring GALGAS_yes_5F_linker::reader_linker (UNUSED_LOCATION_ARGS) const {
  return mAttribute_linker ;
}

//---------------------------------------------------------------------------*

GALGASap_lstring GALGAS_yes_5F_linker::reader_script (UNUSED_LOCATION_ARGS) const {
  return mAttribute_script ;
}

//---------------------------------------------------------------------------*

void GALGAS_yes_5F_linker::modifier_setLocation (GALGASap_location inValue
                                                 COMMA_UNUSED_LOCATION_ARGS) {
  mAttribute_location = inValue ;
}

//---------------------------------------------------------------------------*

void GALGAS_yes_5F_linker::modifier_setLinker (GALGASap_lstring inValue
                                               COMMA_UNUSED_LOCATION_ARGS) {
  mAttribute_linker = inValue ;
}

//---------------------------------------------------------------------------*

void GALGAS_yes_5F_linker::modifier_setScript (GALGASap_lstring inValue
                                               COMMA_UNUSED_LOCATION_ARGS) {
  mAttribute_script = inValue ;
}

//---------------------------------------------------------------------------*
//                                                                           *
//                          @yes_linker class type                           *
//                                                                           *
//---------------------------------------------------------------------------*

const C_galgas_type_descriptor
kTypeDescriptor_GALGAS_yes_5F_linker ("yes_linker",
                                      & kTypeDescriptor_GALGAS_basic_5F_type) ;


//---------------------------------------------------------------------------*

const C_galgas_type_descriptor * GALGAS_yes_5F_linker::typeDescriptor (void) const {
  return & kTypeDescriptor_GALGAS_yes_5F_linker ;
}
//---------------------------------------------------------------------------*

void GALGASap_yes_5F_linker::modifierCall_setLinker (GALGASap_lstring inArgument0
                                                     COMMA_LOCATION_ARGS) {
//--- Release 'output' arguments
//---
  if (isValid ()) {
    insulate (THERE) ;
    ptr (HERE)->modifier_setLinker (inArgument0 COMMA_THERE) ;
  }
}

//---------------------------------------------------------------------------*

void GALGASap_yes_5F_linker::modifierCall_setLocation (GALGASap_location inArgument0
                                                       COMMA_LOCATION_ARGS) {
//--- Release 'output' arguments
//---
  if (isValid ()) {
    insulate (THERE) ;
    ptr (HERE)->modifier_setLocation (inArgument0 COMMA_THERE) ;
  }
}

//---------------------------------------------------------------------------*

void GALGASap_yes_5F_linker::modifierCall_setScript (GALGASap_lstring inArgument0
                                                     COMMA_LOCATION_ARGS) {
//--- Release 'output' arguments
//---
  if (isValid ()) {
    insulate (THERE) ;
    ptr (HERE)->modifier_setScript (inArgument0 COMMA_THERE) ;
  }
}

//---------------------------------------------------------------------------*
//                                                                           *
//                           Routine 'set_linker'                            *
//                                                                           *
//---------------------------------------------------------------------------*

void routine_set_5F_linker (GALGASap_basic_5F_type & ioArgument_l,
                            GALGASap_basic_5F_type inArgument_nl,
                            GALGASap_string inArgument_att,
                            C_Compiler * inCompiler
                            COMMA_UNUSED_LOCATION_ARGS) {
  //-------- @structuredCastInstructionForGeneration
  if (ioArgument_l.isValid ()) {
    if (ioArgument_l.ptr (HERE)->typeDescriptor () == & kTypeDescriptor_GALGAS_void) {
      //-------- @assignmentInstructionForGeneration
      ioArgument_l = inArgument_nl ;
    }else{
      //-------- @errorInstructionForGeneration
      //--- @readerCallExpressionForGeneration
      GALGASap_location temp_0 (inArgument_nl.readerCall_location (SOURCE_FILE_AT_LINE (136))) ;
      //--- @concatExpressionForGeneration
      //--- @literalStringExpressionForGeneration
      GALGASap_string temp_1 ("Redefinition of " COMMA_SOURCE_FILE_AT_LINE (136)) ;
      GALGASap_string temp_2 (temp_1.operator_concat (inArgument_att COMMA_SOURCE_FILE_AT_LINE (136))) ;
      inCompiler->emitSemanticError (temp_0, temp_2 COMMA_SOURCE_FILE_AT_LINE (136)) ;
      //-------- @errorInstructionForGeneration
      //--- @readerCallExpressionForGeneration
      GALGASap_location temp_3 (ioArgument_l.readerCall_location (SOURCE_FILE_AT_LINE (137))) ;
      //--- @literalStringExpressionForGeneration
      GALGASap_string temp_4 ("was defined here" COMMA_SOURCE_FILE_AT_LINE (137)) ;
      inCompiler->emitSemanticError (temp_3, temp_4 COMMA_SOURCE_FILE_AT_LINE (137)) ;
    }
  }
}

//---------------------------------------------------------------------------*
//                                                                           *
//                        @memmap_false auto ptr type                        *
//                                                                           *
//---------------------------------------------------------------------------*

GALGASap_memmap_5F_false::GALGASap_memmap_5F_false (const GALGASap_memmap_5F_false & inSource) :
GALGASap_basic_5F_type (inSource) {
}

//---------------------------------------------------------------------------*

GALGASap_memmap_5F_false::GALGASap_memmap_5F_false (const GALGASap_object & inSource) :
GALGASap_basic_5F_type (inSource) {
  macroNullOrValidObject (mPtr, GALGAS_memmap_5F_false) ;
}

//---------------------------------------------------------------------------*

GALGASap_memmap_5F_false & GALGASap_memmap_5F_false::operator = (const GALGASap_memmap_5F_false & inSource) {
  macroAssignObject (mPtr, inSource.mPtr) ;
  return * this ;
}

//---------------------------------------------------------------------------*

#ifndef DO_NOT_GENERATE_CHECKINGS
  GALGAS_memmap_5F_false * GALGASap_memmap_5F_false::ptr (LOCATION_ARGS) {
    macroValidObjectThere (mPtr, GALGAS_memmap_5F_false) ;
    return (GALGAS_memmap_5F_false *) mPtr ;
  }
#endif

//---------------------------------------------------------------------------*

#ifndef DO_NOT_GENERATE_CHECKINGS
  const GALGAS_memmap_5F_false * GALGASap_memmap_5F_false::ptr (LOCATION_ARGS) const {
    macroValidObjectThere (mPtr, const GALGAS_memmap_5F_false) ;
    return (const GALGAS_memmap_5F_false *) mPtr ;
  }
#endif

//---------------------------------------------------------------------------*

GALGASap_memmap_5F_false::GALGASap_memmap_5F_false (const GALGAS_memmap_5F_false * inSourcePtr) :
GALGASap_basic_5F_type (inSourcePtr) {
}

//---------------------------------------------------------------------------*

GALGASap_memmap_5F_false & GALGASap_memmap_5F_false::operator = (GALGAS_memmap_5F_false * inSourcePtr) {
  macroAssignObject (mPtr, inSourcePtr) ;
  return *this ;
}

//---------------------------------------------------------------------------*

enumComparisonResult GALGASap_memmap_5F_false::objectCompare (const GALGASap_memmap_5F_false & inOperand1,
                                                              const GALGASap_memmap_5F_false & inOperand2) {
  return (inOperand1.isValid () && inOperand2.isValid ()) ? kOperandEqual : kOperandNotValid ;
}


//---------------------------------------------------------------------------*

GALGAS_memmap_5F_false::GALGAS_memmap_5F_false (const GALGASap_location & constinAttribute_location
                                                COMMA_LOCATION_ARGS) :
GALGAS_basic_5F_type (constinAttribute_location COMMA_THERE) {
}

//---------------------------------------------------------------------------*

GALGASap_memmap_5F_false GALGASap_memmap_5F_false::constructor_new (GALGASap_location & inAttribute_location
                                                                    COMMA_LOCATION_ARGS) {
  GALGAS_memmap_5F_false * result = NULL ;
  if (inAttribute_location.isValid ()) {
    macroMyNew (result, GALGAS_memmap_5F_false (inAttribute_location COMMA_THERE)) ;
  }
  return result ;
}

//---------------------------------------------------------------------------*

void GALGAS_memmap_5F_false::description (C_String & ioString,
                                          const PMSInt32 /* inIndentation */) const {
  ioString << "<class @"
           << typeDescriptor ()->mGalgasTypeName
           << ":" ;
  ioString << ">" ;
}

//---------------------------------------------------------------------------*

GALGAS_memmap_5F_false::~GALGAS_memmap_5F_false (void) {
}

//---------------------------------------------------------------------------*

void GALGASap_memmap_5F_false::insulate (LOCATION_ARGS) {
  if (isValid () && (ptr (HERE)->retainCount () > 1)) {
    GALGASap_memmap_5F_false p = constructor_new (ptr (HERE)->mAttribute_location COMMA_THERE) ;
    *this = p ;
  }
}

//---------------------------------------------------------------------------*

void GALGAS_memmap_5F_false::modifier_setLocation (GALGASap_location inValue
                                                   COMMA_UNUSED_LOCATION_ARGS) {
  mAttribute_location = inValue ;
}

//---------------------------------------------------------------------------*
//                                                                           *
//                         @memmap_false class type                          *
//                                                                           *
//---------------------------------------------------------------------------*

const C_galgas_type_descriptor
kTypeDescriptor_GALGAS_memmap_5F_false ("memmap_false",
                                        & kTypeDescriptor_GALGAS_basic_5F_type) ;


//---------------------------------------------------------------------------*

const C_galgas_type_descriptor * GALGAS_memmap_5F_false::typeDescriptor (void) const {
  return & kTypeDescriptor_GALGAS_memmap_5F_false ;
}
//---------------------------------------------------------------------------*

void GALGASap_memmap_5F_false::modifierCall_setLocation (GALGASap_location inArgument0
                                                         COMMA_LOCATION_ARGS) {
//--- Release 'output' arguments
//---
  if (isValid ()) {
    insulate (THERE) ;
    ptr (HERE)->modifier_setLocation (inArgument0 COMMA_THERE) ;
  }
}

//---------------------------------------------------------------------------*
//                                                                           *
//                        @memmap_true auto ptr type                         *
//                                                                           *
//---------------------------------------------------------------------------*

GALGASap_memmap_5F_true::GALGASap_memmap_5F_true (const GALGASap_memmap_5F_true & inSource) :
GALGASap_basic_5F_type (inSource) {
}

//---------------------------------------------------------------------------*

GALGASap_memmap_5F_true::GALGASap_memmap_5F_true (const GALGASap_object & inSource) :
GALGASap_basic_5F_type (inSource) {
  macroNullOrValidObject (mPtr, GALGAS_memmap_5F_true) ;
}

//---------------------------------------------------------------------------*

GALGASap_memmap_5F_true & GALGASap_memmap_5F_true::operator = (const GALGASap_memmap_5F_true & inSource) {
  macroAssignObject (mPtr, inSource.mPtr) ;
  return * this ;
}

//---------------------------------------------------------------------------*

GALGASap_lstring GALGASap_memmap_5F_true::readerCall_assembler (LOCATION_ARGS) const {
  GALGASap_lstring result ;
  if (isValid ()) {
    result = ptr (HERE)->reader_assembler (THERE) ;
  }
  return result ;
}

//---------------------------------------------------------------------------*

GALGASap_lstring GALGASap_memmap_5F_true::readerCall_compiler (LOCATION_ARGS) const {
  GALGASap_lstring result ;
  if (isValid ()) {
    result = ptr (HERE)->reader_compiler (THERE) ;
  }
  return result ;
}

//---------------------------------------------------------------------------*

GALGASap_basic_5F_type GALGASap_memmap_5F_true::readerCall_linker (LOCATION_ARGS) const {
  GALGASap_basic_5F_type result ;
  if (isValid ()) {
    result = ptr (HERE)->reader_linker (THERE) ;
  }
  return result ;
}

//---------------------------------------------------------------------------*

GALGASap_basic_5F_type GALGASap_memmap_5F_true::readerCall_memory_5F_prot (LOCATION_ARGS) const {
  GALGASap_basic_5F_type result ;
  if (isValid ()) {
    result = ptr (HERE)->reader_memory_5F_prot (THERE) ;
  }
  return result ;
}

//---------------------------------------------------------------------------*

#ifndef DO_NOT_GENERATE_CHECKINGS
  GALGAS_memmap_5F_true * GALGASap_memmap_5F_true::ptr (LOCATION_ARGS) {
    macroValidObjectThere (mPtr, GALGAS_memmap_5F_true) ;
    return (GALGAS_memmap_5F_true *) mPtr ;
  }
#endif

//---------------------------------------------------------------------------*

#ifndef DO_NOT_GENERATE_CHECKINGS
  const GALGAS_memmap_5F_true * GALGASap_memmap_5F_true::ptr (LOCATION_ARGS) const {
    macroValidObjectThere (mPtr, const GALGAS_memmap_5F_true) ;
    return (const GALGAS_memmap_5F_true *) mPtr ;
  }
#endif

//---------------------------------------------------------------------------*

GALGASap_memmap_5F_true::GALGASap_memmap_5F_true (const GALGAS_memmap_5F_true * inSourcePtr) :
GALGASap_basic_5F_type (inSourcePtr) {
}

//---------------------------------------------------------------------------*

GALGASap_memmap_5F_true & GALGASap_memmap_5F_true::operator = (GALGAS_memmap_5F_true * inSourcePtr) {
  macroAssignObject (mPtr, inSourcePtr) ;
  return *this ;
}

//---------------------------------------------------------------------------*

enumComparisonResult GALGASap_memmap_5F_true::objectCompare (const GALGASap_memmap_5F_true & inOperand1,
                                                             const GALGASap_memmap_5F_true & inOperand2) {
  enumComparisonResult result = GALGASap_basic_5F_type::objectCompare (inOperand1, inOperand2) ;
  if (kOperandEqual == result) {
    result = GALGASap_lstring::objectCompare (inOperand1.ptr (HERE)->mAttribute_compiler, inOperand2.ptr (HERE)->mAttribute_compiler) ;
  }
  if (kOperandEqual == result) {
    result = GALGASap_lstring::objectCompare (inOperand1.ptr (HERE)->mAttribute_assembler, inOperand2.ptr (HERE)->mAttribute_assembler) ;
  }
  if (kOperandEqual == result) {
    result = GALGASap_basic_5F_type::objectCompare (inOperand1.ptr (HERE)->mAttribute_linker, inOperand2.ptr (HERE)->mAttribute_linker) ;
  }
  if (kOperandEqual == result) {
    result = GALGASap_basic_5F_type::objectCompare (inOperand1.ptr (HERE)->mAttribute_memory_5F_prot, inOperand2.ptr (HERE)->mAttribute_memory_5F_prot) ;
  }
  return result ;
}


//---------------------------------------------------------------------------*

GALGAS_memmap_5F_true::GALGAS_memmap_5F_true (const GALGASap_location & constinAttribute_location,
                                              const GALGASap_lstring & constinAttribute_compiler,
                                              const GALGASap_lstring & constinAttribute_assembler,
                                              const GALGASap_basic_5F_type & constinAttribute_linker,
                                              const GALGASap_basic_5F_type & constinAttribute_memory_5F_prot
                                              COMMA_LOCATION_ARGS) :
GALGAS_basic_5F_type (constinAttribute_location COMMA_THERE),
mAttribute_compiler (constinAttribute_compiler),
mAttribute_assembler (constinAttribute_assembler),
mAttribute_linker (constinAttribute_linker),
mAttribute_memory_5F_prot (constinAttribute_memory_5F_prot) {
}

//---------------------------------------------------------------------------*

GALGASap_memmap_5F_true GALGASap_memmap_5F_true::constructor_new (GALGASap_location & inAttribute_location,
                                                                  GALGASap_lstring & inAttribute_compiler,
                                                                  GALGASap_lstring & inAttribute_assembler,
                                                                  GALGASap_basic_5F_type & inAttribute_linker,
                                                                  GALGASap_basic_5F_type & inAttribute_memory_5F_prot
                                                                  COMMA_LOCATION_ARGS) {
  GALGAS_memmap_5F_true * result = NULL ;
  if (inAttribute_location.isValid () && inAttribute_compiler.isValid () && inAttribute_assembler.isValid () && inAttribute_linker.isValid () && inAttribute_memory_5F_prot.isValid ()) {
    macroMyNew (result, GALGAS_memmap_5F_true (inAttribute_location, inAttribute_compiler, inAttribute_assembler, inAttribute_linker, inAttribute_memory_5F_prot COMMA_THERE)) ;
  }
  return result ;
}

//---------------------------------------------------------------------------*

void GALGAS_memmap_5F_true::description (C_String & ioString,
                                         const PMSInt32 /* inIndentation */) const {
  ioString << "<class @"
           << typeDescriptor ()->mGalgasTypeName
           << ":" ;
//  mAttribute_compiler->description (ioString, inIndentation + 1) ;
  ioString << ", " ;
//  mAttribute_assembler->description (ioString, inIndentation + 1) ;
  ioString << ", " ;
//  mAttribute_linker->description (ioString, inIndentation + 1) ;
  ioString << ", " ;
//  mAttribute_memory_5F_prot->description (ioString, inIndentation + 1) ;
  ioString << ">" ;
}

//---------------------------------------------------------------------------*

GALGAS_memmap_5F_true::~GALGAS_memmap_5F_true (void) {
}

//---------------------------------------------------------------------------*

void GALGASap_memmap_5F_true::insulate (LOCATION_ARGS) {
  if (isValid () && (ptr (HERE)->retainCount () > 1)) {
    GALGASap_memmap_5F_true p = constructor_new (ptr (HERE)->mAttribute_location, ptr (HERE)->mAttribute_compiler, ptr (HERE)->mAttribute_assembler, ptr (HERE)->mAttribute_linker, ptr (HERE)->mAttribute_memory_5F_prot COMMA_THERE) ;
    *this = p ;
  }
}

//---------------------------------------------------------------------------*

GALGASap_lstring GALGAS_memmap_5F_true::reader_compiler (UNUSED_LOCATION_ARGS) const {
  return mAttribute_compiler ;
}

//---------------------------------------------------------------------------*

GALGASap_lstring GALGAS_memmap_5F_true::reader_assembler (UNUSED_LOCATION_ARGS) const {
  return mAttribute_assembler ;
}

//---------------------------------------------------------------------------*

GALGASap_basic_5F_type GALGAS_memmap_5F_true::reader_linker (UNUSED_LOCATION_ARGS) const {
  return mAttribute_linker ;
}

//---------------------------------------------------------------------------*

GALGASap_basic_5F_type GALGAS_memmap_5F_true::reader_memory_5F_prot (UNUSED_LOCATION_ARGS) const {
  return mAttribute_memory_5F_prot ;
}

//---------------------------------------------------------------------------*

void GALGAS_memmap_5F_true::modifier_setLocation (GALGASap_location inValue
                                                  COMMA_UNUSED_LOCATION_ARGS) {
  mAttribute_location = inValue ;
}

//---------------------------------------------------------------------------*

void GALGAS_memmap_5F_true::modifier_setCompiler (GALGASap_lstring inValue
                                                  COMMA_UNUSED_LOCATION_ARGS) {
  mAttribute_compiler = inValue ;
}

//---------------------------------------------------------------------------*

void GALGAS_memmap_5F_true::modifier_setAssembler (GALGASap_lstring inValue
                                                   COMMA_UNUSED_LOCATION_ARGS) {
  mAttribute_assembler = inValue ;
}

//---------------------------------------------------------------------------*

void GALGAS_memmap_5F_true::modifier_setLinker (GALGASap_basic_5F_type inValue
                                                COMMA_UNUSED_LOCATION_ARGS) {
  mAttribute_linker = inValue ;
}

//---------------------------------------------------------------------------*

void GALGAS_memmap_5F_true::modifier_setMemory_5F_prot (GALGASap_basic_5F_type inValue
                                                        COMMA_UNUSED_LOCATION_ARGS) {
  mAttribute_memory_5F_prot = inValue ;
}

//---------------------------------------------------------------------------*
//                                                                           *
//                          @memmap_true class type                          *
//                                                                           *
//---------------------------------------------------------------------------*

const C_galgas_type_descriptor
kTypeDescriptor_GALGAS_memmap_5F_true ("memmap_true",
                                       & kTypeDescriptor_GALGAS_basic_5F_type) ;


//---------------------------------------------------------------------------*

const C_galgas_type_descriptor * GALGAS_memmap_5F_true::typeDescriptor (void) const {
  return & kTypeDescriptor_GALGAS_memmap_5F_true ;
}
//---------------------------------------------------------------------------*

void GALGASap_memmap_5F_true::modifierCall_setAssembler (GALGASap_lstring inArgument0
                                                         COMMA_LOCATION_ARGS) {
//--- Release 'output' arguments
//---
  if (isValid ()) {
    insulate (THERE) ;
    ptr (HERE)->modifier_setAssembler (inArgument0 COMMA_THERE) ;
  }
}

//---------------------------------------------------------------------------*

void GALGASap_memmap_5F_true::modifierCall_setCompiler (GALGASap_lstring inArgument0
                                                        COMMA_LOCATION_ARGS) {
//--- Release 'output' arguments
//---
  if (isValid ()) {
    insulate (THERE) ;
    ptr (HERE)->modifier_setCompiler (inArgument0 COMMA_THERE) ;
  }
}

//---------------------------------------------------------------------------*

void GALGASap_memmap_5F_true::modifierCall_setLinker (GALGASap_basic_5F_type inArgument0
                                                      COMMA_LOCATION_ARGS) {
//--- Release 'output' arguments
//---
  if (isValid ()) {
    insulate (THERE) ;
    ptr (HERE)->modifier_setLinker (inArgument0 COMMA_THERE) ;
  }
}

//---------------------------------------------------------------------------*

void GALGASap_memmap_5F_true::modifierCall_setLocation (GALGASap_location inArgument0
                                                        COMMA_LOCATION_ARGS) {
//--- Release 'output' arguments
//---
  if (isValid ()) {
    insulate (THERE) ;
    ptr (HERE)->modifier_setLocation (inArgument0 COMMA_THERE) ;
  }
}

//---------------------------------------------------------------------------*

void GALGASap_memmap_5F_true::modifierCall_setMemory_5F_prot (GALGASap_basic_5F_type inArgument0
                                                              COMMA_LOCATION_ARGS) {
//--- Release 'output' arguments
//---
  if (isValid ()) {
    insulate (THERE) ;
    ptr (HERE)->modifier_setMemory_5F_prot (inArgument0 COMMA_THERE) ;
  }
}

//---------------------------------------------------------------------------*
//                                                                           *
//                        Function 'link_script_name'                        *
//                                                                           *
//---------------------------------------------------------------------------*

GALGASap_string function_link_5F_script_5F_name (GALGASap_basic_5F_type & constinArgument_mm,
                                                 C_Compiler * /* inCompiler */
                                                 COMMA_UNUSED_LOCATION_ARGS) {
  GALGASap_string result_string ; // Returned variable
  //-------- @structuredCastInstructionForGeneration
  if (constinArgument_mm.isValid ()) {
    if (constinArgument_mm.ptr (HERE)->typeDescriptor () == & kTypeDescriptor_GALGAS_memmap_5F_true) {
    GALGASap_memmap_5F_true cast_3709_m = constinArgument_mm ;
      //-------- @structuredCastInstructionForGeneration
      //--- @readerCallExpressionForGeneration
      GALGASap_basic_5F_type temp_0 (cast_3709_m.readerCall_linker (SOURCE_FILE_AT_LINE (156))) ;
      if (temp_0.isValid ()) {
        if (temp_0.ptr (HERE)->typeDescriptor () == & kTypeDescriptor_GALGAS_yes_5F_linker) {
        GALGASap_yes_5F_linker cast_3760_l = temp_0 ;
          //-------- @assignmentInstructionForGeneration
          //--- @readerCallExpressionForGeneration
          //--- @readerCallExpressionForGeneration
          GALGASap_lstring temp_1 (cast_3760_l.readerCall_script (SOURCE_FILE_AT_LINE (158))) ;
          GALGASap_string temp_2 (temp_1.readerCall_string (SOURCE_FILE_AT_LINE (158))) ;
          result_string = temp_2 ;
        }else{
          //-------- @assignmentInstructionForGeneration
          //--- @literalStringExpressionForGeneration
          GALGASap_string temp_3 ("" COMMA_SOURCE_FILE_AT_LINE (160)) ;
          result_string = temp_3 ;
        }
      }
    }else{
      //-------- @assignmentInstructionForGeneration
      //--- @literalStringExpressionForGeneration
      GALGASap_string temp_4 ("" COMMA_SOURCE_FILE_AT_LINE (164)) ;
      result_string = temp_4 ;
    }
  }
//---
  return result_string ;
}


//---------------------------------------------------------------------------*
//  Introspection                                                            *
//---------------------------------------------------------------------------*

static const C_galgas_type_descriptor * functionArgs_link_5F_script_5F_name [2] = {
  & kTypeDescriptor_GALGAS_basic_5F_type,
  NULL
} ;

//---------------------------------------------------------------------------*

static GALGASap_object functionWithGenericHeader_link_5F_script_5F_name (C_Compiler * inCompiler,
                                                                         cRootObjectArray & inEffectiveParameterArray,
                                                                         const GALGASap_location & inErrorLocation
                                                                         COMMA_LOCATION_ARGS) {
  const bool ok = inCompiler->checkFunctionCallArguments ("link_script_name",
                                                          1,
                                                          functionArgs_link_5F_script_5F_name,
                                                          inEffectiveParameterArray,
                                                          inErrorLocation
                                                          COMMA_THERE) ;
  GALGASap_object result ;
  if (ok) {
    GALGASap_basic_5F_type operand0 = inEffectiveParameterArray.objectAtIndex (0 COMMA_THERE) ;
    result = function_link_5F_script_5F_name (operand0, inCompiler COMMA_THERE).embedObject () ;
  }
  return result ;
}

//---------------------------------------------------------------------------*

C_galgas_function_descriptor functionDescriptor_link_5F_script_5F_name ("link_script_name",
                                                                        functionWithGenericHeader_link_5F_script_5F_name,
                                                                        & kTypeDescriptor_GALGAS_string,
                                                                        1,
                                                                        functionArgs_link_5F_script_5F_name) ;


//---------------------------------------------------------------------------*
//                                                                           *
//                           Routine 'set_memmap'                            *
//                                                                           *
//---------------------------------------------------------------------------*

void routine_set_5F_memmap (GALGASap_basic_5F_type & ioArgument_m,
                            GALGASap_basic_5F_type inArgument_nm,
                            GALGASap_string inArgument_att,
                            C_Compiler * inCompiler
                            COMMA_UNUSED_LOCATION_ARGS) {
  //-------- @structuredCastInstructionForGeneration
  if (ioArgument_m.isValid ()) {
    if (ioArgument_m.ptr (HERE)->typeDescriptor () == & kTypeDescriptor_GALGAS_void) {
      //-------- @assignmentInstructionForGeneration
      ioArgument_m = inArgument_nm ;
    }else{
      //-------- @errorInstructionForGeneration
      //--- @readerCallExpressionForGeneration
      GALGASap_location temp_0 (inArgument_nm.readerCall_location (SOURCE_FILE_AT_LINE (177))) ;
      //--- @concatExpressionForGeneration
      //--- @literalStringExpressionForGeneration
      GALGASap_string temp_1 ("Redefinition of " COMMA_SOURCE_FILE_AT_LINE (177)) ;
      GALGASap_string temp_2 (temp_1.operator_concat (inArgument_att COMMA_SOURCE_FILE_AT_LINE (177))) ;
      inCompiler->emitSemanticError (temp_0, temp_2 COMMA_SOURCE_FILE_AT_LINE (177)) ;
      //-------- @errorInstructionForGeneration
      //--- @readerCallExpressionForGeneration
      GALGASap_location temp_3 (ioArgument_m.readerCall_location (SOURCE_FILE_AT_LINE (178))) ;
      //--- @literalStringExpressionForGeneration
      GALGASap_string temp_4 ("was defined here" COMMA_SOURCE_FILE_AT_LINE (178)) ;
      inCompiler->emitSemanticError (temp_3, temp_4 COMMA_SOURCE_FILE_AT_LINE (178)) ;
    }
  }
}

//---------------------------------------------------------------------------*
//                                                                           *
//                           @os_obj auto ptr type                           *
//                                                                           *
//---------------------------------------------------------------------------*

GALGASap_os_5F_obj::GALGASap_os_5F_obj (const GALGASap_os_5F_obj & inSource) :
GALGASap_oil_5F_obj (inSource) {
}

//---------------------------------------------------------------------------*

GALGASap_os_5F_obj::GALGASap_os_5F_obj (const GALGASap_object & inSource) :
GALGASap_oil_5F_obj (inSource) {
  macroNullOrValidObject (mPtr, GALGAS_os_5F_obj) ;
}

//---------------------------------------------------------------------------*

GALGASap_os_5F_obj & GALGASap_os_5F_obj::operator = (const GALGASap_os_5F_obj & inSource) {
  macroAssignObject (mPtr, inSource.mPtr) ;
  return * this ;
}

//---------------------------------------------------------------------------*

GALGASap_lstring GALGASap_os_5F_obj::readerCall_app_5F_name (LOCATION_ARGS) const {
  GALGASap_lstring result ;
  if (isValid ()) {
    result = ptr (HERE)->reader_app_5F_name (THERE) ;
  }
  return result ;
}

//---------------------------------------------------------------------------*

GALGASap_lstringlist GALGASap_os_5F_obj::readerCall_app_5F_src (LOCATION_ARGS) const {
  GALGASap_lstringlist result ;
  if (isValid ()) {
    result = ptr (HERE)->reader_app_5F_src (THERE) ;
  }
  return result ;
}

//---------------------------------------------------------------------------*

GALGASap_lstringlist GALGASap_os_5F_obj::readerCall_asflags (LOCATION_ARGS) const {
  GALGASap_lstringlist result ;
  if (isValid ()) {
    result = ptr (HERE)->reader_asflags (THERE) ;
  }
  return result ;
}

//---------------------------------------------------------------------------*

GALGASap_lstring GALGASap_os_5F_obj::readerCall_assembler (LOCATION_ARGS) const {
  GALGASap_lstring result ;
  if (isValid ()) {
    result = ptr (HERE)->reader_assembler (THERE) ;
  }
  return result ;
}

//---------------------------------------------------------------------------*

GALGASap_lstringlist GALGASap_os_5F_obj::readerCall_cflags (LOCATION_ARGS) const {
  GALGASap_lstringlist result ;
  if (isValid ()) {
    result = ptr (HERE)->reader_cflags (THERE) ;
  }
  return result ;
}

//---------------------------------------------------------------------------*

GALGASap_lstring GALGASap_os_5F_obj::readerCall_compiler (LOCATION_ARGS) const {
  GALGASap_lstring result ;
  if (isValid ()) {
    result = ptr (HERE)->reader_compiler (THERE) ;
  }
  return result ;
}

//---------------------------------------------------------------------------*

GALGASap_basic_5F_type GALGASap_os_5F_obj::readerCall_debug (LOCATION_ARGS) const {
  GALGASap_basic_5F_type result ;
  if (isValid ()) {
    result = ptr (HERE)->reader_debug (THERE) ;
  }
  return result ;
}

//---------------------------------------------------------------------------*

GALGASap_basic_5F_type GALGASap_os_5F_obj::readerCall_errorhook (LOCATION_ARGS) const {
  GALGASap_basic_5F_type result ;
  if (isValid ()) {
    result = ptr (HERE)->reader_errorhook (THERE) ;
  }
  return result ;
}

//---------------------------------------------------------------------------*

GALGASap_lstringlist GALGASap_os_5F_obj::readerCall_ldflags (LOCATION_ARGS) const {
  GALGASap_lstringlist result ;
  if (isValid ()) {
    result = ptr (HERE)->reader_ldflags (THERE) ;
  }
  return result ;
}

//---------------------------------------------------------------------------*

GALGASap_lstring GALGASap_os_5F_obj::readerCall_linker (LOCATION_ARGS) const {
  GALGASap_lstring result ;
  if (isValid ()) {
    result = ptr (HERE)->reader_linker (THERE) ;
  }
  return result ;
}

//---------------------------------------------------------------------------*

GALGASap_basic_5F_type GALGASap_os_5F_obj::readerCall_memmap (LOCATION_ARGS) const {
  GALGASap_basic_5F_type result ;
  if (isValid ()) {
    result = ptr (HERE)->reader_memmap (THERE) ;
  }
  return result ;
}

//---------------------------------------------------------------------------*

GALGASap_ident_5F_map GALGASap_os_5F_obj::readerCall_others (LOCATION_ARGS) const {
  GALGASap_ident_5F_map result ;
  if (isValid ()) {
    result = ptr (HERE)->reader_others (THERE) ;
  }
  return result ;
}

//---------------------------------------------------------------------------*

GALGASap_basic_5F_type GALGASap_os_5F_obj::readerCall_posttaskhook (LOCATION_ARGS) const {
  GALGASap_basic_5F_type result ;
  if (isValid ()) {
    result = ptr (HERE)->reader_posttaskhook (THERE) ;
  }
  return result ;
}

//---------------------------------------------------------------------------*

GALGASap_basic_5F_type GALGASap_os_5F_obj::readerCall_pretaskhook (LOCATION_ARGS) const {
  GALGASap_basic_5F_type result ;
  if (isValid ()) {
    result = ptr (HERE)->reader_pretaskhook (THERE) ;
  }
  return result ;
}

//---------------------------------------------------------------------------*

GALGASap_basic_5F_type GALGASap_os_5F_obj::readerCall_protectionhook (LOCATION_ARGS) const {
  GALGASap_basic_5F_type result ;
  if (isValid ()) {
    result = ptr (HERE)->reader_protectionhook (THERE) ;
  }
  return result ;
}

//---------------------------------------------------------------------------*

GALGASap_lstring GALGASap_os_5F_obj::readerCall_scalabilityclass (LOCATION_ARGS) const {
  GALGASap_lstring result ;
  if (isValid ()) {
    result = ptr (HERE)->reader_scalabilityclass (THERE) ;
  }
  return result ;
}

//---------------------------------------------------------------------------*

GALGASap_basic_5F_type GALGASap_os_5F_obj::readerCall_shutdownhook (LOCATION_ARGS) const {
  GALGASap_basic_5F_type result ;
  if (isValid ()) {
    result = ptr (HERE)->reader_shutdownhook (THERE) ;
  }
  return result ;
}

//---------------------------------------------------------------------------*

GALGASap_basic_5F_type GALGASap_os_5F_obj::readerCall_stackmonitoring (LOCATION_ARGS) const {
  GALGASap_basic_5F_type result ;
  if (isValid ()) {
    result = ptr (HERE)->reader_stackmonitoring (THERE) ;
  }
  return result ;
}

//---------------------------------------------------------------------------*

GALGASap_basic_5F_type GALGASap_os_5F_obj::readerCall_startuphook (LOCATION_ARGS) const {
  GALGASap_basic_5F_type result ;
  if (isValid ()) {
    result = ptr (HERE)->reader_startuphook (THERE) ;
  }
  return result ;
}

//---------------------------------------------------------------------------*

GALGASap_lstring GALGASap_os_5F_obj::readerCall_status (LOCATION_ARGS) const {
  GALGASap_lstring result ;
  if (isValid ()) {
    result = ptr (HERE)->reader_status (THERE) ;
  }
  return result ;
}

//---------------------------------------------------------------------------*

GALGASap_basic_5F_type GALGASap_os_5F_obj::readerCall_systemcall (LOCATION_ARGS) const {
  GALGASap_basic_5F_type result ;
  if (isValid ()) {
    result = ptr (HERE)->reader_systemcall (THERE) ;
  }
  return result ;
}

//---------------------------------------------------------------------------*

GALGASap_lstring GALGASap_os_5F_obj::readerCall_tpl_5F_base_5F_path (LOCATION_ARGS) const {
  GALGASap_lstring result ;
  if (isValid ()) {
    result = ptr (HERE)->reader_tpl_5F_base_5F_path (THERE) ;
  }
  return result ;
}

//---------------------------------------------------------------------------*

GALGASap_trace GALGASap_os_5F_obj::readerCall_trace (LOCATION_ARGS) const {
  GALGASap_trace result ;
  if (isValid ()) {
    result = ptr (HERE)->reader_trace (THERE) ;
  }
  return result ;
}

//---------------------------------------------------------------------------*

GALGASap_basic_5F_type GALGASap_os_5F_obj::readerCall_usegetserviceid (LOCATION_ARGS) const {
  GALGASap_basic_5F_type result ;
  if (isValid ()) {
    result = ptr (HERE)->reader_usegetserviceid (THERE) ;
  }
  return result ;
}

//---------------------------------------------------------------------------*

GALGASap_basic_5F_type GALGASap_os_5F_obj::readerCall_useparameteraccess (LOCATION_ARGS) const {
  GALGASap_basic_5F_type result ;
  if (isValid ()) {
    result = ptr (HERE)->reader_useparameteraccess (THERE) ;
  }
  return result ;
}

//---------------------------------------------------------------------------*

GALGASap_basic_5F_type GALGASap_os_5F_obj::readerCall_useresscheduler (LOCATION_ARGS) const {
  GALGASap_basic_5F_type result ;
  if (isValid ()) {
    result = ptr (HERE)->reader_useresscheduler (THERE) ;
  }
  return result ;
}

//---------------------------------------------------------------------------*

#ifndef DO_NOT_GENERATE_CHECKINGS
  GALGAS_os_5F_obj * GALGASap_os_5F_obj::ptr (LOCATION_ARGS) {
    macroValidObjectThere (mPtr, GALGAS_os_5F_obj) ;
    return (GALGAS_os_5F_obj *) mPtr ;
  }
#endif

//---------------------------------------------------------------------------*

#ifndef DO_NOT_GENERATE_CHECKINGS
  const GALGAS_os_5F_obj * GALGASap_os_5F_obj::ptr (LOCATION_ARGS) const {
    macroValidObjectThere (mPtr, const GALGAS_os_5F_obj) ;
    return (const GALGAS_os_5F_obj *) mPtr ;
  }
#endif

//---------------------------------------------------------------------------*

GALGASap_os_5F_obj::GALGASap_os_5F_obj (const GALGAS_os_5F_obj * inSourcePtr) :
GALGASap_oil_5F_obj (inSourcePtr) {
}

//---------------------------------------------------------------------------*

GALGASap_os_5F_obj & GALGASap_os_5F_obj::operator = (GALGAS_os_5F_obj * inSourcePtr) {
  macroAssignObject (mPtr, inSourcePtr) ;
  return *this ;
}

//---------------------------------------------------------------------------*

enumComparisonResult GALGASap_os_5F_obj::objectCompare (const GALGASap_os_5F_obj & inOperand1,
                                                        const GALGASap_os_5F_obj & inOperand2) {
  enumComparisonResult result = GALGASap_oil_5F_obj::objectCompare (inOperand1, inOperand2) ;
  if (kOperandEqual == result) {
    result = GALGASap_lstring::objectCompare (inOperand1.ptr (HERE)->mAttribute_status, inOperand2.ptr (HERE)->mAttribute_status) ;
  }
  if (kOperandEqual == result) {
    result = GALGASap_basic_5F_type::objectCompare (inOperand1.ptr (HERE)->mAttribute_startuphook, inOperand2.ptr (HERE)->mAttribute_startuphook) ;
  }
  if (kOperandEqual == result) {
    result = GALGASap_basic_5F_type::objectCompare (inOperand1.ptr (HERE)->mAttribute_shutdownhook, inOperand2.ptr (HERE)->mAttribute_shutdownhook) ;
  }
  if (kOperandEqual == result) {
    result = GALGASap_basic_5F_type::objectCompare (inOperand1.ptr (HERE)->mAttribute_errorhook, inOperand2.ptr (HERE)->mAttribute_errorhook) ;
  }
  if (kOperandEqual == result) {
    result = GALGASap_basic_5F_type::objectCompare (inOperand1.ptr (HERE)->mAttribute_pretaskhook, inOperand2.ptr (HERE)->mAttribute_pretaskhook) ;
  }
  if (kOperandEqual == result) {
    result = GALGASap_basic_5F_type::objectCompare (inOperand1.ptr (HERE)->mAttribute_posttaskhook, inOperand2.ptr (HERE)->mAttribute_posttaskhook) ;
  }
  if (kOperandEqual == result) {
    result = GALGASap_basic_5F_type::objectCompare (inOperand1.ptr (HERE)->mAttribute_protectionhook, inOperand2.ptr (HERE)->mAttribute_protectionhook) ;
  }
  if (kOperandEqual == result) {
    result = GALGASap_lstring::objectCompare (inOperand1.ptr (HERE)->mAttribute_scalabilityclass, inOperand2.ptr (HERE)->mAttribute_scalabilityclass) ;
  }
  if (kOperandEqual == result) {
    result = GALGASap_basic_5F_type::objectCompare (inOperand1.ptr (HERE)->mAttribute_stackmonitoring, inOperand2.ptr (HERE)->mAttribute_stackmonitoring) ;
  }
  if (kOperandEqual == result) {
    result = GALGASap_basic_5F_type::objectCompare (inOperand1.ptr (HERE)->mAttribute_usegetserviceid, inOperand2.ptr (HERE)->mAttribute_usegetserviceid) ;
  }
  if (kOperandEqual == result) {
    result = GALGASap_basic_5F_type::objectCompare (inOperand1.ptr (HERE)->mAttribute_useparameteraccess, inOperand2.ptr (HERE)->mAttribute_useparameteraccess) ;
  }
  if (kOperandEqual == result) {
    result = GALGASap_basic_5F_type::objectCompare (inOperand1.ptr (HERE)->mAttribute_useresscheduler, inOperand2.ptr (HERE)->mAttribute_useresscheduler) ;
  }
  if (kOperandEqual == result) {
    result = GALGASap_basic_5F_type::objectCompare (inOperand1.ptr (HERE)->mAttribute_systemcall, inOperand2.ptr (HERE)->mAttribute_systemcall) ;
  }
  if (kOperandEqual == result) {
    result = GALGASap_basic_5F_type::objectCompare (inOperand1.ptr (HERE)->mAttribute_debug, inOperand2.ptr (HERE)->mAttribute_debug) ;
  }
  if (kOperandEqual == result) {
    result = GALGASap_basic_5F_type::objectCompare (inOperand1.ptr (HERE)->mAttribute_memmap, inOperand2.ptr (HERE)->mAttribute_memmap) ;
  }
  if (kOperandEqual == result) {
    result = GALGASap_lstringlist::objectCompare (inOperand1.ptr (HERE)->mAttribute_app_5F_src, inOperand2.ptr (HERE)->mAttribute_app_5F_src) ;
  }
  if (kOperandEqual == result) {
    result = GALGASap_lstring::objectCompare (inOperand1.ptr (HERE)->mAttribute_compiler, inOperand2.ptr (HERE)->mAttribute_compiler) ;
  }
  if (kOperandEqual == result) {
    result = GALGASap_lstring::objectCompare (inOperand1.ptr (HERE)->mAttribute_assembler, inOperand2.ptr (HERE)->mAttribute_assembler) ;
  }
  if (kOperandEqual == result) {
    result = GALGASap_lstring::objectCompare (inOperand1.ptr (HERE)->mAttribute_linker, inOperand2.ptr (HERE)->mAttribute_linker) ;
  }
  if (kOperandEqual == result) {
    result = GALGASap_lstringlist::objectCompare (inOperand1.ptr (HERE)->mAttribute_cflags, inOperand2.ptr (HERE)->mAttribute_cflags) ;
  }
  if (kOperandEqual == result) {
    result = GALGASap_lstringlist::objectCompare (inOperand1.ptr (HERE)->mAttribute_asflags, inOperand2.ptr (HERE)->mAttribute_asflags) ;
  }
  if (kOperandEqual == result) {
    result = GALGASap_lstringlist::objectCompare (inOperand1.ptr (HERE)->mAttribute_ldflags, inOperand2.ptr (HERE)->mAttribute_ldflags) ;
  }
  if (kOperandEqual == result) {
    result = GALGASap_lstring::objectCompare (inOperand1.ptr (HERE)->mAttribute_app_5F_name, inOperand2.ptr (HERE)->mAttribute_app_5F_name) ;
  }
  if (kOperandEqual == result) {
    result = GALGASap_lstring::objectCompare (inOperand1.ptr (HERE)->mAttribute_tpl_5F_base_5F_path, inOperand2.ptr (HERE)->mAttribute_tpl_5F_base_5F_path) ;
  }
  if (kOperandEqual == result) {
    result = GALGASap_trace::objectCompare (inOperand1.ptr (HERE)->mAttribute_trace, inOperand2.ptr (HERE)->mAttribute_trace) ;
  }
  if (kOperandEqual == result) {
    result = GALGASap_ident_5F_map::objectCompare (inOperand1.ptr (HERE)->mAttribute_others, inOperand2.ptr (HERE)->mAttribute_others) ;
  }
  return result ;
}


//---------------------------------------------------------------------------*

GALGAS_os_5F_obj::GALGAS_os_5F_obj (const GALGASap_lstring & constinAttribute_desc,
                                    const GALGASap_lstring & constinAttribute_status,
                                    const GALGASap_basic_5F_type & constinAttribute_startuphook,
                                    const GALGASap_basic_5F_type & constinAttribute_shutdownhook,
                                    const GALGASap_basic_5F_type & constinAttribute_errorhook,
                                    const GALGASap_basic_5F_type & constinAttribute_pretaskhook,
                                    const GALGASap_basic_5F_type & constinAttribute_posttaskhook,
                                    const GALGASap_basic_5F_type & constinAttribute_protectionhook,
                                    const GALGASap_lstring & constinAttribute_scalabilityclass,
                                    const GALGASap_basic_5F_type & constinAttribute_stackmonitoring,
                                    const GALGASap_basic_5F_type & constinAttribute_usegetserviceid,
                                    const GALGASap_basic_5F_type & constinAttribute_useparameteraccess,
                                    const GALGASap_basic_5F_type & constinAttribute_useresscheduler,
                                    const GALGASap_basic_5F_type & constinAttribute_systemcall,
                                    const GALGASap_basic_5F_type & constinAttribute_debug,
                                    const GALGASap_basic_5F_type & constinAttribute_memmap,
                                    const GALGASap_lstringlist & constinAttribute_app_5F_src,
                                    const GALGASap_lstring & constinAttribute_compiler,
                                    const GALGASap_lstring & constinAttribute_assembler,
                                    const GALGASap_lstring & constinAttribute_linker,
                                    const GALGASap_lstringlist & constinAttribute_cflags,
                                    const GALGASap_lstringlist & constinAttribute_asflags,
                                    const GALGASap_lstringlist & constinAttribute_ldflags,
                                    const GALGASap_lstring & constinAttribute_app_5F_name,
                                    const GALGASap_lstring & constinAttribute_tpl_5F_base_5F_path,
                                    const GALGASap_trace & constinAttribute_trace,
                                    const GALGASap_ident_5F_map & constinAttribute_others
                                    COMMA_LOCATION_ARGS) :
GALGAS_oil_5F_obj (constinAttribute_desc COMMA_THERE),
mAttribute_status (constinAttribute_status),
mAttribute_startuphook (constinAttribute_startuphook),
mAttribute_shutdownhook (constinAttribute_shutdownhook),
mAttribute_errorhook (constinAttribute_errorhook),
mAttribute_pretaskhook (constinAttribute_pretaskhook),
mAttribute_posttaskhook (constinAttribute_posttaskhook),
mAttribute_protectionhook (constinAttribute_protectionhook),
mAttribute_scalabilityclass (constinAttribute_scalabilityclass),
mAttribute_stackmonitoring (constinAttribute_stackmonitoring),
mAttribute_usegetserviceid (constinAttribute_usegetserviceid),
mAttribute_useparameteraccess (constinAttribute_useparameteraccess),
mAttribute_useresscheduler (constinAttribute_useresscheduler),
mAttribute_systemcall (constinAttribute_systemcall),
mAttribute_debug (constinAttribute_debug),
mAttribute_memmap (constinAttribute_memmap),
mAttribute_app_5F_src (constinAttribute_app_5F_src),
mAttribute_compiler (constinAttribute_compiler),
mAttribute_assembler (constinAttribute_assembler),
mAttribute_linker (constinAttribute_linker),
mAttribute_cflags (constinAttribute_cflags),
mAttribute_asflags (constinAttribute_asflags),
mAttribute_ldflags (constinAttribute_ldflags),
mAttribute_app_5F_name (constinAttribute_app_5F_name),
mAttribute_tpl_5F_base_5F_path (constinAttribute_tpl_5F_base_5F_path),
mAttribute_trace (constinAttribute_trace),
mAttribute_others (constinAttribute_others) {
}

//---------------------------------------------------------------------------*

GALGASap_os_5F_obj GALGASap_os_5F_obj::constructor_new (GALGASap_lstring & inAttribute_desc,
                                                        GALGASap_lstring & inAttribute_status,
                                                        GALGASap_basic_5F_type & inAttribute_startuphook,
                                                        GALGASap_basic_5F_type & inAttribute_shutdownhook,
                                                        GALGASap_basic_5F_type & inAttribute_errorhook,
                                                        GALGASap_basic_5F_type & inAttribute_pretaskhook,
                                                        GALGASap_basic_5F_type & inAttribute_posttaskhook,
                                                        GALGASap_basic_5F_type & inAttribute_protectionhook,
                                                        GALGASap_lstring & inAttribute_scalabilityclass,
                                                        GALGASap_basic_5F_type & inAttribute_stackmonitoring,
                                                        GALGASap_basic_5F_type & inAttribute_usegetserviceid,
                                                        GALGASap_basic_5F_type & inAttribute_useparameteraccess,
                                                        GALGASap_basic_5F_type & inAttribute_useresscheduler,
                                                        GALGASap_basic_5F_type & inAttribute_systemcall,
                                                        GALGASap_basic_5F_type & inAttribute_debug,
                                                        GALGASap_basic_5F_type & inAttribute_memmap,
                                                        GALGASap_lstringlist & inAttribute_app_5F_src,
                                                        GALGASap_lstring & inAttribute_compiler,
                                                        GALGASap_lstring & inAttribute_assembler,
                                                        GALGASap_lstring & inAttribute_linker,
                                                        GALGASap_lstringlist & inAttribute_cflags,
                                                        GALGASap_lstringlist & inAttribute_asflags,
                                                        GALGASap_lstringlist & inAttribute_ldflags,
                                                        GALGASap_lstring & inAttribute_app_5F_name,
                                                        GALGASap_lstring & inAttribute_tpl_5F_base_5F_path,
                                                        GALGASap_trace & inAttribute_trace,
                                                        GALGASap_ident_5F_map & inAttribute_others
                                                        COMMA_LOCATION_ARGS) {
  GALGAS_os_5F_obj * result = NULL ;
  if (inAttribute_desc.isValid () && inAttribute_status.isValid () && inAttribute_startuphook.isValid () && inAttribute_shutdownhook.isValid () && inAttribute_errorhook.isValid () && inAttribute_pretaskhook.isValid () && inAttribute_posttaskhook.isValid () && inAttribute_protectionhook.isValid () && inAttribute_scalabilityclass.isValid () && inAttribute_stackmonitoring.isValid () && inAttribute_usegetserviceid.isValid () && inAttribute_useparameteraccess.isValid () && inAttribute_useresscheduler.isValid () && inAttribute_systemcall.isValid () && inAttribute_debug.isValid () && inAttribute_memmap.isValid () && inAttribute_app_5F_src.isValid () && inAttribute_compiler.isValid () && inAttribute_assembler.isValid () && inAttribute_linker.isValid () && inAttribute_cflags.isValid () && inAttribute_asflags.isValid () && inAttribute_ldflags.isValid () && inAttribute_app_5F_name.isValid () && inAttribute_tpl_5F_base_5F_path.isValid () && inAttribute_trace.isValid () && inAttribute_others.isValid ()) {
    macroMyNew (result, GALGAS_os_5F_obj (inAttribute_desc, inAttribute_status, inAttribute_startuphook, inAttribute_shutdownhook, inAttribute_errorhook, inAttribute_pretaskhook, inAttribute_posttaskhook, inAttribute_protectionhook, inAttribute_scalabilityclass, inAttribute_stackmonitoring, inAttribute_usegetserviceid, inAttribute_useparameteraccess, inAttribute_useresscheduler, inAttribute_systemcall, inAttribute_debug, inAttribute_memmap, inAttribute_app_5F_src, inAttribute_compiler, inAttribute_assembler, inAttribute_linker, inAttribute_cflags, inAttribute_asflags, inAttribute_ldflags, inAttribute_app_5F_name, inAttribute_tpl_5F_base_5F_path, inAttribute_trace, inAttribute_others COMMA_THERE)) ;
  }
  return result ;
}

//---------------------------------------------------------------------------*

void GALGAS_os_5F_obj::description (C_String & ioString,
                                    const PMSInt32 /* inIndentation */) const {
  ioString << "<class @"
           << typeDescriptor ()->mGalgasTypeName
           << ":" ;
//  mAttribute_status->description (ioString, inIndentation + 1) ;
  ioString << ", " ;
//  mAttribute_startuphook->description (ioString, inIndentation + 1) ;
  ioString << ", " ;
//  mAttribute_shutdownhook->description (ioString, inIndentation + 1) ;
  ioString << ", " ;
//  mAttribute_errorhook->description (ioString, inIndentation + 1) ;
  ioString << ", " ;
//  mAttribute_pretaskhook->description (ioString, inIndentation + 1) ;
  ioString << ", " ;
//  mAttribute_posttaskhook->description (ioString, inIndentation + 1) ;
  ioString << ", " ;
//  mAttribute_protectionhook->description (ioString, inIndentation + 1) ;
  ioString << ", " ;
//  mAttribute_scalabilityclass->description (ioString, inIndentation + 1) ;
  ioString << ", " ;
//  mAttribute_stackmonitoring->description (ioString, inIndentation + 1) ;
  ioString << ", " ;
//  mAttribute_usegetserviceid->description (ioString, inIndentation + 1) ;
  ioString << ", " ;
//  mAttribute_useparameteraccess->description (ioString, inIndentation + 1) ;
  ioString << ", " ;
//  mAttribute_useresscheduler->description (ioString, inIndentation + 1) ;
  ioString << ", " ;
//  mAttribute_systemcall->description (ioString, inIndentation + 1) ;
  ioString << ", " ;
//  mAttribute_debug->description (ioString, inIndentation + 1) ;
  ioString << ", " ;
//  mAttribute_memmap->description (ioString, inIndentation + 1) ;
  ioString << ", " ;
//  mAttribute_app_5F_src->description (ioString, inIndentation + 1) ;
  ioString << ", " ;
//  mAttribute_compiler->description (ioString, inIndentation + 1) ;
  ioString << ", " ;
//  mAttribute_assembler->description (ioString, inIndentation + 1) ;
  ioString << ", " ;
//  mAttribute_linker->description (ioString, inIndentation + 1) ;
  ioString << ", " ;
//  mAttribute_cflags->description (ioString, inIndentation + 1) ;
  ioString << ", " ;
//  mAttribute_asflags->description (ioString, inIndentation + 1) ;
  ioString << ", " ;
//  mAttribute_ldflags->description (ioString, inIndentation + 1) ;
  ioString << ", " ;
//  mAttribute_app_5F_name->description (ioString, inIndentation + 1) ;
  ioString << ", " ;
//  mAttribute_tpl_5F_base_5F_path->description (ioString, inIndentation + 1) ;
  ioString << ", " ;
//  mAttribute_trace->description (ioString, inIndentation + 1) ;
  ioString << ", " ;
//  mAttribute_others->description (ioString, inIndentation + 1) ;
  ioString << ">" ;
}

//---------------------------------------------------------------------------*

GALGAS_os_5F_obj::~GALGAS_os_5F_obj (void) {
}

//---------------------------------------------------------------------------*

void GALGASap_os_5F_obj::insulate (LOCATION_ARGS) {
  if (isValid () && (ptr (HERE)->retainCount () > 1)) {
    GALGASap_os_5F_obj p = constructor_new (ptr (HERE)->mAttribute_desc, ptr (HERE)->mAttribute_status, ptr (HERE)->mAttribute_startuphook, ptr (HERE)->mAttribute_shutdownhook, ptr (HERE)->mAttribute_errorhook, ptr (HERE)->mAttribute_pretaskhook, ptr (HERE)->mAttribute_posttaskhook, ptr (HERE)->mAttribute_protectionhook, ptr (HERE)->mAttribute_scalabilityclass, ptr (HERE)->mAttribute_stackmonitoring, ptr (HERE)->mAttribute_usegetserviceid, ptr (HERE)->mAttribute_useparameteraccess, ptr (HERE)->mAttribute_useresscheduler, ptr (HERE)->mAttribute_systemcall, ptr (HERE)->mAttribute_debug, ptr (HERE)->mAttribute_memmap, ptr (HERE)->mAttribute_app_5F_src, ptr (HERE)->mAttribute_compiler, ptr (HERE)->mAttribute_assembler, ptr (HERE)->mAttribute_linker, ptr (HERE)->mAttribute_cflags, ptr (HERE)->mAttribute_asflags, ptr (HERE)->mAttribute_ldflags, ptr (HERE)->mAttribute_app_5F_name, ptr (HERE)->mAttribute_tpl_5F_base_5F_path, ptr (HERE)->mAttribute_trace, ptr (HERE)->mAttribute_others COMMA_THERE) ;
    *this = p ;
  }
}

//---------------------------------------------------------------------------*

GALGASap_lstring GALGAS_os_5F_obj::reader_status (UNUSED_LOCATION_ARGS) const {
  return mAttribute_status ;
}

//---------------------------------------------------------------------------*

GALGASap_basic_5F_type GALGAS_os_5F_obj::reader_startuphook (UNUSED_LOCATION_ARGS) const {
  return mAttribute_startuphook ;
}

//---------------------------------------------------------------------------*

GALGASap_basic_5F_type GALGAS_os_5F_obj::reader_shutdownhook (UNUSED_LOCATION_ARGS) const {
  return mAttribute_shutdownhook ;
}

//---------------------------------------------------------------------------*

GALGASap_basic_5F_type GALGAS_os_5F_obj::reader_errorhook (UNUSED_LOCATION_ARGS) const {
  return mAttribute_errorhook ;
}

//---------------------------------------------------------------------------*

GALGASap_basic_5F_type GALGAS_os_5F_obj::reader_pretaskhook (UNUSED_LOCATION_ARGS) const {
  return mAttribute_pretaskhook ;
}

//---------------------------------------------------------------------------*

GALGASap_basic_5F_type GALGAS_os_5F_obj::reader_posttaskhook (UNUSED_LOCATION_ARGS) const {
  return mAttribute_posttaskhook ;
}

//---------------------------------------------------------------------------*

GALGASap_basic_5F_type GALGAS_os_5F_obj::reader_protectionhook (UNUSED_LOCATION_ARGS) const {
  return mAttribute_protectionhook ;
}

//---------------------------------------------------------------------------*

GALGASap_lstring GALGAS_os_5F_obj::reader_scalabilityclass (UNUSED_LOCATION_ARGS) const {
  return mAttribute_scalabilityclass ;
}

//---------------------------------------------------------------------------*

GALGASap_basic_5F_type GALGAS_os_5F_obj::reader_stackmonitoring (UNUSED_LOCATION_ARGS) const {
  return mAttribute_stackmonitoring ;
}

//---------------------------------------------------------------------------*

GALGASap_basic_5F_type GALGAS_os_5F_obj::reader_usegetserviceid (UNUSED_LOCATION_ARGS) const {
  return mAttribute_usegetserviceid ;
}

//---------------------------------------------------------------------------*

GALGASap_basic_5F_type GALGAS_os_5F_obj::reader_useparameteraccess (UNUSED_LOCATION_ARGS) const {
  return mAttribute_useparameteraccess ;
}

//---------------------------------------------------------------------------*

GALGASap_basic_5F_type GALGAS_os_5F_obj::reader_useresscheduler (UNUSED_LOCATION_ARGS) const {
  return mAttribute_useresscheduler ;
}

//---------------------------------------------------------------------------*

GALGASap_basic_5F_type GALGAS_os_5F_obj::reader_systemcall (UNUSED_LOCATION_ARGS) const {
  return mAttribute_systemcall ;
}

//---------------------------------------------------------------------------*

GALGASap_basic_5F_type GALGAS_os_5F_obj::reader_debug (UNUSED_LOCATION_ARGS) const {
  return mAttribute_debug ;
}

//---------------------------------------------------------------------------*

GALGASap_basic_5F_type GALGAS_os_5F_obj::reader_memmap (UNUSED_LOCATION_ARGS) const {
  return mAttribute_memmap ;
}

//---------------------------------------------------------------------------*

GALGASap_lstringlist GALGAS_os_5F_obj::reader_app_5F_src (UNUSED_LOCATION_ARGS) const {
  return mAttribute_app_5F_src ;
}

//---------------------------------------------------------------------------*

GALGASap_lstring GALGAS_os_5F_obj::reader_compiler (UNUSED_LOCATION_ARGS) const {
  return mAttribute_compiler ;
}

//---------------------------------------------------------------------------*

GALGASap_lstring GALGAS_os_5F_obj::reader_assembler (UNUSED_LOCATION_ARGS) const {
  return mAttribute_assembler ;
}

//---------------------------------------------------------------------------*

GALGASap_lstring GALGAS_os_5F_obj::reader_linker (UNUSED_LOCATION_ARGS) const {
  return mAttribute_linker ;
}

//---------------------------------------------------------------------------*

GALGASap_lstringlist GALGAS_os_5F_obj::reader_cflags (UNUSED_LOCATION_ARGS) const {
  return mAttribute_cflags ;
}

//---------------------------------------------------------------------------*

GALGASap_lstringlist GALGAS_os_5F_obj::reader_asflags (UNUSED_LOCATION_ARGS) const {
  return mAttribute_asflags ;
}

//---------------------------------------------------------------------------*

GALGASap_lstringlist GALGAS_os_5F_obj::reader_ldflags (UNUSED_LOCATION_ARGS) const {
  return mAttribute_ldflags ;
}

//---------------------------------------------------------------------------*

GALGASap_lstring GALGAS_os_5F_obj::reader_app_5F_name (UNUSED_LOCATION_ARGS) const {
  return mAttribute_app_5F_name ;
}

//---------------------------------------------------------------------------*

GALGASap_lstring GALGAS_os_5F_obj::reader_tpl_5F_base_5F_path (UNUSED_LOCATION_ARGS) const {
  return mAttribute_tpl_5F_base_5F_path ;
}

//---------------------------------------------------------------------------*

GALGASap_trace GALGAS_os_5F_obj::reader_trace (UNUSED_LOCATION_ARGS) const {
  return mAttribute_trace ;
}

//---------------------------------------------------------------------------*

GALGASap_ident_5F_map GALGAS_os_5F_obj::reader_others (UNUSED_LOCATION_ARGS) const {
  return mAttribute_others ;
}

//---------------------------------------------------------------------------*

void GALGAS_os_5F_obj::modifier_setDesc (GALGASap_lstring inValue
                                         COMMA_UNUSED_LOCATION_ARGS) {
  mAttribute_desc = inValue ;
}

//---------------------------------------------------------------------------*

void GALGAS_os_5F_obj::modifier_setStatus (GALGASap_lstring inValue
                                           COMMA_UNUSED_LOCATION_ARGS) {
  mAttribute_status = inValue ;
}

//---------------------------------------------------------------------------*

void GALGAS_os_5F_obj::modifier_setStartuphook (GALGASap_basic_5F_type inValue
                                                COMMA_UNUSED_LOCATION_ARGS) {
  mAttribute_startuphook = inValue ;
}

//---------------------------------------------------------------------------*

void GALGAS_os_5F_obj::modifier_setShutdownhook (GALGASap_basic_5F_type inValue
                                                 COMMA_UNUSED_LOCATION_ARGS) {
  mAttribute_shutdownhook = inValue ;
}

//---------------------------------------------------------------------------*

void GALGAS_os_5F_obj::modifier_setErrorhook (GALGASap_basic_5F_type inValue
                                              COMMA_UNUSED_LOCATION_ARGS) {
  mAttribute_errorhook = inValue ;
}

//---------------------------------------------------------------------------*

void GALGAS_os_5F_obj::modifier_setPretaskhook (GALGASap_basic_5F_type inValue
                                                COMMA_UNUSED_LOCATION_ARGS) {
  mAttribute_pretaskhook = inValue ;
}

//---------------------------------------------------------------------------*

void GALGAS_os_5F_obj::modifier_setPosttaskhook (GALGASap_basic_5F_type inValue
                                                 COMMA_UNUSED_LOCATION_ARGS) {
  mAttribute_posttaskhook = inValue ;
}

//---------------------------------------------------------------------------*

void GALGAS_os_5F_obj::modifier_setProtectionhook (GALGASap_basic_5F_type inValue
                                                   COMMA_UNUSED_LOCATION_ARGS) {
  mAttribute_protectionhook = inValue ;
}

//---------------------------------------------------------------------------*

void GALGAS_os_5F_obj::modifier_setScalabilityclass (GALGASap_lstring inValue
                                                     COMMA_UNUSED_LOCATION_ARGS) {
  mAttribute_scalabilityclass = inValue ;
}

//---------------------------------------------------------------------------*

void GALGAS_os_5F_obj::modifier_setStackmonitoring (GALGASap_basic_5F_type inValue
                                                    COMMA_UNUSED_LOCATION_ARGS) {
  mAttribute_stackmonitoring = inValue ;
}

//---------------------------------------------------------------------------*

void GALGAS_os_5F_obj::modifier_setUsegetserviceid (GALGASap_basic_5F_type inValue
                                                    COMMA_UNUSED_LOCATION_ARGS) {
  mAttribute_usegetserviceid = inValue ;
}

//---------------------------------------------------------------------------*

void GALGAS_os_5F_obj::modifier_setUseparameteraccess (GALGASap_basic_5F_type inValue
                                                       COMMA_UNUSED_LOCATION_ARGS) {
  mAttribute_useparameteraccess = inValue ;
}

//---------------------------------------------------------------------------*

void GALGAS_os_5F_obj::modifier_setUseresscheduler (GALGASap_basic_5F_type inValue
                                                    COMMA_UNUSED_LOCATION_ARGS) {
  mAttribute_useresscheduler = inValue ;
}

//---------------------------------------------------------------------------*

void GALGAS_os_5F_obj::modifier_setSystemcall (GALGASap_basic_5F_type inValue
                                               COMMA_UNUSED_LOCATION_ARGS) {
  mAttribute_systemcall = inValue ;
}

//---------------------------------------------------------------------------*

void GALGAS_os_5F_obj::modifier_setDebug (GALGASap_basic_5F_type inValue
                                          COMMA_UNUSED_LOCATION_ARGS) {
  mAttribute_debug = inValue ;
}

//---------------------------------------------------------------------------*

void GALGAS_os_5F_obj::modifier_setMemmap (GALGASap_basic_5F_type inValue
                                           COMMA_UNUSED_LOCATION_ARGS) {
  mAttribute_memmap = inValue ;
}

//---------------------------------------------------------------------------*

void GALGAS_os_5F_obj::modifier_setApp_5F_src (GALGASap_lstringlist inValue
                                               COMMA_UNUSED_LOCATION_ARGS) {
  mAttribute_app_5F_src = inValue ;
}

//---------------------------------------------------------------------------*

void GALGAS_os_5F_obj::modifier_setCompiler (GALGASap_lstring inValue
                                             COMMA_UNUSED_LOCATION_ARGS) {
  mAttribute_compiler = inValue ;
}

//---------------------------------------------------------------------------*

void GALGAS_os_5F_obj::modifier_setAssembler (GALGASap_lstring inValue
                                              COMMA_UNUSED_LOCATION_ARGS) {
  mAttribute_assembler = inValue ;
}

//---------------------------------------------------------------------------*

void GALGAS_os_5F_obj::modifier_setLinker (GALGASap_lstring inValue
                                           COMMA_UNUSED_LOCATION_ARGS) {
  mAttribute_linker = inValue ;
}

//---------------------------------------------------------------------------*

void GALGAS_os_5F_obj::modifier_setCflags (GALGASap_lstringlist inValue
                                           COMMA_UNUSED_LOCATION_ARGS) {
  mAttribute_cflags = inValue ;
}

//---------------------------------------------------------------------------*

void GALGAS_os_5F_obj::modifier_setAsflags (GALGASap_lstringlist inValue
                                            COMMA_UNUSED_LOCATION_ARGS) {
  mAttribute_asflags = inValue ;
}

//---------------------------------------------------------------------------*

void GALGAS_os_5F_obj::modifier_setLdflags (GALGASap_lstringlist inValue
                                            COMMA_UNUSED_LOCATION_ARGS) {
  mAttribute_ldflags = inValue ;
}

//---------------------------------------------------------------------------*

void GALGAS_os_5F_obj::modifier_setApp_5F_name (GALGASap_lstring inValue
                                                COMMA_UNUSED_LOCATION_ARGS) {
  mAttribute_app_5F_name = inValue ;
}

//---------------------------------------------------------------------------*

void GALGAS_os_5F_obj::modifier_setTpl_5F_base_5F_path (GALGASap_lstring inValue
                                                        COMMA_UNUSED_LOCATION_ARGS) {
  mAttribute_tpl_5F_base_5F_path = inValue ;
}

//---------------------------------------------------------------------------*

void GALGAS_os_5F_obj::modifier_setTrace (GALGASap_trace inValue
                                          COMMA_UNUSED_LOCATION_ARGS) {
  mAttribute_trace = inValue ;
}

//---------------------------------------------------------------------------*

void GALGAS_os_5F_obj::modifier_setOthers (GALGASap_ident_5F_map inValue
                                           COMMA_UNUSED_LOCATION_ARGS) {
  mAttribute_others = inValue ;
}

//---------------------------------------------------------------------------*
//                                                                           *
//                            @os_obj class type                             *
//                                                                           *
//---------------------------------------------------------------------------*

const C_galgas_type_descriptor
kTypeDescriptor_GALGAS_os_5F_obj ("os_obj",
                                  & kTypeDescriptor_GALGAS_oil_5F_obj) ;


//---------------------------------------------------------------------------*

const C_galgas_type_descriptor * GALGAS_os_5F_obj::typeDescriptor (void) const {
  return & kTypeDescriptor_GALGAS_os_5F_obj ;
}
//---------------------------------------------------------------------------*

void GALGASap_os_5F_obj::modifierCall_setApp_5F_name (GALGASap_lstring inArgument0
                                                      COMMA_LOCATION_ARGS) {
//--- Release 'output' arguments
//---
  if (isValid ()) {
    insulate (THERE) ;
    ptr (HERE)->modifier_setApp_5F_name (inArgument0 COMMA_THERE) ;
  }
}

//---------------------------------------------------------------------------*

void GALGASap_os_5F_obj::modifierCall_setApp_5F_src (GALGASap_lstringlist inArgument0
                                                     COMMA_LOCATION_ARGS) {
//--- Release 'output' arguments
//---
  if (isValid ()) {
    insulate (THERE) ;
    ptr (HERE)->modifier_setApp_5F_src (inArgument0 COMMA_THERE) ;
  }
}

//---------------------------------------------------------------------------*

void GALGASap_os_5F_obj::modifierCall_setAsflags (GALGASap_lstringlist inArgument0
                                                  COMMA_LOCATION_ARGS) {
//--- Release 'output' arguments
//---
  if (isValid ()) {
    insulate (THERE) ;
    ptr (HERE)->modifier_setAsflags (inArgument0 COMMA_THERE) ;
  }
}

//---------------------------------------------------------------------------*

void GALGASap_os_5F_obj::modifierCall_setAssembler (GALGASap_lstring inArgument0
                                                    COMMA_LOCATION_ARGS) {
//--- Release 'output' arguments
//---
  if (isValid ()) {
    insulate (THERE) ;
    ptr (HERE)->modifier_setAssembler (inArgument0 COMMA_THERE) ;
  }
}

//---------------------------------------------------------------------------*

void GALGASap_os_5F_obj::modifierCall_setCflags (GALGASap_lstringlist inArgument0
                                                 COMMA_LOCATION_ARGS) {
//--- Release 'output' arguments
//---
  if (isValid ()) {
    insulate (THERE) ;
    ptr (HERE)->modifier_setCflags (inArgument0 COMMA_THERE) ;
  }
}

//---------------------------------------------------------------------------*

void GALGASap_os_5F_obj::modifierCall_setCompiler (GALGASap_lstring inArgument0
                                                   COMMA_LOCATION_ARGS) {
//--- Release 'output' arguments
//---
  if (isValid ()) {
    insulate (THERE) ;
    ptr (HERE)->modifier_setCompiler (inArgument0 COMMA_THERE) ;
  }
}

//---------------------------------------------------------------------------*

void GALGASap_os_5F_obj::modifierCall_setDebug (GALGASap_basic_5F_type inArgument0
                                                COMMA_LOCATION_ARGS) {
//--- Release 'output' arguments
//---
  if (isValid ()) {
    insulate (THERE) ;
    ptr (HERE)->modifier_setDebug (inArgument0 COMMA_THERE) ;
  }
}

//---------------------------------------------------------------------------*

void GALGASap_os_5F_obj::modifierCall_setDesc (GALGASap_lstring inArgument0
                                               COMMA_LOCATION_ARGS) {
//--- Release 'output' arguments
//---
  if (isValid ()) {
    insulate (THERE) ;
    ptr (HERE)->modifier_setDesc (inArgument0 COMMA_THERE) ;
  }
}

//---------------------------------------------------------------------------*

void GALGASap_os_5F_obj::modifierCall_setErrorhook (GALGASap_basic_5F_type inArgument0
                                                    COMMA_LOCATION_ARGS) {
//--- Release 'output' arguments
//---
  if (isValid ()) {
    insulate (THERE) ;
    ptr (HERE)->modifier_setErrorhook (inArgument0 COMMA_THERE) ;
  }
}

//---------------------------------------------------------------------------*

void GALGASap_os_5F_obj::modifierCall_setLdflags (GALGASap_lstringlist inArgument0
                                                  COMMA_LOCATION_ARGS) {
//--- Release 'output' arguments
//---
  if (isValid ()) {
    insulate (THERE) ;
    ptr (HERE)->modifier_setLdflags (inArgument0 COMMA_THERE) ;
  }
}

//---------------------------------------------------------------------------*

void GALGASap_os_5F_obj::modifierCall_setLinker (GALGASap_lstring inArgument0
                                                 COMMA_LOCATION_ARGS) {
//--- Release 'output' arguments
//---
  if (isValid ()) {
    insulate (THERE) ;
    ptr (HERE)->modifier_setLinker (inArgument0 COMMA_THERE) ;
  }
}

//---------------------------------------------------------------------------*

void GALGASap_os_5F_obj::modifierCall_setMemmap (GALGASap_basic_5F_type inArgument0
                                                 COMMA_LOCATION_ARGS) {
//--- Release 'output' arguments
//---
  if (isValid ()) {
    insulate (THERE) ;
    ptr (HERE)->modifier_setMemmap (inArgument0 COMMA_THERE) ;
  }
}

//---------------------------------------------------------------------------*

void GALGASap_os_5F_obj::modifierCall_setOthers (GALGASap_ident_5F_map inArgument0
                                                 COMMA_LOCATION_ARGS) {
//--- Release 'output' arguments
//---
  if (isValid ()) {
    insulate (THERE) ;
    ptr (HERE)->modifier_setOthers (inArgument0 COMMA_THERE) ;
  }
}

//---------------------------------------------------------------------------*

void GALGASap_os_5F_obj::modifierCall_setPosttaskhook (GALGASap_basic_5F_type inArgument0
                                                       COMMA_LOCATION_ARGS) {
//--- Release 'output' arguments
//---
  if (isValid ()) {
    insulate (THERE) ;
    ptr (HERE)->modifier_setPosttaskhook (inArgument0 COMMA_THERE) ;
  }
}

//---------------------------------------------------------------------------*

void GALGASap_os_5F_obj::modifierCall_setPretaskhook (GALGASap_basic_5F_type inArgument0
                                                      COMMA_LOCATION_ARGS) {
//--- Release 'output' arguments
//---
  if (isValid ()) {
    insulate (THERE) ;
    ptr (HERE)->modifier_setPretaskhook (inArgument0 COMMA_THERE) ;
  }
}

//---------------------------------------------------------------------------*

void GALGASap_os_5F_obj::modifierCall_setProtectionhook (GALGASap_basic_5F_type inArgument0
                                                         COMMA_LOCATION_ARGS) {
//--- Release 'output' arguments
//---
  if (isValid ()) {
    insulate (THERE) ;
    ptr (HERE)->modifier_setProtectionhook (inArgument0 COMMA_THERE) ;
  }
}

//---------------------------------------------------------------------------*

void GALGASap_os_5F_obj::modifierCall_setScalabilityclass (GALGASap_lstring inArgument0
                                                           COMMA_LOCATION_ARGS) {
//--- Release 'output' arguments
//---
  if (isValid ()) {
    insulate (THERE) ;
    ptr (HERE)->modifier_setScalabilityclass (inArgument0 COMMA_THERE) ;
  }
}

//---------------------------------------------------------------------------*

void GALGASap_os_5F_obj::modifierCall_setShutdownhook (GALGASap_basic_5F_type inArgument0
                                                       COMMA_LOCATION_ARGS) {
//--- Release 'output' arguments
//---
  if (isValid ()) {
    insulate (THERE) ;
    ptr (HERE)->modifier_setShutdownhook (inArgument0 COMMA_THERE) ;
  }
}

//---------------------------------------------------------------------------*

void GALGASap_os_5F_obj::modifierCall_setStackmonitoring (GALGASap_basic_5F_type inArgument0
                                                          COMMA_LOCATION_ARGS) {
//--- Release 'output' arguments
//---
  if (isValid ()) {
    insulate (THERE) ;
    ptr (HERE)->modifier_setStackmonitoring (inArgument0 COMMA_THERE) ;
  }
}

//---------------------------------------------------------------------------*

void GALGASap_os_5F_obj::modifierCall_setStartuphook (GALGASap_basic_5F_type inArgument0
                                                      COMMA_LOCATION_ARGS) {
//--- Release 'output' arguments
//---
  if (isValid ()) {
    insulate (THERE) ;
    ptr (HERE)->modifier_setStartuphook (inArgument0 COMMA_THERE) ;
  }
}

//---------------------------------------------------------------------------*

void GALGASap_os_5F_obj::modifierCall_setStatus (GALGASap_lstring inArgument0
                                                 COMMA_LOCATION_ARGS) {
//--- Release 'output' arguments
//---
  if (isValid ()) {
    insulate (THERE) ;
    ptr (HERE)->modifier_setStatus (inArgument0 COMMA_THERE) ;
  }
}

//---------------------------------------------------------------------------*

void GALGASap_os_5F_obj::modifierCall_setSystemcall (GALGASap_basic_5F_type inArgument0
                                                     COMMA_LOCATION_ARGS) {
//--- Release 'output' arguments
//---
  if (isValid ()) {
    insulate (THERE) ;
    ptr (HERE)->modifier_setSystemcall (inArgument0 COMMA_THERE) ;
  }
}

//---------------------------------------------------------------------------*

void GALGASap_os_5F_obj::modifierCall_setTpl_5F_base_5F_path (GALGASap_lstring inArgument0
                                                              COMMA_LOCATION_ARGS) {
//--- Release 'output' arguments
//---
  if (isValid ()) {
    insulate (THERE) ;
    ptr (HERE)->modifier_setTpl_5F_base_5F_path (inArgument0 COMMA_THERE) ;
  }
}

//---------------------------------------------------------------------------*

void GALGASap_os_5F_obj::modifierCall_setTrace (GALGASap_trace inArgument0
                                                COMMA_LOCATION_ARGS) {
//--- Release 'output' arguments
//---
  if (isValid ()) {
    insulate (THERE) ;
    ptr (HERE)->modifier_setTrace (inArgument0 COMMA_THERE) ;
  }
}

//---------------------------------------------------------------------------*

void GALGASap_os_5F_obj::modifierCall_setUsegetserviceid (GALGASap_basic_5F_type inArgument0
                                                          COMMA_LOCATION_ARGS) {
//--- Release 'output' arguments
//---
  if (isValid ()) {
    insulate (THERE) ;
    ptr (HERE)->modifier_setUsegetserviceid (inArgument0 COMMA_THERE) ;
  }
}

//---------------------------------------------------------------------------*

void GALGASap_os_5F_obj::modifierCall_setUseparameteraccess (GALGASap_basic_5F_type inArgument0
                                                             COMMA_LOCATION_ARGS) {
//--- Release 'output' arguments
//---
  if (isValid ()) {
    insulate (THERE) ;
    ptr (HERE)->modifier_setUseparameteraccess (inArgument0 COMMA_THERE) ;
  }
}

//---------------------------------------------------------------------------*

void GALGASap_os_5F_obj::modifierCall_setUseresscheduler (GALGASap_basic_5F_type inArgument0
                                                          COMMA_LOCATION_ARGS) {
//--- Release 'output' arguments
//---
  if (isValid ()) {
    insulate (THERE) ;
    ptr (HERE)->modifier_setUseresscheduler (inArgument0 COMMA_THERE) ;
  }
}

//---------------------------------------------------------------------------*
//                                                                           *
//                        Function 'applicationName'                         *
//                                                                           *
//---------------------------------------------------------------------------*

GALGASap_lstring function_applicationName (GALGASap_os_5F_obj & constinArgument_os,
                                           C_Compiler * inCompiler
                                           COMMA_UNUSED_LOCATION_ARGS) {
  GALGASap_lstring result_lstring ; // Returned variable
  //-------- @assignmentInstructionForGeneration
  //--- @readerCallExpressionForGeneration
  GALGASap_lstring temp_0 (constinArgument_os.readerCall_app_5F_name (SOURCE_FILE_AT_LINE (212))) ;
  result_lstring = temp_0 ;
  //-------- @ifInstructionForGeneration
  //--- @equalExpressionForGeneration
  //--- @readerCallExpressionForGeneration
  GALGASap_string temp_1 (result_lstring.readerCall_string (SOURCE_FILE_AT_LINE (213))) ;
  //--- @literalStringExpressionForGeneration
  GALGASap_string temp_2 ("" COMMA_SOURCE_FILE_AT_LINE (213)) ;
  GALGASap_bool temp_3 (kIsEqual, GALGASap_string::objectCompare (temp_1, temp_2) COMMA_SOURCE_FILE_AT_LINE (213)) ;
  if (isValidAndTrue (temp_3)) {
    //-------- @assignmentInstructionForGeneration
    //--- @functionCallExpressionForGeneration
    //--- @literalStringExpressionForGeneration
    GALGASap_string temp_4 ("trampoline" COMMA_SOURCE_FILE_AT_LINE (214)) ;
    GALGASap_lstring temp_5 (function_lstringWith (temp_4, inCompiler COMMA_SOURCE_FILE_AT_LINE (214))) ;
    result_lstring = temp_5 ;
  }
//---
  return result_lstring ;
}


//---------------------------------------------------------------------------*
//  Introspection                                                            *
//---------------------------------------------------------------------------*

static const C_galgas_type_descriptor * functionArgs_applicationName [2] = {
  & kTypeDescriptor_GALGAS_os_5F_obj,
  NULL
} ;

//---------------------------------------------------------------------------*

static GALGASap_object functionWithGenericHeader_applicationName (C_Compiler * inCompiler,
                                                                  cRootObjectArray & inEffectiveParameterArray,
                                                                  const GALGASap_location & inErrorLocation
                                                                  COMMA_LOCATION_ARGS) {
  const bool ok = inCompiler->checkFunctionCallArguments ("applicationName",
                                                          1,
                                                          functionArgs_applicationName,
                                                          inEffectiveParameterArray,
                                                          inErrorLocation
                                                          COMMA_THERE) ;
  GALGASap_object result ;
  if (ok) {
    GALGASap_os_5F_obj operand0 = inEffectiveParameterArray.objectAtIndex (0 COMMA_THERE) ;
    result = function_applicationName (operand0, inCompiler COMMA_THERE).embedObject () ;
  }
  return result ;
}

//---------------------------------------------------------------------------*

C_galgas_function_descriptor functionDescriptor_applicationName ("applicationName",
                                                                 functionWithGenericHeader_applicationName,
                                                                 & kTypeDescriptor_GALGAS_lstring,
                                                                 1,
                                                                 functionArgs_applicationName) ;


//---------------------------------------------------------------------------*
//                                                                           *
//                       Function 'memory_protection'                        *
//                                                                           *
//---------------------------------------------------------------------------*

GALGASap_basic_5F_type function_memory_5F_protection (GALGASap_os_5F_obj & inArgument_os,
                                                      C_Compiler * inCompiler
                                                      COMMA_UNUSED_LOCATION_ARGS) {
  GALGASap_basic_5F_type result_basic_5F_type ; // Returned variable
  //-------- @structuredCastInstructionForGeneration
  //--- @readerCallExpressionForGeneration
  GALGASap_basic_5F_type temp_0 (inArgument_os.readerCall_memmap (SOURCE_FILE_AT_LINE (222))) ;
  if (temp_0.isValid ()) {
    if (temp_0.ptr (HERE)->typeDescriptor () == & kTypeDescriptor_GALGAS_memmap_5F_true) {
    GALGASap_memmap_5F_true cast_5838_mm = temp_0 ;
      //-------- @assignmentInstructionForGeneration
      //--- @readerCallExpressionForGeneration
      GALGASap_basic_5F_type temp_1 (cast_5838_mm.readerCall_memory_5F_prot (SOURCE_FILE_AT_LINE (224))) ;
      result_basic_5F_type = temp_1 ;
    }else{
      //-------- @assignmentInstructionForGeneration
      GALGASap_location temp_2 (inCompiler->here (SOURCE_FILE_AT_LINE (226))) ;
      //--- @falseExpressionForGeneration
      GALGASap_bool temp_3 (false COMMA_SOURCE_FILE_AT_LINE (226)) ;
      GALGASap_bool_5F_class temp_4 (GALGASap_bool_5F_class::constructor_new (temp_2, temp_3 COMMA_SOURCE_FILE_AT_LINE (226))) ;
      result_basic_5F_type = temp_4 ;
    }
  }
//---
  return result_basic_5F_type ;
}


//---------------------------------------------------------------------------*
//  Introspection                                                            *
//---------------------------------------------------------------------------*

static const C_galgas_type_descriptor * functionArgs_memory_5F_protection [2] = {
  & kTypeDescriptor_GALGAS_os_5F_obj,
  NULL
} ;

//---------------------------------------------------------------------------*

static GALGASap_object functionWithGenericHeader_memory_5F_protection (C_Compiler * inCompiler,
                                                                       cRootObjectArray & inEffectiveParameterArray,
                                                                       const GALGASap_location & inErrorLocation
                                                                       COMMA_LOCATION_ARGS) {
  const bool ok = inCompiler->checkFunctionCallArguments ("memory_protection",
                                                          1,
                                                          functionArgs_memory_5F_protection,
                                                          inEffectiveParameterArray,
                                                          inErrorLocation
                                                          COMMA_THERE) ;
  GALGASap_object result ;
  if (ok) {
    GALGASap_os_5F_obj operand0 = inEffectiveParameterArray.objectAtIndex (0 COMMA_THERE) ;
    result = function_memory_5F_protection (operand0, inCompiler COMMA_THERE).embedObject () ;
  }
  return result ;
}

//---------------------------------------------------------------------------*

C_galgas_function_descriptor functionDescriptor_memory_5F_protection ("memory_protection",
                                                                      functionWithGenericHeader_memory_5F_protection,
                                                                      & kTypeDescriptor_GALGAS_basic_5F_type,
                                                                      1,
                                                                      functionArgs_memory_5F_protection) ;


//---------------------------------------------------------------------------*
//                                                                           *
//                      Function 'memory_protection_on'                      *
//                                                                           *
//---------------------------------------------------------------------------*

GALGASap_bool function_memory_5F_protection_5F_on (GALGASap_os_5F_obj & inArgument_os,
                                                   C_Compiler * /* inCompiler */
                                                   COMMA_UNUSED_LOCATION_ARGS) {
  GALGASap_bool result_bool ; // Returned variable
  //-------- @structuredCastInstructionForGeneration
  //--- @readerCallExpressionForGeneration
  GALGASap_basic_5F_type temp_0 (inArgument_os.readerCall_memmap (SOURCE_FILE_AT_LINE (234))) ;
  if (temp_0.isValid ()) {
    if (temp_0.ptr (HERE)->typeDescriptor () == & kTypeDescriptor_GALGAS_memmap_5F_true) {
    GALGASap_memmap_5F_true cast_6051_mm = temp_0 ;
      //-------- @structuredCastInstructionForGeneration
      //--- @readerCallExpressionForGeneration
      GALGASap_basic_5F_type temp_1 (cast_6051_mm.readerCall_memory_5F_prot (SOURCE_FILE_AT_LINE (236))) ;
      if (temp_1.isValid ()) {
        if (temp_1.ptr (HERE)->typeDescriptor () == & kTypeDescriptor_GALGAS_bool_5F_class) {
        GALGASap_bool_5F_class cast_6108_b = temp_1 ;
          //-------- @assignmentInstructionForGeneration
          //--- @readerCallExpressionForGeneration
          GALGASap_bool temp_2 (cast_6108_b.readerCall_value (SOURCE_FILE_AT_LINE (238))) ;
          result_bool = temp_2 ;
        }else{
          //-------- @assignmentInstructionForGeneration
          //--- @falseExpressionForGeneration
          GALGASap_bool temp_3 (false COMMA_SOURCE_FILE_AT_LINE (240)) ;
          result_bool = temp_3 ;
        }
      }
    }else{
      //-------- @assignmentInstructionForGeneration
      //--- @falseExpressionForGeneration
      GALGASap_bool temp_4 (false COMMA_SOURCE_FILE_AT_LINE (243)) ;
      result_bool = temp_4 ;
    }
  }
//---
  return result_bool ;
}


//---------------------------------------------------------------------------*
//  Introspection                                                            *
//---------------------------------------------------------------------------*

static const C_galgas_type_descriptor * functionArgs_memory_5F_protection_5F_on [2] = {
  & kTypeDescriptor_GALGAS_os_5F_obj,
  NULL
} ;

//---------------------------------------------------------------------------*

static GALGASap_object functionWithGenericHeader_memory_5F_protection_5F_on (C_Compiler * inCompiler,
                                                                             cRootObjectArray & inEffectiveParameterArray,
                                                                             const GALGASap_location & inErrorLocation
                                                                             COMMA_LOCATION_ARGS) {
  const bool ok = inCompiler->checkFunctionCallArguments ("memory_protection_on",
                                                          1,
                                                          functionArgs_memory_5F_protection_5F_on,
                                                          inEffectiveParameterArray,
                                                          inErrorLocation
                                                          COMMA_THERE) ;
  GALGASap_object result ;
  if (ok) {
    GALGASap_os_5F_obj operand0 = inEffectiveParameterArray.objectAtIndex (0 COMMA_THERE) ;
    result = function_memory_5F_protection_5F_on (operand0, inCompiler COMMA_THERE).embedObject () ;
  }
  return result ;
}

//---------------------------------------------------------------------------*

C_galgas_function_descriptor functionDescriptor_memory_5F_protection_5F_on ("memory_protection_on",
                                                                            functionWithGenericHeader_memory_5F_protection_5F_on,
                                                                            & kTypeDescriptor_GALGAS_bool,
                                                                            1,
                                                                            functionArgs_memory_5F_protection_5F_on) ;


//---------------------------------------------------------------------------*
//                                                                           *
//                         Function 'memory_mapping'                         *
//                                                                           *
//---------------------------------------------------------------------------*

GALGASap_bool function_memory_5F_mapping (GALGASap_os_5F_obj & inArgument_os,
                                          C_Compiler * /* inCompiler */
                                          COMMA_UNUSED_LOCATION_ARGS) {
  GALGASap_bool result_bool ; // Returned variable
  //-------- @structuredCastInstructionForGeneration
  //--- @readerCallExpressionForGeneration
  GALGASap_basic_5F_type temp_0 (inArgument_os.readerCall_memmap (SOURCE_FILE_AT_LINE (251))) ;
  if (temp_0.isValid ()) {
    if (temp_0.ptr (HERE)->typeDescriptor () == & kTypeDescriptor_GALGAS_memmap_5F_true) {
      //-------- @assignmentInstructionForGeneration
      //--- @trueExpressionForGeneration
      GALGASap_bool temp_1 (true COMMA_SOURCE_FILE_AT_LINE (253)) ;
      result_bool = temp_1 ;
    }else{
      //-------- @assignmentInstructionForGeneration
      //--- @falseExpressionForGeneration
      GALGASap_bool temp_2 (false COMMA_SOURCE_FILE_AT_LINE (255)) ;
      result_bool = temp_2 ;
    }
  }
//---
  return result_bool ;
}


//---------------------------------------------------------------------------*
//  Introspection                                                            *
//---------------------------------------------------------------------------*

static const C_galgas_type_descriptor * functionArgs_memory_5F_mapping [2] = {
  & kTypeDescriptor_GALGAS_os_5F_obj,
  NULL
} ;

//---------------------------------------------------------------------------*

static GALGASap_object functionWithGenericHeader_memory_5F_mapping (C_Compiler * inCompiler,
                                                                    cRootObjectArray & inEffectiveParameterArray,
                                                                    const GALGASap_location & inErrorLocation
                                                                    COMMA_LOCATION_ARGS) {
  const bool ok = inCompiler->checkFunctionCallArguments ("memory_mapping",
                                                          1,
                                                          functionArgs_memory_5F_mapping,
                                                          inEffectiveParameterArray,
                                                          inErrorLocation
                                                          COMMA_THERE) ;
  GALGASap_object result ;
  if (ok) {
    GALGASap_os_5F_obj operand0 = inEffectiveParameterArray.objectAtIndex (0 COMMA_THERE) ;
    result = function_memory_5F_mapping (operand0, inCompiler COMMA_THERE).embedObject () ;
  }
  return result ;
}

//---------------------------------------------------------------------------*

C_galgas_function_descriptor functionDescriptor_memory_5F_mapping ("memory_mapping",
                                                                   functionWithGenericHeader_memory_5F_mapping,
                                                                   & kTypeDescriptor_GALGAS_bool,
                                                                   1,
                                                                   functionArgs_memory_5F_mapping) ;


//---------------------------------------------------------------------------*
//                                                                           *
//                            Function 'compiler'                            *
//                                                                           *
//---------------------------------------------------------------------------*

GALGASap_string function_compiler (GALGASap_basic_5F_type & constinArgument_os_5F_memmap,
                                   C_Compiler * inCompiler
                                   COMMA_UNUSED_LOCATION_ARGS) {
  GALGASap_string result_string ; // Returned variable
  //-------- @structuredCastInstructionForGeneration
  if (constinArgument_os_5F_memmap.isValid ()) {
    if (constinArgument_os_5F_memmap.ptr (HERE)->typeDescriptor () == & kTypeDescriptor_GALGAS_memmap_5F_true) {
    GALGASap_memmap_5F_true cast_6599_s = constinArgument_os_5F_memmap ;
      //-------- @assignmentInstructionForGeneration
      //--- @readerCallExpressionForGeneration
      //--- @readerCallExpressionForGeneration
      GALGASap_lstring temp_0 (cast_6599_s.readerCall_compiler (SOURCE_FILE_AT_LINE (269))) ;
      GALGASap_string temp_1 (temp_0.readerCall_string (SOURCE_FILE_AT_LINE (269))) ;
      result_string = temp_1 ;
      //-------- @assignmentInstructionForGeneration
      //--- @concatExpressionForGeneration
      //--- @literalStringExpressionForGeneration
      GALGASap_string temp_2 ("compiler/" COMMA_SOURCE_FILE_AT_LINE (270)) ;
      GALGASap_string temp_3 (temp_2.operator_concat (result_string COMMA_SOURCE_FILE_AT_LINE (270))) ;
      result_string = temp_3 ;
      //-------- @localVariableOrConstantDeclarationWithSourceExpressionForGeneration
      //--- @functionCallExpressionForGeneration
      GALGASap_string temp_4 (function_rootTemplatesDirectory (inCompiler COMMA_SOURCE_FILE_AT_LINE (271))) ;
      GALGASap_string var_rtd (temp_4) ;
      //-------- @ifInstructionForGeneration
      //--- @notEqualExpressionForGeneration
      //--- @literalStringExpressionForGeneration
      GALGASap_string temp_5 ("" COMMA_SOURCE_FILE_AT_LINE (272)) ;
      GALGASap_bool temp_6 (kIsNotEqual, GALGASap_string::objectCompare (var_rtd, temp_5) COMMA_SOURCE_FILE_AT_LINE (272)) ;
      if (isValidAndTrue (temp_6)) {
        //-------- @localVariableOrConstantDeclarationWithSourceExpressionForGeneration
        //--- @concatExpressionForGeneration
        //--- @concatExpressionForGeneration
        //--- @literalStringExpressionForGeneration
        GALGASap_string temp_7 ("/" COMMA_SOURCE_FILE_AT_LINE (273)) ;
        GALGASap_string temp_8 (var_rtd.operator_concat (temp_7 COMMA_SOURCE_FILE_AT_LINE (273))) ;
        GALGASap_string temp_9 (temp_8.operator_concat (result_string COMMA_SOURCE_FILE_AT_LINE (273))) ;
        GALGASap_string var_path (temp_9) ;
        //-------- @ifInstructionForGeneration
        //--- @notExpressionForGeneration
        //--- @readerCallExpressionForGeneration
        GALGASap_bool temp_10 (var_path.readerCall_directoryExists (SOURCE_FILE_AT_LINE (274))) ;
        GALGASap_bool temp_11 (temp_10.operator_not (SOURCE_FILE_AT_LINE (274))) ;
        if (isValidAndTrue (temp_11)) {
          //-------- @warningInstructionForGeneration
          GALGASap_location temp_12 (inCompiler->here (SOURCE_FILE_AT_LINE (275))) ;
          //--- @concatExpressionForGeneration
          //--- @literalStringExpressionForGeneration
          GALGASap_string temp_13 ("no compiler found at path: " COMMA_SOURCE_FILE_AT_LINE (275)) ;
          GALGASap_string temp_14 (temp_13.operator_concat (var_path COMMA_SOURCE_FILE_AT_LINE (275))) ;
          inCompiler->emitSemanticWarning (temp_12, temp_14 COMMA_SOURCE_FILE_AT_LINE (275)) ;
          //-------- @assignmentInstructionForGeneration
          //--- @literalStringExpressionForGeneration
          GALGASap_string temp_15 ("" COMMA_SOURCE_FILE_AT_LINE (276)) ;
          result_string = temp_15 ;
        }
      }else{
        //-------- @assignmentInstructionForGeneration
        //--- @literalStringExpressionForGeneration
        GALGASap_string temp_16 ("" COMMA_SOURCE_FILE_AT_LINE (279)) ;
        result_string = temp_16 ;
      }
    }else{
      //-------- @assignmentInstructionForGeneration
      //--- @literalStringExpressionForGeneration
      GALGASap_string temp_17 ("" COMMA_SOURCE_FILE_AT_LINE (281)) ;
      result_string = temp_17 ;
    }
  }
//---
  return result_string ;
}


//---------------------------------------------------------------------------*
//  Introspection                                                            *
//---------------------------------------------------------------------------*

static const C_galgas_type_descriptor * functionArgs_compiler [2] = {
  & kTypeDescriptor_GALGAS_basic_5F_type,
  NULL
} ;

//---------------------------------------------------------------------------*

static GALGASap_object functionWithGenericHeader_compiler (C_Compiler * inCompiler,
                                                           cRootObjectArray & inEffectiveParameterArray,
                                                           const GALGASap_location & inErrorLocation
                                                           COMMA_LOCATION_ARGS) {
  const bool ok = inCompiler->checkFunctionCallArguments ("compiler",
                                                          1,
                                                          functionArgs_compiler,
                                                          inEffectiveParameterArray,
                                                          inErrorLocation
                                                          COMMA_THERE) ;
  GALGASap_object result ;
  if (ok) {
    GALGASap_basic_5F_type operand0 = inEffectiveParameterArray.objectAtIndex (0 COMMA_THERE) ;
    result = function_compiler (operand0, inCompiler COMMA_THERE).embedObject () ;
  }
  return result ;
}

//---------------------------------------------------------------------------*

C_galgas_function_descriptor functionDescriptor_compiler ("compiler",
                                                          functionWithGenericHeader_compiler,
                                                          & kTypeDescriptor_GALGAS_string,
                                                          1,
                                                          functionArgs_compiler) ;


//---------------------------------------------------------------------------*
//                                                                           *
//                             Function 'linker'                             *
//                                                                           *
//---------------------------------------------------------------------------*

GALGASap_string function_linker (GALGASap_basic_5F_type & constinArgument_os_5F_memmap,
                                 C_Compiler * inCompiler
                                 COMMA_UNUSED_LOCATION_ARGS) {
  GALGASap_string result_string ; // Returned variable
  //-------- @structuredCastInstructionForGeneration
  if (constinArgument_os_5F_memmap.isValid ()) {
    if (constinArgument_os_5F_memmap.ptr (HERE)->typeDescriptor () == & kTypeDescriptor_GALGAS_memmap_5F_true) {
    GALGASap_memmap_5F_true cast_7173_s = constinArgument_os_5F_memmap ;
      //-------- @structuredCastInstructionForGeneration
      //--- @readerCallExpressionForGeneration
      GALGASap_basic_5F_type temp_0 (cast_7173_s.readerCall_linker (SOURCE_FILE_AT_LINE (295))) ;
      if (temp_0.isValid ()) {
        if (temp_0.ptr (HERE)->typeDescriptor () == & kTypeDescriptor_GALGAS_no_5F_linker) {
          //-------- @assignmentInstructionForGeneration
          //--- @literalStringExpressionForGeneration
          GALGASap_string temp_1 ("" COMMA_SOURCE_FILE_AT_LINE (296)) ;
          result_string = temp_1 ;
        }else if (temp_0.ptr (HERE)->typeDescriptor () == & kTypeDescriptor_GALGAS_yes_5F_linker) {
        GALGASap_yes_5F_linker cast_7260_l = temp_0 ;
          //-------- @assignmentInstructionForGeneration
          //--- @readerCallExpressionForGeneration
          //--- @readerCallExpressionForGeneration
          GALGASap_lstring temp_2 (cast_7260_l.readerCall_linker (SOURCE_FILE_AT_LINE (297))) ;
          GALGASap_string temp_3 (temp_2.readerCall_string (SOURCE_FILE_AT_LINE (297))) ;
          result_string = temp_3 ;
        }else{
          //-------- @assignmentInstructionForGeneration
          //--- @literalStringExpressionForGeneration
          GALGASap_string temp_4 ("" COMMA_SOURCE_FILE_AT_LINE (299)) ;
          result_string = temp_4 ;
        }
      }
    }else{
      //-------- @assignmentInstructionForGeneration
      //--- @literalStringExpressionForGeneration
      GALGASap_string temp_5 ("" COMMA_SOURCE_FILE_AT_LINE (301)) ;
      result_string = temp_5 ;
    }
  }
  //-------- @ifInstructionForGeneration
  //--- @notEqualExpressionForGeneration
  //--- @literalStringExpressionForGeneration
  GALGASap_string temp_6 ("" COMMA_SOURCE_FILE_AT_LINE (303)) ;
  GALGASap_bool temp_7 (kIsNotEqual, GALGASap_string::objectCompare (result_string, temp_6) COMMA_SOURCE_FILE_AT_LINE (303)) ;
  if (isValidAndTrue (temp_7)) {
    //-------- @assignmentInstructionForGeneration
    //--- @concatExpressionForGeneration
    //--- @literalStringExpressionForGeneration
    GALGASap_string temp_8 ("linker/" COMMA_SOURCE_FILE_AT_LINE (304)) ;
    GALGASap_string temp_9 (temp_8.operator_concat (result_string COMMA_SOURCE_FILE_AT_LINE (304))) ;
    result_string = temp_9 ;
    //-------- @localVariableOrConstantDeclarationWithSourceExpressionForGeneration
    //--- @functionCallExpressionForGeneration
    GALGASap_string temp_10 (function_rootTemplatesDirectory (inCompiler COMMA_SOURCE_FILE_AT_LINE (305))) ;
    GALGASap_string var_rtd (temp_10) ;
    //-------- @ifInstructionForGeneration
    //--- @notEqualExpressionForGeneration
    //--- @literalStringExpressionForGeneration
    GALGASap_string temp_11 ("" COMMA_SOURCE_FILE_AT_LINE (306)) ;
    GALGASap_bool temp_12 (kIsNotEqual, GALGASap_string::objectCompare (var_rtd, temp_11) COMMA_SOURCE_FILE_AT_LINE (306)) ;
    if (isValidAndTrue (temp_12)) {
      //-------- @localVariableOrConstantDeclarationWithSourceExpressionForGeneration
      //--- @concatExpressionForGeneration
      //--- @concatExpressionForGeneration
      //--- @literalStringExpressionForGeneration
      GALGASap_string temp_13 ("/" COMMA_SOURCE_FILE_AT_LINE (307)) ;
      GALGASap_string temp_14 (var_rtd.operator_concat (temp_13 COMMA_SOURCE_FILE_AT_LINE (307))) ;
      GALGASap_string temp_15 (temp_14.operator_concat (result_string COMMA_SOURCE_FILE_AT_LINE (307))) ;
      GALGASap_string var_path (temp_15) ;
      //-------- @ifInstructionForGeneration
      //--- @notExpressionForGeneration
      //--- @readerCallExpressionForGeneration
      GALGASap_bool temp_16 (var_path.readerCall_directoryExists (SOURCE_FILE_AT_LINE (308))) ;
      GALGASap_bool temp_17 (temp_16.operator_not (SOURCE_FILE_AT_LINE (308))) ;
      if (isValidAndTrue (temp_17)) {
        //-------- @assignmentInstructionForGeneration
        //--- @literalStringExpressionForGeneration
        GALGASap_string temp_18 ("" COMMA_SOURCE_FILE_AT_LINE (309)) ;
        result_string = temp_18 ;
      }
    }else{
      //-------- @assignmentInstructionForGeneration
      //--- @literalStringExpressionForGeneration
      GALGASap_string temp_19 ("" COMMA_SOURCE_FILE_AT_LINE (312)) ;
      result_string = temp_19 ;
    }
  }
//---
  return result_string ;
}


//---------------------------------------------------------------------------*
//  Introspection                                                            *
//---------------------------------------------------------------------------*

static const C_galgas_type_descriptor * functionArgs_linker [2] = {
  & kTypeDescriptor_GALGAS_basic_5F_type,
  NULL
} ;

//---------------------------------------------------------------------------*

static GALGASap_object functionWithGenericHeader_linker (C_Compiler * inCompiler,
                                                         cRootObjectArray & inEffectiveParameterArray,
                                                         const GALGASap_location & inErrorLocation
                                                         COMMA_LOCATION_ARGS) {
  const bool ok = inCompiler->checkFunctionCallArguments ("linker",
                                                          1,
                                                          functionArgs_linker,
                                                          inEffectiveParameterArray,
                                                          inErrorLocation
                                                          COMMA_THERE) ;
  GALGASap_object result ;
  if (ok) {
    GALGASap_basic_5F_type operand0 = inEffectiveParameterArray.objectAtIndex (0 COMMA_THERE) ;
    result = function_linker (operand0, inCompiler COMMA_THERE).embedObject () ;
  }
  return result ;
}

//---------------------------------------------------------------------------*

C_galgas_function_descriptor functionDescriptor_linker ("linker",
                                                        functionWithGenericHeader_linker,
                                                        & kTypeDescriptor_GALGAS_string,
                                                        1,
                                                        functionArgs_linker) ;


//---------------------------------------------------------------------------*
//                                                                           *
//                          Function 'void_os_obj'                           *
//                                                                           *
//---------------------------------------------------------------------------*

GALGASap_os_5F_obj function_void_5F_os_5F_obj (C_Compiler * inCompiler
                                               COMMA_UNUSED_LOCATION_ARGS) {
  GALGASap_os_5F_obj result_os_5F_obj ; // Returned variable
  //-------- @localVariableOrConstantDeclarationWithSourceExpressionForGeneration
  GALGASap_location temp_0 (inCompiler->here (SOURCE_FILE_AT_LINE (320))) ;
  GALGASap_void temp_1 (GALGASap_void::constructor_new (temp_0 COMMA_SOURCE_FILE_AT_LINE (320))) ;
  GALGASap_void var_void_5F_obj (temp_1) ;
  //-------- @localVariableOrConstantDeclarationWithSourceExpressionForGeneration
  //--- @literalStringExpressionForGeneration
  GALGASap_string temp_2 ("" COMMA_SOURCE_FILE_AT_LINE (321)) ;
  GALGASap_location temp_3 (inCompiler->here (SOURCE_FILE_AT_LINE (321))) ;
  GALGASap_lstring temp_4 (GALGASap_lstring::constructor_new (temp_2, temp_3 COMMA_SOURCE_FILE_AT_LINE (321))) ;
  GALGASap_lstring var_emptyString (temp_4) ;
  //-------- @assignmentInstructionForGeneration
  GALGASap_lstringlist temp_5 (GALGASap_lstringlist::constructor_emptyList (SOURCE_FILE_AT_LINE (339))) ;
  GALGASap_lstringlist temp_6 (GALGASap_lstringlist::constructor_emptyList (SOURCE_FILE_AT_LINE (343))) ;
  GALGASap_lstringlist temp_7 (GALGASap_lstringlist::constructor_emptyList (SOURCE_FILE_AT_LINE (344))) ;
  GALGASap_lstringlist temp_8 (GALGASap_lstringlist::constructor_emptyList (SOURCE_FILE_AT_LINE (345))) ;
  GALGASap_location temp_9 (inCompiler->here (SOURCE_FILE_AT_LINE (348))) ;
  GALGASap_trace temp_10 (GALGASap_trace::constructor_new (temp_9 COMMA_SOURCE_FILE_AT_LINE (348))) ;
  GALGASap_ident_5F_map temp_11 (GALGASap_ident_5F_map::constructor_emptyMap (SOURCE_FILE_AT_LINE (349))) ;
  GALGASap_os_5F_obj temp_12 (GALGASap_os_5F_obj::constructor_new (var_emptyString, var_emptyString, var_void_5F_obj, var_void_5F_obj, var_void_5F_obj, var_void_5F_obj, var_void_5F_obj, var_void_5F_obj, var_emptyString, var_void_5F_obj, var_void_5F_obj, var_void_5F_obj, var_void_5F_obj, var_void_5F_obj, var_void_5F_obj, var_void_5F_obj, temp_5, var_emptyString, var_emptyString, var_emptyString, temp_6, temp_7, temp_8, var_emptyString, var_emptyString, temp_10, temp_11 COMMA_SOURCE_FILE_AT_LINE (322))) ;
  result_os_5F_obj = temp_12 ;
//---
  return result_os_5F_obj ;
}


//---------------------------------------------------------------------------*
//  Introspection                                                            *
//---------------------------------------------------------------------------*

static const C_galgas_type_descriptor * functionArgs_void_5F_os_5F_obj [1] = {
  NULL
} ;

//---------------------------------------------------------------------------*

static GALGASap_object functionWithGenericHeader_void_5F_os_5F_obj (C_Compiler * inCompiler,
                                                                    cRootObjectArray & inEffectiveParameterArray,
                                                                    const GALGASap_location & inErrorLocation
                                                                    COMMA_LOCATION_ARGS) {
  const bool ok = inCompiler->checkFunctionCallArguments ("void_os_obj",
                                                          0,
                                                          functionArgs_void_5F_os_5F_obj,
                                                          inEffectiveParameterArray,
                                                          inErrorLocation
                                                          COMMA_THERE) ;
  GALGASap_object result ;
  if (ok) {
    result = function_void_5F_os_5F_obj (inCompiler COMMA_THERE).embedObject () ;
  }
  return result ;
}

//---------------------------------------------------------------------------*

C_galgas_function_descriptor functionDescriptor_void_5F_os_5F_obj ("void_os_obj",
                                                                   functionWithGenericHeader_void_5F_os_5F_obj,
                                                                   & kTypeDescriptor_GALGAS_os_5F_obj,
                                                                   0,
                                                                   functionArgs_void_5F_os_5F_obj) ;


//--- START OF USER ZONE 2


//--- END OF USER ZONE 2


