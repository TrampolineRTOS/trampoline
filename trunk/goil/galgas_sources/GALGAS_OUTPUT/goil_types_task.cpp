//---------------------------------------------------------------------------*
//                                                                           *
//                        File 'goil_types_task.cpp'                         *
//             Generated by version version GALGAS_BETA_VERSION              *
//                    november 17th, 2010, at 19h29'53"                      *
//                                                                           *
//---------------------------------------------------------------------------*

//--- START OF USER ZONE 1


//--- END OF USER ZONE 1

#include "version_libpm.h"
#if CURRENT_LIBPM_VERSION != VERSION_OF_LIBPM_USED_BY_GALGAS_COMPILER
  #error "This file has been compiled with a version of GALGAS that uses libpm version VERSION_OF_LIBPM_USED_BY_GALGAS_COMPILER, different than the current version (CURRENT_LIBPM_VERSION) of libpm"
#endif

//---------------------------------------------------------------------------*

#include "goil_types_task.h"
#include "galgas2/C_Compiler.h"
#include "galgas2/C_galgas_CLI_Options.h"

//---------------------------------------------------------------------------*

#include "goil_options.h"

//---------------------------------------------------------------------------*

#ifndef DO_NOT_GENERATE_CHECKINGS
  #define SOURCE_FILE_AT_LINE(line) "goil_types_task.gSemantics", line
  #define COMMA_SOURCE_FILE_AT_LINE(line) , SOURCE_FILE_AT_LINE(line)
#else
  #define SOURCE_FILE_AT_LINE(line) 
  #define COMMA_SOURCE_FILE_AT_LINE(line) 
#endif

//---------------------------------------------------------------------------*
//                                                                           *
//                         Function 'void_task_obj'                          *
//                                                                           *
//---------------------------------------------------------------------------*

GALGAS_task_5F_obj function_void_5F_task_5F_obj (C_Compiler * inCompiler
                                                 COMMA_UNUSED_LOCATION_ARGS) {
  GALGAS_task_5F_obj result_task_5F_obj ; // Returned variable
  //-------- @localVariableOrConstantDeclarationWithSourceExpressionForGeneration
  GALGAS_void var_void_5F_obj = GALGAS_void::constructor_new (inCompiler->here () COMMA_SOURCE_FILE_AT_LINE (39)) ;
  //-------- @localVariableOrConstantDeclarationWithSourceExpressionForGeneration
  GALGAS_lstring var_emptyString = GALGAS_lstring::constructor_new (GALGAS_string (""), inCompiler->here () COMMA_SOURCE_FILE_AT_LINE (40)) ;
  //-------- @assignmentInstructionForGeneration
  result_task_5F_obj = GALGAS_task_5F_obj::constructor_new (var_emptyString, var_void_5F_obj, var_emptyString, var_void_5F_obj, GALGAS_task_5F_autostart_5F_void::constructor_new (inCompiler->here () COMMA_SOURCE_FILE_AT_LINE (46)), GALGAS_lstringlist::constructor_emptyList (SOURCE_FILE_AT_LINE (47)), GALGAS_lstringlist::constructor_emptyList (SOURCE_FILE_AT_LINE (48)), GALGAS_lstringlist::constructor_emptyList (SOURCE_FILE_AT_LINE (49)), GALGAS_lstringlist::constructor_emptyList (SOURCE_FILE_AT_LINE (50)), GALGAS_void_5F_timing_5F_prot::constructor_new (inCompiler->here () COMMA_SOURCE_FILE_AT_LINE (51)), GALGAS_ident_5F_map::constructor_emptyMap (SOURCE_FILE_AT_LINE (52)) COMMA_SOURCE_FILE_AT_LINE (41)) ;
//---
  return result_task_5F_obj ;
}


//---------------------------------------------------------------------------*
//  Function introspection                                                   *
//---------------------------------------------------------------------------*

static const C_galgas_type_descriptor * functionArgs_void_5F_task_5F_obj [1] = {
  NULL
} ;

//---------------------------------------------------------------------------*

static GALGAS_object functionWithGenericHeader_void_5F_task_5F_obj (C_Compiler * inCompiler,
                                                                    const cObjectArray & /* inEffectiveParameterArray */,
                                                                    const GALGAS_location & /* inErrorLocation */
                                                                    COMMA_LOCATION_ARGS) {
  return function_void_5F_task_5F_obj (inCompiler COMMA_THERE).reader_object (THERE) ;
}

//---------------------------------------------------------------------------*

C_galgas_function_descriptor functionDescriptor_void_5F_task_5F_obj ("void_task_obj",
                                                                     functionWithGenericHeader_void_5F_task_5F_obj,
                                                                     & kTypeDescriptor_GALGAS_task_5F_obj,
                                                                     0,
                                                                     functionArgs_void_5F_task_5F_obj) ;

//---------------------------------------------------------------------------*
//                                                                           *
//                        Function 'default_task_obj'                        *
//                                                                           *
//---------------------------------------------------------------------------*

GALGAS_task_5F_obj function_default_5F_task_5F_obj (C_Compiler * inCompiler
                                                    COMMA_UNUSED_LOCATION_ARGS) {
  GALGAS_task_5F_obj result_task_5F_obj ; // Returned variable
  //-------- @localVariableOrConstantDeclarationWithSourceExpressionForGeneration
  GALGAS_void var_void_5F_obj = GALGAS_void::constructor_new (inCompiler->here () COMMA_SOURCE_FILE_AT_LINE (59)) ;
  //-------- @localVariableOrConstantDeclarationWithSourceExpressionForGeneration
  GALGAS_lstring var_emptyString = GALGAS_lstring::constructor_new (GALGAS_string (""), inCompiler->here () COMMA_SOURCE_FILE_AT_LINE (60)) ;
  //-------- @assignmentInstructionForGeneration
  result_task_5F_obj = GALGAS_task_5F_obj::constructor_new (var_emptyString, var_void_5F_obj, var_emptyString, var_void_5F_obj, GALGAS_task_5F_autostart_5F_false::constructor_new (inCompiler->here () COMMA_SOURCE_FILE_AT_LINE (66)), GALGAS_lstringlist::constructor_emptyList (SOURCE_FILE_AT_LINE (67)), GALGAS_lstringlist::constructor_emptyList (SOURCE_FILE_AT_LINE (68)), GALGAS_lstringlist::constructor_emptyList (SOURCE_FILE_AT_LINE (69)), GALGAS_lstringlist::constructor_emptyList (SOURCE_FILE_AT_LINE (70)), GALGAS_false_5F_timing_5F_prot::constructor_new (inCompiler->here () COMMA_SOURCE_FILE_AT_LINE (71)), GALGAS_ident_5F_map::constructor_emptyMap (SOURCE_FILE_AT_LINE (72)) COMMA_SOURCE_FILE_AT_LINE (61)) ;
//---
  return result_task_5F_obj ;
}


//---------------------------------------------------------------------------*
//  Function introspection                                                   *
//---------------------------------------------------------------------------*

static const C_galgas_type_descriptor * functionArgs_default_5F_task_5F_obj [1] = {
  NULL
} ;

//---------------------------------------------------------------------------*

static GALGAS_object functionWithGenericHeader_default_5F_task_5F_obj (C_Compiler * inCompiler,
                                                                       const cObjectArray & /* inEffectiveParameterArray */,
                                                                       const GALGAS_location & /* inErrorLocation */
                                                                       COMMA_LOCATION_ARGS) {
  return function_default_5F_task_5F_obj (inCompiler COMMA_THERE).reader_object (THERE) ;
}

//---------------------------------------------------------------------------*

C_galgas_function_descriptor functionDescriptor_default_5F_task_5F_obj ("default_task_obj",
                                                                        functionWithGenericHeader_default_5F_task_5F_obj,
                                                                        & kTypeDescriptor_GALGAS_task_5F_obj,
                                                                        0,
                                                                        functionArgs_default_5F_task_5F_obj) ;

//---------------------------------------------------------------------------*

cMapElement_task_5F_map::cMapElement_task_5F_map (const GALGAS_lstring & inKey,
                                                  const GALGAS_task_5F_obj & in_task
                                                  COMMA_LOCATION_ARGS) :
cMapElement (inKey COMMA_THERE),
mAttribute_task (in_task) {
}

//---------------------------------------------------------------------------*

bool cMapElement_task_5F_map::isValid (void) const {
  return mAttribute_lkey.isValid () && mAttribute_task.isValid () ;
}

//---------------------------------------------------------------------------*

cMapElement * cMapElement_task_5F_map::copy (void) {
  cMapElement * result = NULL ;
  macroMyNew (result, cMapElement_task_5F_map (mAttribute_lkey, mAttribute_task COMMA_HERE)) ;
  return result ;
}

//---------------------------------------------------------------------------*

void cMapElement_task_5F_map::description (C_String & /* ioString */, const PMSInt32 /* inIndentation */) const {
// mAttribute_task.description (ioString, inIndentation) ;
}

//---------------------------------------------------------------------------*

enumComparisonResult cMapElement_task_5F_map::compare (const cCollectionElement * inOperand) const {
  cMapElement_task_5F_map * operand = (cMapElement_task_5F_map *) inOperand ;
  enumComparisonResult result = mAttribute_lkey.objectCompare (operand->mAttribute_lkey) ;
  if (kOperandEqual == result) {
    result = mAttribute_task.objectCompare (operand->mAttribute_task) ;
  }
  return result ;
}

//---------------------------------------------------------------------------*

GALGAS_task_5F_map::GALGAS_task_5F_map (void) :
AC_GALGAS_map () {
}

//---------------------------------------------------------------------------*

GALGAS_task_5F_map::GALGAS_task_5F_map (const GALGAS_task_5F_map & inSource) :
AC_GALGAS_map (inSource) {
}

//---------------------------------------------------------------------------*

GALGAS_task_5F_map & GALGAS_task_5F_map::operator = (const GALGAS_task_5F_map & inSource) {
  * ((AC_GALGAS_map *) this) = inSource ;
  return * this ;
}

//---------------------------------------------------------------------------*

GALGAS_task_5F_map GALGAS_task_5F_map::constructor_emptyMap (LOCATION_ARGS) {
  GALGAS_task_5F_map result ;
  result.makeNewEmptyMap (THERE) ;
  return result ;
}

//---------------------------------------------------------------------------*

GALGAS_task_5F_map GALGAS_task_5F_map::constructor_mapWithMapToOverride (const GALGAS_task_5F_map & inMapToOverride
                                                                         COMMA_LOCATION_ARGS) {
  GALGAS_task_5F_map result ;
  result.makeNewEmptyMapWithMapToOverride (inMapToOverride COMMA_THERE) ;
  return result ;
}

//---------------------------------------------------------------------------*

GALGAS_task_5F_map GALGAS_task_5F_map::reader_overriddenMap (UNUSED_LOCATION_ARGS) const {
  GALGAS_task_5F_map result ;
  getOverridenMap (result) ;
  return result ;
}
//---------------------------------------------------------------------------*

void GALGAS_task_5F_map::modifier_put (GALGAS_lstring inKey,
                                       GALGAS_task_5F_obj inArgument0,
                                       C_Compiler * inCompiler
                                       COMMA_LOCATION_ARGS) {
  cMapElement_task_5F_map * p = NULL ;
  macroMyNew (p, cMapElement_task_5F_map (inKey, inArgument0 COMMA_HERE)) ;
  capCollectionElement attributes ;
  attributes.setPointer (p) ;
  macroDetachSharedObject (p) ;
  const char * kInsertErrorMessage = "Task %K is already defined in %L" ;
  const char * kShadowErrorMessage = "" ;
  performInsert (attributes, inCompiler, kInsertErrorMessage, kShadowErrorMessage COMMA_THERE) ;
}

//---------------------------------------------------------------------------*

const char * kSearchErrorMessage_task_5F_map_get = "Task %K is unkown" ;

//---------------------------------------------------------------------------*

void GALGAS_task_5F_map::method_get (GALGAS_lstring inKey,
                                     GALGAS_task_5F_obj & outArgument0,
                                     C_Compiler * inCompiler
                                     COMMA_LOCATION_ARGS) const {
  const cMapElement_task_5F_map * p = (const cMapElement_task_5F_map *) performSearch (inKey,
                                                                                         inCompiler,
                                                                                         kSearchErrorMessage_task_5F_map_get
                                                                                         COMMA_THERE) ;
  if (NULL == p) {
    outArgument0.drop () ;
  }else{
    macroValidSharedObject (p, const cMapElement_task_5F_map) ;
    outArgument0 = p->mAttribute_task ;
  }
}

//---------------------------------------------------------------------------*

void GALGAS_task_5F_map::modifier_del (GALGAS_lstring inKey,
                                       GALGAS_task_5F_obj & outArgument0,
                                       C_Compiler * inCompiler
                                       COMMA_LOCATION_ARGS) {
  const char * kRemoveErrorMessage = "Task %K is unkown" ;
  capCollectionElement attributes ;
  performRemove (inKey, attributes, inCompiler, kRemoveErrorMessage COMMA_THERE) ;
  cMapElement_task_5F_map * p = (cMapElement_task_5F_map *) attributes.ptr () ;
  if (NULL != p) {
    macroValidSharedObject (p, cMapElement_task_5F_map) ;
    outArgument0 = p->mAttribute_task ;
  }
}

//---------------------------------------------------------------------------*

GALGAS_task_5F_obj GALGAS_task_5F_map::reader_taskForKey (const GALGAS_string & inKey,
                                                          C_Compiler * inCompiler
                                                          COMMA_LOCATION_ARGS) const {
  const cCollectionElement * attributes = searchForReadingAttribute (inKey, inCompiler COMMA_THERE) ;
  const cMapElement_task_5F_map * p = (const cMapElement_task_5F_map *) attributes ;
  GALGAS_task_5F_obj result ;
  if (NULL != p) {
    macroValidSharedObject (p, const cMapElement_task_5F_map) ;
    result = p->mAttribute_task ;
  }
  return result ;
}

//---------------------------------------------------------------------------*

void GALGAS_task_5F_map::modifier_setTaskForKey (GALGAS_task_5F_obj inAttributeValue,
                                                 GALGAS_string inKey,
                                                 C_Compiler * inCompiler
                                                 COMMA_LOCATION_ARGS) {
  cCollectionElement * attributes = searchForReadWriteAttribute (inKey, inCompiler COMMA_THERE) ;
  cMapElement_task_5F_map * p = (cMapElement_task_5F_map *) attributes ;
  if (NULL != p) {
    macroValidSharedObject (p, cMapElement_task_5F_map) ;
    p->mAttribute_task = inAttributeValue ;
  }
}

//---------------------------------------------------------------------------*

cMapElement_task_5F_map * GALGAS_task_5F_map::readWriteAccessForWithInstruction_get (C_Compiler * inCompiler,
                                                                                     const GALGAS_lstring & inKey
                                                                                     COMMA_LOCATION_ARGS) {
  cMapElement * p = searchForReadWriteAttribute (inKey, inCompiler, kSearchErrorMessage_task_5F_map_get COMMA_THERE) ;
  cMapElement_task_5F_map * result = (cMapElement_task_5F_map *) p ;
  macroNullOrValidSharedObject (result, cMapElement_task_5F_map) ;
  return result ;
}

//---------------------------------------------------------------------------*

cMapElement_task_5F_map * GALGAS_task_5F_map::readWriteAccessForWithInstruction_hasKey (C_Compiler * inCompiler,
                                                                                        const GALGAS_string & inKey
                                                                                        COMMA_LOCATION_ARGS) {
  cMapElement * p = searchForReadWriteAttribute (inKey, inCompiler COMMA_THERE) ;
  cMapElement_task_5F_map * result = (cMapElement_task_5F_map *) p ;
  macroNullOrValidSharedObject (result, cMapElement_task_5F_map) ;
  return result ;
}

//---------------------------------------------------------------------------*

cEnumerator_task_5F_map::cEnumerator_task_5F_map (const GALGAS_task_5F_map & inEnumeratedObject,
                                                  const bool inAscending) :
cGenericAbstractEnumerator () {
  inEnumeratedObject.populateEnumerationArray (mEnumerationArray, inAscending) ;
}

//---------------------------------------------------------------------------*

GALGAS_lstring cEnumerator_task_5F_map::current_lkey (LOCATION_ARGS) const {
  const cMapElement * p = (const cMapElement *) currentObjectPtr (THERE) ;
  macroValidSharedObject (p, const cMapElement) ;
  return p->mAttribute_lkey ;
}

//---------------------------------------------------------------------------*

GALGAS_task_5F_obj cEnumerator_task_5F_map::current_task (LOCATION_ARGS) const {
  const cMapElement_task_5F_map * p = (const cMapElement_task_5F_map *) currentObjectPtr (THERE) ;
  macroValidSharedObject (p, const cMapElement_task_5F_map) ;
  return p->mAttribute_task ;
}



//---------------------------------------------------------------------------*
//                                                                           *
//                              @task_map type                               *
//                                                                           *
//---------------------------------------------------------------------------*

const C_galgas_type_descriptor
kTypeDescriptor_GALGAS_task_5F_map ("task_map",
                                    NULL) ;

//---------------------------------------------------------------------------*

const C_galgas_type_descriptor * GALGAS_task_5F_map::staticTypeDescriptor (void) const {
  return & kTypeDescriptor_GALGAS_task_5F_map ;
}

//---------------------------------------------------------------------------*

AC_GALGAS_root * GALGAS_task_5F_map::clonedObject (void) const {
  AC_GALGAS_root * result = NULL ;
  if (isValid ()) {
    macroMyNew (result, GALGAS_task_5F_map (*this)) ;
  }
  return result ;
}

//---------------------------------------------------------------------------*

GALGAS_task_5F_map GALGAS_task_5F_map::extractObject (const GALGAS_object & inObject,
                                                      C_Compiler * inCompiler,
                                                      const GALGAS_location & inErrorLocation
                                                      COMMA_LOCATION_ARGS) {
  GALGAS_task_5F_map result ;
  const GALGAS_task_5F_map * p = (const GALGAS_task_5F_map *) inObject.embeddedObject () ;
  if (NULL != p) {
    if (NULL != dynamic_cast <const GALGAS_task_5F_map *> (p)) {
      result = *p ;
    }else{
      inCompiler->extractObjectError (inErrorLocation, "task_map", p->dynamicTypeDescriptor () COMMA_THERE) ;
    }  
  }
  return result ;
}

//---------------------------------------------------------------------------*

cMapElement_task_5F_mask::cMapElement_task_5F_mask (const GALGAS_lstring & inKey,
                                                    const GALGAS_uint_36__34_ & in_mask
                                                    COMMA_LOCATION_ARGS) :
cMapElement (inKey COMMA_THERE),
mAttribute_mask (in_mask) {
}

//---------------------------------------------------------------------------*

bool cMapElement_task_5F_mask::isValid (void) const {
  return mAttribute_lkey.isValid () && mAttribute_mask.isValid () ;
}

//---------------------------------------------------------------------------*

cMapElement * cMapElement_task_5F_mask::copy (void) {
  cMapElement * result = NULL ;
  macroMyNew (result, cMapElement_task_5F_mask (mAttribute_lkey, mAttribute_mask COMMA_HERE)) ;
  return result ;
}

//---------------------------------------------------------------------------*

void cMapElement_task_5F_mask::description (C_String & /* ioString */, const PMSInt32 /* inIndentation */) const {
// mAttribute_mask.description (ioString, inIndentation) ;
}

//---------------------------------------------------------------------------*

enumComparisonResult cMapElement_task_5F_mask::compare (const cCollectionElement * inOperand) const {
  cMapElement_task_5F_mask * operand = (cMapElement_task_5F_mask *) inOperand ;
  enumComparisonResult result = mAttribute_lkey.objectCompare (operand->mAttribute_lkey) ;
  if (kOperandEqual == result) {
    result = mAttribute_mask.objectCompare (operand->mAttribute_mask) ;
  }
  return result ;
}

//---------------------------------------------------------------------------*

GALGAS_task_5F_mask::GALGAS_task_5F_mask (void) :
AC_GALGAS_map () {
}

//---------------------------------------------------------------------------*

GALGAS_task_5F_mask::GALGAS_task_5F_mask (const GALGAS_task_5F_mask & inSource) :
AC_GALGAS_map (inSource) {
}

//---------------------------------------------------------------------------*

GALGAS_task_5F_mask & GALGAS_task_5F_mask::operator = (const GALGAS_task_5F_mask & inSource) {
  * ((AC_GALGAS_map *) this) = inSource ;
  return * this ;
}

//---------------------------------------------------------------------------*

GALGAS_task_5F_mask GALGAS_task_5F_mask::constructor_emptyMap (LOCATION_ARGS) {
  GALGAS_task_5F_mask result ;
  result.makeNewEmptyMap (THERE) ;
  return result ;
}

//---------------------------------------------------------------------------*

GALGAS_task_5F_mask GALGAS_task_5F_mask::constructor_mapWithMapToOverride (const GALGAS_task_5F_mask & inMapToOverride
                                                                           COMMA_LOCATION_ARGS) {
  GALGAS_task_5F_mask result ;
  result.makeNewEmptyMapWithMapToOverride (inMapToOverride COMMA_THERE) ;
  return result ;
}

//---------------------------------------------------------------------------*

GALGAS_task_5F_mask GALGAS_task_5F_mask::reader_overriddenMap (UNUSED_LOCATION_ARGS) const {
  GALGAS_task_5F_mask result ;
  getOverridenMap (result) ;
  return result ;
}
//---------------------------------------------------------------------------*

void GALGAS_task_5F_mask::modifier_insert_5F_mask (GALGAS_lstring inKey,
                                                   GALGAS_uint_36__34_ inArgument0,
                                                   C_Compiler * inCompiler
                                                   COMMA_LOCATION_ARGS) {
  cMapElement_task_5F_mask * p = NULL ;
  macroMyNew (p, cMapElement_task_5F_mask (inKey, inArgument0 COMMA_HERE)) ;
  capCollectionElement attributes ;
  attributes.setPointer (p) ;
  macroDetachSharedObject (p) ;
  const char * kInsertErrorMessage = "Task %K has already its mask" ;
  const char * kShadowErrorMessage = "" ;
  performInsert (attributes, inCompiler, kInsertErrorMessage, kShadowErrorMessage COMMA_THERE) ;
}

//---------------------------------------------------------------------------*

const char * kSearchErrorMessage_task_5F_mask_get_5F_mask = "No mask for task %K" ;

//---------------------------------------------------------------------------*

void GALGAS_task_5F_mask::method_get_5F_mask (GALGAS_lstring inKey,
                                              GALGAS_uint_36__34_ & outArgument0,
                                              C_Compiler * inCompiler
                                              COMMA_LOCATION_ARGS) const {
  const cMapElement_task_5F_mask * p = (const cMapElement_task_5F_mask *) performSearch (inKey,
                                                                                           inCompiler,
                                                                                           kSearchErrorMessage_task_5F_mask_get_5F_mask
                                                                                           COMMA_THERE) ;
  if (NULL == p) {
    outArgument0.drop () ;
  }else{
    macroValidSharedObject (p, const cMapElement_task_5F_mask) ;
    outArgument0 = p->mAttribute_mask ;
  }
}

//---------------------------------------------------------------------------*

void GALGAS_task_5F_mask::modifier_del_5F_mask (GALGAS_lstring inKey,
                                                GALGAS_uint_36__34_ & outArgument0,
                                                C_Compiler * inCompiler
                                                COMMA_LOCATION_ARGS) {
  const char * kRemoveErrorMessage = "No mask for task %K" ;
  capCollectionElement attributes ;
  performRemove (inKey, attributes, inCompiler, kRemoveErrorMessage COMMA_THERE) ;
  cMapElement_task_5F_mask * p = (cMapElement_task_5F_mask *) attributes.ptr () ;
  if (NULL != p) {
    macroValidSharedObject (p, cMapElement_task_5F_mask) ;
    outArgument0 = p->mAttribute_mask ;
  }
}

//---------------------------------------------------------------------------*

GALGAS_uint_36__34_ GALGAS_task_5F_mask::reader_maskForKey (const GALGAS_string & inKey,
                                                            C_Compiler * inCompiler
                                                            COMMA_LOCATION_ARGS) const {
  const cCollectionElement * attributes = searchForReadingAttribute (inKey, inCompiler COMMA_THERE) ;
  const cMapElement_task_5F_mask * p = (const cMapElement_task_5F_mask *) attributes ;
  GALGAS_uint_36__34_ result ;
  if (NULL != p) {
    macroValidSharedObject (p, const cMapElement_task_5F_mask) ;
    result = p->mAttribute_mask ;
  }
  return result ;
}

//---------------------------------------------------------------------------*

void GALGAS_task_5F_mask::modifier_setMaskForKey (GALGAS_uint_36__34_ inAttributeValue,
                                                  GALGAS_string inKey,
                                                  C_Compiler * inCompiler
                                                  COMMA_LOCATION_ARGS) {
  cCollectionElement * attributes = searchForReadWriteAttribute (inKey, inCompiler COMMA_THERE) ;
  cMapElement_task_5F_mask * p = (cMapElement_task_5F_mask *) attributes ;
  if (NULL != p) {
    macroValidSharedObject (p, cMapElement_task_5F_mask) ;
    p->mAttribute_mask = inAttributeValue ;
  }
}

//---------------------------------------------------------------------------*

cMapElement_task_5F_mask * GALGAS_task_5F_mask::readWriteAccessForWithInstruction_get_5F_mask (C_Compiler * inCompiler,
                                                                                               const GALGAS_lstring & inKey
                                                                                               COMMA_LOCATION_ARGS) {
  cMapElement * p = searchForReadWriteAttribute (inKey, inCompiler, kSearchErrorMessage_task_5F_mask_get_5F_mask COMMA_THERE) ;
  cMapElement_task_5F_mask * result = (cMapElement_task_5F_mask *) p ;
  macroNullOrValidSharedObject (result, cMapElement_task_5F_mask) ;
  return result ;
}

//---------------------------------------------------------------------------*

cMapElement_task_5F_mask * GALGAS_task_5F_mask::readWriteAccessForWithInstruction_hasKey (C_Compiler * inCompiler,
                                                                                          const GALGAS_string & inKey
                                                                                          COMMA_LOCATION_ARGS) {
  cMapElement * p = searchForReadWriteAttribute (inKey, inCompiler COMMA_THERE) ;
  cMapElement_task_5F_mask * result = (cMapElement_task_5F_mask *) p ;
  macroNullOrValidSharedObject (result, cMapElement_task_5F_mask) ;
  return result ;
}

//---------------------------------------------------------------------------*

cEnumerator_task_5F_mask::cEnumerator_task_5F_mask (const GALGAS_task_5F_mask & inEnumeratedObject,
                                                    const bool inAscending) :
cGenericAbstractEnumerator () {
  inEnumeratedObject.populateEnumerationArray (mEnumerationArray, inAscending) ;
}

//---------------------------------------------------------------------------*

GALGAS_lstring cEnumerator_task_5F_mask::current_lkey (LOCATION_ARGS) const {
  const cMapElement * p = (const cMapElement *) currentObjectPtr (THERE) ;
  macroValidSharedObject (p, const cMapElement) ;
  return p->mAttribute_lkey ;
}

//---------------------------------------------------------------------------*

GALGAS_uint_36__34_ cEnumerator_task_5F_mask::current_mask (LOCATION_ARGS) const {
  const cMapElement_task_5F_mask * p = (const cMapElement_task_5F_mask *) currentObjectPtr (THERE) ;
  macroValidSharedObject (p, const cMapElement_task_5F_mask) ;
  return p->mAttribute_mask ;
}



//---------------------------------------------------------------------------*
//                                                                           *
//                              @task_mask type                              *
//                                                                           *
//---------------------------------------------------------------------------*

const C_galgas_type_descriptor
kTypeDescriptor_GALGAS_task_5F_mask ("task_mask",
                                     NULL) ;

//---------------------------------------------------------------------------*

const C_galgas_type_descriptor * GALGAS_task_5F_mask::staticTypeDescriptor (void) const {
  return & kTypeDescriptor_GALGAS_task_5F_mask ;
}

//---------------------------------------------------------------------------*

AC_GALGAS_root * GALGAS_task_5F_mask::clonedObject (void) const {
  AC_GALGAS_root * result = NULL ;
  if (isValid ()) {
    macroMyNew (result, GALGAS_task_5F_mask (*this)) ;
  }
  return result ;
}

//---------------------------------------------------------------------------*

GALGAS_task_5F_mask GALGAS_task_5F_mask::extractObject (const GALGAS_object & inObject,
                                                        C_Compiler * inCompiler,
                                                        const GALGAS_location & inErrorLocation
                                                        COMMA_LOCATION_ARGS) {
  GALGAS_task_5F_mask result ;
  const GALGAS_task_5F_mask * p = (const GALGAS_task_5F_mask *) inObject.embeddedObject () ;
  if (NULL != p) {
    if (NULL != dynamic_cast <const GALGAS_task_5F_mask *> (p)) {
      result = *p ;
    }else{
      inCompiler->extractObjectError (inErrorLocation, "task_mask", p->dynamicTypeDescriptor () COMMA_THERE) ;
    }  
  }
  return result ;
}

//---------------------------------------------------------------------------*
//                                                                           *
//          Class for element of '@objs_5F_by_5F_prio' sorted list           *
//                                                                           *
//---------------------------------------------------------------------------*

class cSortedListElement_objs_5F_by_5F_prio : public cSortedListElement {
//--- List attributes
  public : GALGAS_uint mAttribute_prio ;
  public : GALGAS_uint mAttribute_act ;
  public : GALGAS_lstring mAttribute_name ;

//--- Constructor
  public : cSortedListElement_objs_5F_by_5F_prio (const GALGAS_uint & in_prio,
                                                  const GALGAS_uint & in_act,
                                                  const GALGAS_lstring & in_name
                                                  COMMA_LOCATION_ARGS) ;

//--- Virtual method that checks that all attributes are valid
  public : virtual bool isValid (void) const ;

//--- Virtual method that returns a copy of current object
  public : virtual cSortedListElement * copy (void) ;

//--- Virtual method for comparing elements
  public : virtual enumComparisonResult compare (const cCollectionElement * inOperand) const ;

//--- Description
 public : virtual void description (C_String & ioString, const PMSInt32 inIndentation) const ;

//--- Virtual method that comparing element for sorting
  public : virtual enumComparisonResult compareForSorting (const cSortedListElement * inOperand) const ;
} ;

//---------------------------------------------------------------------------*

cSortedListElement_objs_5F_by_5F_prio::cSortedListElement_objs_5F_by_5F_prio (const GALGAS_uint & in_prio,
                                                                              const GALGAS_uint & in_act,
                                                                              const GALGAS_lstring & in_name
                                                                              COMMA_LOCATION_ARGS) :
cSortedListElement (THERE),
mAttribute_prio (in_prio),
mAttribute_act (in_act),
mAttribute_name (in_name) {
}

//---------------------------------------------------------------------------*

bool cSortedListElement_objs_5F_by_5F_prio::isValid (void) const {
  return mAttribute_prio.isValid () && mAttribute_act.isValid () && mAttribute_name.isValid () ;
}

//---------------------------------------------------------------------------*

cSortedListElement * cSortedListElement_objs_5F_by_5F_prio::copy (void) {
  cSortedListElement * result = NULL ;
  macroMyNew (result, cSortedListElement_objs_5F_by_5F_prio (mAttribute_prio, mAttribute_act, mAttribute_name COMMA_HERE)) ;
  return result ;
}

//---------------------------------------------------------------------------*

void cSortedListElement_objs_5F_by_5F_prio::description (C_String & /* ioString */, const PMSInt32 /* inIndentation */) const {
// mAttribute_prio.description (ioString, inIndentation) ;
// mAttribute_act.description (ioString, inIndentation) ;
// mAttribute_name.description (ioString, inIndentation) ;
}

//---------------------------------------------------------------------------*

enumComparisonResult cSortedListElement_objs_5F_by_5F_prio::compare (const cCollectionElement * inOperand) const {
  enumComparisonResult result = kOperandNotValid ;
  if (NULL != inOperand) {
    result = kOperandEqual ;
    cSortedListElement_objs_5F_by_5F_prio * operand = (cSortedListElement_objs_5F_by_5F_prio *) inOperand ;
    macroValidSharedObject (operand, cSortedListElement_objs_5F_by_5F_prio) ;
    if (kOperandEqual == result) {
      result = mAttribute_prio.objectCompare (operand->mAttribute_prio) ;
    }
    if (kOperandEqual == result) {
      result = mAttribute_act.objectCompare (operand->mAttribute_act) ;
    }
    if (kOperandEqual == result) {
      result = mAttribute_name.objectCompare (operand->mAttribute_name) ;
    }
  }
  return result ;
}

//---------------------------------------------------------------------------*

GALGAS_objs_5F_by_5F_prio::GALGAS_objs_5F_by_5F_prio (void) :
AC_GALGAS_sortedlist () {
}

//---------------------------------------------------------------------------*

enumComparisonResult cSortedListElement_objs_5F_by_5F_prio::compareForSorting (const cSortedListElement * inOperand) const {
  enumComparisonResult result = kOperandEqual ;
  const cSortedListElement_objs_5F_by_5F_prio * operand = (const cSortedListElement_objs_5F_by_5F_prio *) inOperand ;
  macroValidSharedObject (operand, const cSortedListElement_objs_5F_by_5F_prio) ;
  if (result == kOperandEqual) {
    result = mAttribute_prio.objectCompare (operand->mAttribute_prio) ;
  }
  return result ;
}

//---------------------------------------------------------------------------*

GALGAS_objs_5F_by_5F_prio GALGAS_objs_5F_by_5F_prio::constructor_emptySortedList (LOCATION_ARGS) {
  GALGAS_objs_5F_by_5F_prio result ;
  result.createNewEmptySortedList (THERE) ;
  return result ;
}

//---------------------------------------------------------------------------*

GALGAS_objs_5F_by_5F_prio GALGAS_objs_5F_by_5F_prio::constructor_sortedListWithValue (const GALGAS_uint & inOperand0,
                                                                                      const GALGAS_uint & inOperand1,
                                                                                      const GALGAS_lstring & inOperand2
                                                                                      COMMA_LOCATION_ARGS) {
  GALGAS_objs_5F_by_5F_prio result = constructor_emptySortedList (THERE) ;
  cSortedListElement * p = NULL ;
  macroMyNew (p, cSortedListElement_objs_5F_by_5F_prio (inOperand0, inOperand1, inOperand2 COMMA_THERE)) ;
  capSortedListElement attributes ;
  attributes.setPointer (p) ;
  macroDetachSharedObject (p) ;
  result.addObject (attributes) ;
  return result ;
}

//---------------------------------------------------------------------------*

void GALGAS_objs_5F_by_5F_prio::addAssign_operation (const GALGAS_uint & inOperand0,
                                                     const GALGAS_uint & inOperand1,
                                                     const GALGAS_lstring & inOperand2
                                                     COMMA_LOCATION_ARGS) {
  if (isValid ()) {
    cSortedListElement * p = NULL ;
    macroMyNew (p, cSortedListElement_objs_5F_by_5F_prio (inOperand0, inOperand1, inOperand2 COMMA_THERE)) ;
    capSortedListElement attributes ;
    attributes.setPointer (p) ;
    macroDetachSharedObject (p) ;
    addObject (attributes) ;
  }
}

//---------------------------------------------------------------------------*

void GALGAS_objs_5F_by_5F_prio::dotAssign_operation (const GALGAS_objs_5F_by_5F_prio inOperand
                                                     COMMA_UNUSED_LOCATION_ARGS) {
  if (isValid ()) {
    appendSortedList (inOperand) ;
  }
}

//---------------------------------------------------------------------------*

GALGAS_objs_5F_by_5F_prio GALGAS_objs_5F_by_5F_prio::operator_concat (const GALGAS_objs_5F_by_5F_prio & inOperand
                                                                      COMMA_LOCATION_ARGS) const {
  GALGAS_objs_5F_by_5F_prio result ;
  if (isValid () && inOperand.isValid ()) {
    result = constructor_emptySortedList (THERE) ;
    result = *this ;
    result.appendSortedList (inOperand) ;
  }
  return result ;
}

//---------------------------------------------------------------------------*

void GALGAS_objs_5F_by_5F_prio::modifier_popSmallest (GALGAS_uint & outOperand0,
                                                      GALGAS_uint & outOperand1,
                                                      GALGAS_lstring & outOperand2,
                                                      C_Compiler * inCompiler
                                                      COMMA_LOCATION_ARGS) {
  capSortedListElement attributes ;
  removeSmallestObject (attributes, inCompiler COMMA_THERE) ;
  cSortedListElement_objs_5F_by_5F_prio * p = (cSortedListElement_objs_5F_by_5F_prio *) attributes.ptr () ;
  if (NULL == p) {
    outOperand0.drop () ;
    outOperand1.drop () ;
    outOperand2.drop () ;
  }else{
    macroValidSharedObject (p, cSortedListElement_objs_5F_by_5F_prio) ;
    outOperand0 = p->mAttribute_prio ;
    outOperand1 = p->mAttribute_act ;
    outOperand2 = p->mAttribute_name ;
  }
}

//---------------------------------------------------------------------------*

void GALGAS_objs_5F_by_5F_prio::modifier_popGreatest (GALGAS_uint & outOperand0,
                                                      GALGAS_uint & outOperand1,
                                                      GALGAS_lstring & outOperand2,
                                                      C_Compiler * inCompiler
                                                      COMMA_LOCATION_ARGS) {
  capSortedListElement attributes ;
  removeGreatestObject (attributes, inCompiler COMMA_THERE) ;
  cSortedListElement_objs_5F_by_5F_prio * p = (cSortedListElement_objs_5F_by_5F_prio *) attributes.ptr () ;
  if (NULL == p) {
    outOperand0.drop () ;
    outOperand1.drop () ;
    outOperand2.drop () ;
  }else{
    macroValidSharedObject (p, cSortedListElement_objs_5F_by_5F_prio) ;
    outOperand0 = p->mAttribute_prio ;
    outOperand1 = p->mAttribute_act ;
    outOperand2 = p->mAttribute_name ;
  }
}

//---------------------------------------------------------------------------*

void GALGAS_objs_5F_by_5F_prio::method_smallest (GALGAS_uint & outOperand0,
                                                 GALGAS_uint & outOperand1,
                                                 GALGAS_lstring & outOperand2,
                                                 C_Compiler * inCompiler
                                                 COMMA_LOCATION_ARGS) const {
  capSortedListElement attributes ;
  smallestObjectAttributeList (attributes, inCompiler COMMA_THERE) ;
  cSortedListElement_objs_5F_by_5F_prio * p = (cSortedListElement_objs_5F_by_5F_prio *) attributes.ptr () ;
  if (NULL == p) {
    outOperand0.drop () ;
    outOperand1.drop () ;
    outOperand2.drop () ;
  }else{
    macroValidSharedObject (p, cSortedListElement_objs_5F_by_5F_prio) ;
    outOperand0 = p->mAttribute_prio ;
    outOperand1 = p->mAttribute_act ;
    outOperand2 = p->mAttribute_name ;
  }
}

//---------------------------------------------------------------------------*

void GALGAS_objs_5F_by_5F_prio::method_greatest (GALGAS_uint & outOperand0,
                                                 GALGAS_uint & outOperand1,
                                                 GALGAS_lstring & outOperand2,
                                                 C_Compiler * inCompiler
                                                 COMMA_LOCATION_ARGS) const {
  capSortedListElement attributes ;
  greatestObjectAttributeList (attributes, inCompiler COMMA_THERE) ;
  cSortedListElement_objs_5F_by_5F_prio * p = (cSortedListElement_objs_5F_by_5F_prio *) attributes.ptr () ;
  if (NULL == p) {
    outOperand0.drop () ;
    outOperand1.drop () ;
    outOperand2.drop () ;
  }else{
    macroValidSharedObject (p, cSortedListElement_objs_5F_by_5F_prio) ;
    outOperand0 = p->mAttribute_prio ;
    outOperand1 = p->mAttribute_act ;
    outOperand2 = p->mAttribute_name ;
  }
}

//---------------------------------------------------------------------------*

cEnumerator_objs_5F_by_5F_prio::cEnumerator_objs_5F_by_5F_prio (const GALGAS_objs_5F_by_5F_prio & inEnumeratedObject,
                                                                const bool inAscending) :
cGenericAbstractEnumerator () {
  inEnumeratedObject.populateEnumerationArray (mEnumerationArray, inAscending) ;
}

//---------------------------------------------------------------------------*

GALGAS_uint cEnumerator_objs_5F_by_5F_prio::current_prio (LOCATION_ARGS) const {
  const cSortedListElement_objs_5F_by_5F_prio * p = (const cSortedListElement_objs_5F_by_5F_prio *) currentObjectPtr (THERE) ;
  macroValidSharedObject (p, const cSortedListElement_objs_5F_by_5F_prio) ;
  return p->mAttribute_prio ;
}

//---------------------------------------------------------------------------*

GALGAS_uint cEnumerator_objs_5F_by_5F_prio::current_act (LOCATION_ARGS) const {
  const cSortedListElement_objs_5F_by_5F_prio * p = (const cSortedListElement_objs_5F_by_5F_prio *) currentObjectPtr (THERE) ;
  macroValidSharedObject (p, const cSortedListElement_objs_5F_by_5F_prio) ;
  return p->mAttribute_act ;
}

//---------------------------------------------------------------------------*

GALGAS_lstring cEnumerator_objs_5F_by_5F_prio::current_name (LOCATION_ARGS) const {
  const cSortedListElement_objs_5F_by_5F_prio * p = (const cSortedListElement_objs_5F_by_5F_prio *) currentObjectPtr (THERE) ;
  macroValidSharedObject (p, const cSortedListElement_objs_5F_by_5F_prio) ;
  return p->mAttribute_name ;
}



//---------------------------------------------------------------------------*
//                                                                           *
//                            @objs_by_prio type                             *
//                                                                           *
//---------------------------------------------------------------------------*

const C_galgas_type_descriptor
kTypeDescriptor_GALGAS_objs_5F_by_5F_prio ("objs_by_prio",
                                           NULL) ;

//---------------------------------------------------------------------------*

const C_galgas_type_descriptor * GALGAS_objs_5F_by_5F_prio::staticTypeDescriptor (void) const {
  return & kTypeDescriptor_GALGAS_objs_5F_by_5F_prio ;
}

//---------------------------------------------------------------------------*

AC_GALGAS_root * GALGAS_objs_5F_by_5F_prio::clonedObject (void) const {
  AC_GALGAS_root * result = NULL ;
  if (isValid ()) {
    macroMyNew (result, GALGAS_objs_5F_by_5F_prio (*this)) ;
  }
  return result ;
}

//---------------------------------------------------------------------------*

GALGAS_objs_5F_by_5F_prio GALGAS_objs_5F_by_5F_prio::extractObject (const GALGAS_object & inObject,
                                                                    C_Compiler * inCompiler,
                                                                    const GALGAS_location & inErrorLocation
                                                                    COMMA_LOCATION_ARGS) {
  GALGAS_objs_5F_by_5F_prio result ;
  const GALGAS_objs_5F_by_5F_prio * p = (const GALGAS_objs_5F_by_5F_prio *) inObject.embeddedObject () ;
  if (NULL != p) {
    if (NULL != dynamic_cast <const GALGAS_objs_5F_by_5F_prio *> (p)) {
      result = *p ;
    }else{
      inCompiler->extractObjectError (inErrorLocation, "objs_by_prio", p->dynamicTypeDescriptor () COMMA_THERE) ;
    }  
  }
  return result ;
}

//---------------------------------------------------------------------------*
//                                                                           *
//          Class for element of '@tasks_5F_by_5F_type' sorted list          *
//                                                                           *
//---------------------------------------------------------------------------*

class cSortedListElement_tasks_5F_by_5F_type : public cSortedListElement {
//--- List attributes
  public : GALGAS_uint mAttribute_type ;
  public : GALGAS_string mAttribute_name ;

//--- Constructor
  public : cSortedListElement_tasks_5F_by_5F_type (const GALGAS_uint & in_type,
                                                   const GALGAS_string & in_name
                                                   COMMA_LOCATION_ARGS) ;

//--- Virtual method that checks that all attributes are valid
  public : virtual bool isValid (void) const ;

//--- Virtual method that returns a copy of current object
  public : virtual cSortedListElement * copy (void) ;

//--- Virtual method for comparing elements
  public : virtual enumComparisonResult compare (const cCollectionElement * inOperand) const ;

//--- Description
 public : virtual void description (C_String & ioString, const PMSInt32 inIndentation) const ;

//--- Virtual method that comparing element for sorting
  public : virtual enumComparisonResult compareForSorting (const cSortedListElement * inOperand) const ;
} ;

//---------------------------------------------------------------------------*

cSortedListElement_tasks_5F_by_5F_type::cSortedListElement_tasks_5F_by_5F_type (const GALGAS_uint & in_type,
                                                                                const GALGAS_string & in_name
                                                                                COMMA_LOCATION_ARGS) :
cSortedListElement (THERE),
mAttribute_type (in_type),
mAttribute_name (in_name) {
}

//---------------------------------------------------------------------------*

bool cSortedListElement_tasks_5F_by_5F_type::isValid (void) const {
  return mAttribute_type.isValid () && mAttribute_name.isValid () ;
}

//---------------------------------------------------------------------------*

cSortedListElement * cSortedListElement_tasks_5F_by_5F_type::copy (void) {
  cSortedListElement * result = NULL ;
  macroMyNew (result, cSortedListElement_tasks_5F_by_5F_type (mAttribute_type, mAttribute_name COMMA_HERE)) ;
  return result ;
}

//---------------------------------------------------------------------------*

void cSortedListElement_tasks_5F_by_5F_type::description (C_String & /* ioString */, const PMSInt32 /* inIndentation */) const {
// mAttribute_type.description (ioString, inIndentation) ;
// mAttribute_name.description (ioString, inIndentation) ;
}

//---------------------------------------------------------------------------*

enumComparisonResult cSortedListElement_tasks_5F_by_5F_type::compare (const cCollectionElement * inOperand) const {
  enumComparisonResult result = kOperandNotValid ;
  if (NULL != inOperand) {
    result = kOperandEqual ;
    cSortedListElement_tasks_5F_by_5F_type * operand = (cSortedListElement_tasks_5F_by_5F_type *) inOperand ;
    macroValidSharedObject (operand, cSortedListElement_tasks_5F_by_5F_type) ;
    if (kOperandEqual == result) {
      result = mAttribute_type.objectCompare (operand->mAttribute_type) ;
    }
    if (kOperandEqual == result) {
      result = mAttribute_name.objectCompare (operand->mAttribute_name) ;
    }
  }
  return result ;
}

//---------------------------------------------------------------------------*

GALGAS_tasks_5F_by_5F_type::GALGAS_tasks_5F_by_5F_type (void) :
AC_GALGAS_sortedlist () {
}

//---------------------------------------------------------------------------*

enumComparisonResult cSortedListElement_tasks_5F_by_5F_type::compareForSorting (const cSortedListElement * inOperand) const {
  enumComparisonResult result = kOperandEqual ;
  const cSortedListElement_tasks_5F_by_5F_type * operand = (const cSortedListElement_tasks_5F_by_5F_type *) inOperand ;
  macroValidSharedObject (operand, const cSortedListElement_tasks_5F_by_5F_type) ;
  if (result == kOperandEqual) {
    result = mAttribute_type.objectCompare (operand->mAttribute_type) ;
  }
  return result ;
}

//---------------------------------------------------------------------------*

GALGAS_tasks_5F_by_5F_type GALGAS_tasks_5F_by_5F_type::constructor_emptySortedList (LOCATION_ARGS) {
  GALGAS_tasks_5F_by_5F_type result ;
  result.createNewEmptySortedList (THERE) ;
  return result ;
}

//---------------------------------------------------------------------------*

GALGAS_tasks_5F_by_5F_type GALGAS_tasks_5F_by_5F_type::constructor_sortedListWithValue (const GALGAS_uint & inOperand0,
                                                                                        const GALGAS_string & inOperand1
                                                                                        COMMA_LOCATION_ARGS) {
  GALGAS_tasks_5F_by_5F_type result = constructor_emptySortedList (THERE) ;
  cSortedListElement * p = NULL ;
  macroMyNew (p, cSortedListElement_tasks_5F_by_5F_type (inOperand0, inOperand1 COMMA_THERE)) ;
  capSortedListElement attributes ;
  attributes.setPointer (p) ;
  macroDetachSharedObject (p) ;
  result.addObject (attributes) ;
  return result ;
}

//---------------------------------------------------------------------------*

void GALGAS_tasks_5F_by_5F_type::addAssign_operation (const GALGAS_uint & inOperand0,
                                                      const GALGAS_string & inOperand1
                                                      COMMA_LOCATION_ARGS) {
  if (isValid ()) {
    cSortedListElement * p = NULL ;
    macroMyNew (p, cSortedListElement_tasks_5F_by_5F_type (inOperand0, inOperand1 COMMA_THERE)) ;
    capSortedListElement attributes ;
    attributes.setPointer (p) ;
    macroDetachSharedObject (p) ;
    addObject (attributes) ;
  }
}

//---------------------------------------------------------------------------*

void GALGAS_tasks_5F_by_5F_type::dotAssign_operation (const GALGAS_tasks_5F_by_5F_type inOperand
                                                      COMMA_UNUSED_LOCATION_ARGS) {
  if (isValid ()) {
    appendSortedList (inOperand) ;
  }
}

//---------------------------------------------------------------------------*

GALGAS_tasks_5F_by_5F_type GALGAS_tasks_5F_by_5F_type::operator_concat (const GALGAS_tasks_5F_by_5F_type & inOperand
                                                                        COMMA_LOCATION_ARGS) const {
  GALGAS_tasks_5F_by_5F_type result ;
  if (isValid () && inOperand.isValid ()) {
    result = constructor_emptySortedList (THERE) ;
    result = *this ;
    result.appendSortedList (inOperand) ;
  }
  return result ;
}

//---------------------------------------------------------------------------*

void GALGAS_tasks_5F_by_5F_type::modifier_popSmallest (GALGAS_uint & outOperand0,
                                                       GALGAS_string & outOperand1,
                                                       C_Compiler * inCompiler
                                                       COMMA_LOCATION_ARGS) {
  capSortedListElement attributes ;
  removeSmallestObject (attributes, inCompiler COMMA_THERE) ;
  cSortedListElement_tasks_5F_by_5F_type * p = (cSortedListElement_tasks_5F_by_5F_type *) attributes.ptr () ;
  if (NULL == p) {
    outOperand0.drop () ;
    outOperand1.drop () ;
  }else{
    macroValidSharedObject (p, cSortedListElement_tasks_5F_by_5F_type) ;
    outOperand0 = p->mAttribute_type ;
    outOperand1 = p->mAttribute_name ;
  }
}

//---------------------------------------------------------------------------*

void GALGAS_tasks_5F_by_5F_type::modifier_popGreatest (GALGAS_uint & outOperand0,
                                                       GALGAS_string & outOperand1,
                                                       C_Compiler * inCompiler
                                                       COMMA_LOCATION_ARGS) {
  capSortedListElement attributes ;
  removeGreatestObject (attributes, inCompiler COMMA_THERE) ;
  cSortedListElement_tasks_5F_by_5F_type * p = (cSortedListElement_tasks_5F_by_5F_type *) attributes.ptr () ;
  if (NULL == p) {
    outOperand0.drop () ;
    outOperand1.drop () ;
  }else{
    macroValidSharedObject (p, cSortedListElement_tasks_5F_by_5F_type) ;
    outOperand0 = p->mAttribute_type ;
    outOperand1 = p->mAttribute_name ;
  }
}

//---------------------------------------------------------------------------*

void GALGAS_tasks_5F_by_5F_type::method_smallest (GALGAS_uint & outOperand0,
                                                  GALGAS_string & outOperand1,
                                                  C_Compiler * inCompiler
                                                  COMMA_LOCATION_ARGS) const {
  capSortedListElement attributes ;
  smallestObjectAttributeList (attributes, inCompiler COMMA_THERE) ;
  cSortedListElement_tasks_5F_by_5F_type * p = (cSortedListElement_tasks_5F_by_5F_type *) attributes.ptr () ;
  if (NULL == p) {
    outOperand0.drop () ;
    outOperand1.drop () ;
  }else{
    macroValidSharedObject (p, cSortedListElement_tasks_5F_by_5F_type) ;
    outOperand0 = p->mAttribute_type ;
    outOperand1 = p->mAttribute_name ;
  }
}

//---------------------------------------------------------------------------*

void GALGAS_tasks_5F_by_5F_type::method_greatest (GALGAS_uint & outOperand0,
                                                  GALGAS_string & outOperand1,
                                                  C_Compiler * inCompiler
                                                  COMMA_LOCATION_ARGS) const {
  capSortedListElement attributes ;
  greatestObjectAttributeList (attributes, inCompiler COMMA_THERE) ;
  cSortedListElement_tasks_5F_by_5F_type * p = (cSortedListElement_tasks_5F_by_5F_type *) attributes.ptr () ;
  if (NULL == p) {
    outOperand0.drop () ;
    outOperand1.drop () ;
  }else{
    macroValidSharedObject (p, cSortedListElement_tasks_5F_by_5F_type) ;
    outOperand0 = p->mAttribute_type ;
    outOperand1 = p->mAttribute_name ;
  }
}

//---------------------------------------------------------------------------*

cEnumerator_tasks_5F_by_5F_type::cEnumerator_tasks_5F_by_5F_type (const GALGAS_tasks_5F_by_5F_type & inEnumeratedObject,
                                                                  const bool inAscending) :
cGenericAbstractEnumerator () {
  inEnumeratedObject.populateEnumerationArray (mEnumerationArray, inAscending) ;
}

//---------------------------------------------------------------------------*

GALGAS_uint cEnumerator_tasks_5F_by_5F_type::current_type (LOCATION_ARGS) const {
  const cSortedListElement_tasks_5F_by_5F_type * p = (const cSortedListElement_tasks_5F_by_5F_type *) currentObjectPtr (THERE) ;
  macroValidSharedObject (p, const cSortedListElement_tasks_5F_by_5F_type) ;
  return p->mAttribute_type ;
}

//---------------------------------------------------------------------------*

GALGAS_string cEnumerator_tasks_5F_by_5F_type::current_name (LOCATION_ARGS) const {
  const cSortedListElement_tasks_5F_by_5F_type * p = (const cSortedListElement_tasks_5F_by_5F_type *) currentObjectPtr (THERE) ;
  macroValidSharedObject (p, const cSortedListElement_tasks_5F_by_5F_type) ;
  return p->mAttribute_name ;
}



//---------------------------------------------------------------------------*
//                                                                           *
//                            @tasks_by_type type                            *
//                                                                           *
//---------------------------------------------------------------------------*

const C_galgas_type_descriptor
kTypeDescriptor_GALGAS_tasks_5F_by_5F_type ("tasks_by_type",
                                            NULL) ;

//---------------------------------------------------------------------------*

const C_galgas_type_descriptor * GALGAS_tasks_5F_by_5F_type::staticTypeDescriptor (void) const {
  return & kTypeDescriptor_GALGAS_tasks_5F_by_5F_type ;
}

//---------------------------------------------------------------------------*

AC_GALGAS_root * GALGAS_tasks_5F_by_5F_type::clonedObject (void) const {
  AC_GALGAS_root * result = NULL ;
  if (isValid ()) {
    macroMyNew (result, GALGAS_tasks_5F_by_5F_type (*this)) ;
  }
  return result ;
}

//---------------------------------------------------------------------------*

GALGAS_tasks_5F_by_5F_type GALGAS_tasks_5F_by_5F_type::extractObject (const GALGAS_object & inObject,
                                                                      C_Compiler * inCompiler,
                                                                      const GALGAS_location & inErrorLocation
                                                                      COMMA_LOCATION_ARGS) {
  GALGAS_tasks_5F_by_5F_type result ;
  const GALGAS_tasks_5F_by_5F_type * p = (const GALGAS_tasks_5F_by_5F_type *) inObject.embeddedObject () ;
  if (NULL != p) {
    if (NULL != dynamic_cast <const GALGAS_tasks_5F_by_5F_type *> (p)) {
      result = *p ;
    }else{
      inCompiler->extractObjectError (inErrorLocation, "tasks_by_type", p->dynamicTypeDescriptor () COMMA_THERE) ;
    }  
  }
  return result ;
}

//---------------------------------------------------------------------------*
//                                                                           *
//                 Class for element of '@prio_5F_list' list                 *
//                                                                           *
//---------------------------------------------------------------------------*

class cCollectionElement_prio_5F_list : public cCollectionElement {
//--- List attributes
  public : GALGAS_uint mAttribute_fifosize ;

//--- Constructor
  public : cCollectionElement_prio_5F_list (const GALGAS_uint & in_fifosize
                                            COMMA_LOCATION_ARGS) ;

//--- Virtual method for comparing elements
  public : virtual enumComparisonResult compare (const cCollectionElement * inOperand) const ;

//--- Virtual method that checks that all attributes are valid
  public : virtual bool isValid (void) const ;

//--- Virtual method that returns a copy of current object
  public : virtual cCollectionElement * copy (void) ;

//--- Description
 public : virtual void description (C_String & ioString, const PMSInt32 inIndentation) const ;
} ;

//---------------------------------------------------------------------------*

cCollectionElement_prio_5F_list::cCollectionElement_prio_5F_list (const GALGAS_uint & in_fifosize
                                                                  COMMA_LOCATION_ARGS) :
cCollectionElement (THERE),
mAttribute_fifosize (in_fifosize) {
}

//---------------------------------------------------------------------------*

bool cCollectionElement_prio_5F_list::isValid (void) const {
  return mAttribute_fifosize.isValid () ;
}

//---------------------------------------------------------------------------*

cCollectionElement * cCollectionElement_prio_5F_list::copy (void) {
  cCollectionElement * result = NULL ;
  macroMyNew (result, cCollectionElement_prio_5F_list (mAttribute_fifosize COMMA_HERE)) ;
  return result ;
}

//---------------------------------------------------------------------------*

void cCollectionElement_prio_5F_list::description (C_String & /* ioString */, const PMSInt32 /* inIndentation */) const {
// mAttribute_fifosize.description (ioString, inIndentation) ;
}

//---------------------------------------------------------------------------*

enumComparisonResult cCollectionElement_prio_5F_list::compare (const cCollectionElement * inOperand) const {
  cCollectionElement_prio_5F_list * operand = (cCollectionElement_prio_5F_list *) inOperand ;
  enumComparisonResult result = kOperandEqual ;
  if (kOperandEqual == result) {
    result = mAttribute_fifosize.objectCompare (operand->mAttribute_fifosize) ;
  }
  return result ;
}

//---------------------------------------------------------------------------*

GALGAS_prio_5F_list::GALGAS_prio_5F_list (void) :
AC_GALGAS_list () {
}

//---------------------------------------------------------------------------*

GALGAS_prio_5F_list::GALGAS_prio_5F_list (cSharedList * inSharedListPtr) :
AC_GALGAS_list (inSharedListPtr) {
  if (NULL == inSharedListPtr) {
    createNewEmptyList (HERE) ;
  }
}

//---------------------------------------------------------------------------*

GALGAS_prio_5F_list GALGAS_prio_5F_list::constructor_emptyList (LOCATION_ARGS) {
  GALGAS_prio_5F_list result ;
  result.createNewEmptyList (THERE) ;
  return result ;
}

//---------------------------------------------------------------------------*

GALGAS_prio_5F_list GALGAS_prio_5F_list::constructor_listWithValue (const GALGAS_uint & inOperand0
                                                                    COMMA_LOCATION_ARGS) {
  GALGAS_prio_5F_list result ;
  if (inOperand0.isValid ()) {
    result.createNewEmptyList (THERE) ;
    cCollectionElement * p = NULL ;
    macroMyNew (p, cCollectionElement_prio_5F_list (inOperand0 COMMA_THERE)) ;
    capCollectionElement attributes ;
    attributes.setPointer (p) ;
    macroDetachSharedObject (p) ;
    result.addObject (attributes) ;
  }
  return result ;
}

//---------------------------------------------------------------------------*

cCollectionElement_prio_5F_list * GALGAS_prio_5F_list::makeElement (const GALGAS_uint & in_fifosize
                                                                    COMMA_LOCATION_ARGS) {
  cCollectionElement_prio_5F_list * result = NULL ;
  macroMyNew (result, cCollectionElement_prio_5F_list (in_fifosize COMMA_THERE)) ;
  return result ;
}

//---------------------------------------------------------------------------*

void GALGAS_prio_5F_list::addAssign_operation (const GALGAS_uint & inOperand0
                                               COMMA_LOCATION_ARGS) {
  if (isValid () && inOperand0.isValid ()) {
    cCollectionElement * p = NULL ;
    macroMyNew (p, cCollectionElement_prio_5F_list (inOperand0 COMMA_THERE)) ;
    capCollectionElement attributes ;
    attributes.setPointer (p) ;
    macroDetachSharedObject (p) ;
    addObject (attributes) ;
  }
}

//---------------------------------------------------------------------------*

void GALGAS_prio_5F_list::modifier_prependValue (GALGAS_uint inOperand0
                                                 COMMA_LOCATION_ARGS) {
  if (isValid () && inOperand0.isValid ()) {
    cCollectionElement * p = NULL ;
    macroMyNew (p, cCollectionElement_prio_5F_list (inOperand0 COMMA_THERE)) ;
    capCollectionElement attributes ;
    attributes.setPointer (p) ;
    macroDetachSharedObject (p) ;
    prependAttributeArray (attributes) ;
  }
}

//---------------------------------------------------------------------------*

void GALGAS_prio_5F_list::modifier_popFirst (GALGAS_uint & outOperand0,
                                             C_Compiler * inCompiler
                                             COMMA_LOCATION_ARGS) {
  capCollectionElement attributes ;
  removeFirstObject (attributes, inCompiler COMMA_THERE) ;
  cCollectionElement_prio_5F_list * p = (cCollectionElement_prio_5F_list *) attributes.ptr () ;
  if (NULL == p) {
    outOperand0.drop () ;
  }else{
    macroValidSharedObject (p, cCollectionElement_prio_5F_list) ;
    outOperand0 = p->mAttribute_fifosize ;
  }
}

//---------------------------------------------------------------------------*

void GALGAS_prio_5F_list::modifier_popLast (GALGAS_uint & outOperand0,
                                            C_Compiler * inCompiler
                                            COMMA_LOCATION_ARGS) {
  capCollectionElement attributes ;
  removeLastObject (attributes, inCompiler COMMA_THERE) ;
  cCollectionElement_prio_5F_list * p = (cCollectionElement_prio_5F_list *) attributes.ptr () ;
  if (NULL == p) {
    outOperand0.drop () ;
  }else{
    macroValidSharedObject (p, cCollectionElement_prio_5F_list) ;
    outOperand0 = p->mAttribute_fifosize ;
  }
}

//---------------------------------------------------------------------------*

void GALGAS_prio_5F_list::method_first (GALGAS_uint & outOperand0,
                                        C_Compiler * inCompiler
                                        COMMA_LOCATION_ARGS) const {
  capCollectionElement attributes ;
  readFirst (attributes, inCompiler COMMA_THERE) ;
  cCollectionElement_prio_5F_list * p = (cCollectionElement_prio_5F_list *) attributes.ptr () ;
  if (NULL == p) {
    outOperand0.drop () ;
  }else{
    macroValidSharedObject (p, cCollectionElement_prio_5F_list) ;
    outOperand0 = p->mAttribute_fifosize ;
  }
}

//---------------------------------------------------------------------------*

void GALGAS_prio_5F_list::method_last (GALGAS_uint & outOperand0,
                                       C_Compiler * inCompiler
                                       COMMA_LOCATION_ARGS) const {
  capCollectionElement attributes ;
  readLast (attributes, inCompiler COMMA_THERE) ;
  cCollectionElement_prio_5F_list * p = (cCollectionElement_prio_5F_list *) attributes.ptr () ;
  if (NULL == p) {
    outOperand0.drop () ;
  }else{
    macroValidSharedObject (p, cCollectionElement_prio_5F_list) ;
    outOperand0 = p->mAttribute_fifosize ;
  }
}

//---------------------------------------------------------------------------*

GALGAS_prio_5F_list GALGAS_prio_5F_list::operator_concat (const GALGAS_prio_5F_list & inOperand
                                                          COMMA_UNUSED_LOCATION_ARGS) const {
  GALGAS_prio_5F_list result ;
  if (isValid () && inOperand.isValid ()) {
    result = *this ;
    result.appendList (inOperand) ;
  }
  return result ;
}

//---------------------------------------------------------------------------*

GALGAS_prio_5F_list GALGAS_prio_5F_list::reader_subListWithRange (const GALGAS_uint & inIndex,
                                                                  const GALGAS_uint & inLength,
                                                                  C_Compiler * inCompiler
                                                                  COMMA_LOCATION_ARGS) const {
  GALGAS_prio_5F_list result = GALGAS_prio_5F_list::constructor_emptyList (THERE) ;
  subListWithRange (result, inIndex, inLength, inCompiler COMMA_THERE) ;
  return result ;
}

//---------------------------------------------------------------------------*

GALGAS_prio_5F_list GALGAS_prio_5F_list::reader_subListFromIndex (const GALGAS_uint & inIndex,
                                                                  C_Compiler * inCompiler
                                                                  COMMA_LOCATION_ARGS) const {
  GALGAS_prio_5F_list result = GALGAS_prio_5F_list::constructor_emptyList (THERE) ;
  subListFromIndex (result, inIndex, inCompiler COMMA_THERE) ;
  return result ;
}

//---------------------------------------------------------------------------*

void GALGAS_prio_5F_list::dotAssign_operation (const GALGAS_prio_5F_list inOperand
                                               COMMA_UNUSED_LOCATION_ARGS) {
  appendList (inOperand) ;
}

//---------------------------------------------------------------------------*

void GALGAS_prio_5F_list::modifier_setFifosizeAtIndex (GALGAS_uint inOperand,
                                                       GALGAS_uint inIndex,
                                                       C_Compiler * inCompiler
                                                       COMMA_LOCATION_ARGS) {
  cCollectionElement_prio_5F_list * p = (cCollectionElement_prio_5F_list *) objectPointerAtIndex (inIndex, inCompiler COMMA_THERE) ;
  if (NULL != p) {
    macroValidSharedObject (p, cCollectionElement_prio_5F_list) ;
    p->mAttribute_fifosize = inOperand ;
  }
}


//---------------------------------------------------------------------------*

GALGAS_uint GALGAS_prio_5F_list::reader_fifosizeAtIndex (const GALGAS_uint & inIndex,
                                                         C_Compiler * inCompiler
                                                         COMMA_LOCATION_ARGS) const {
  capCollectionElement attributes = readObjectAtIndex (inIndex, inCompiler COMMA_THERE) ;
  cCollectionElement_prio_5F_list * p = (cCollectionElement_prio_5F_list *) attributes.ptr () ;
  GALGAS_uint result ;
  if (NULL != p) {
    macroValidSharedObject (p, cCollectionElement_prio_5F_list) ;
    result = p->mAttribute_fifosize ;
  }
  return result ;
}



//---------------------------------------------------------------------------*

cEnumerator_prio_5F_list::cEnumerator_prio_5F_list (const GALGAS_prio_5F_list & inEnumeratedObject,
                                                    const bool inAscending) :
cGenericAbstractEnumerator () {
  inEnumeratedObject.populateEnumerationArray (mEnumerationArray, inAscending) ;
}

//---------------------------------------------------------------------------*

GALGAS_uint cEnumerator_prio_5F_list::current_fifosize (LOCATION_ARGS) const {
  const cCollectionElement_prio_5F_list * p = (const cCollectionElement_prio_5F_list *) currentObjectPtr (THERE) ;
  macroValidSharedObject (p, const cCollectionElement_prio_5F_list) ;
  return p->mAttribute_fifosize ;
}




//---------------------------------------------------------------------------*
//                                                                           *
//                              @prio_list type                              *
//                                                                           *
//---------------------------------------------------------------------------*

const C_galgas_type_descriptor
kTypeDescriptor_GALGAS_prio_5F_list ("prio_list",
                                     NULL) ;

//---------------------------------------------------------------------------*

const C_galgas_type_descriptor * GALGAS_prio_5F_list::staticTypeDescriptor (void) const {
  return & kTypeDescriptor_GALGAS_prio_5F_list ;
}

//---------------------------------------------------------------------------*

AC_GALGAS_root * GALGAS_prio_5F_list::clonedObject (void) const {
  AC_GALGAS_root * result = NULL ;
  if (isValid ()) {
    macroMyNew (result, GALGAS_prio_5F_list (*this)) ;
  }
  return result ;
}

//---------------------------------------------------------------------------*

GALGAS_prio_5F_list GALGAS_prio_5F_list::extractObject (const GALGAS_object & inObject,
                                                        C_Compiler * inCompiler,
                                                        const GALGAS_location & inErrorLocation
                                                        COMMA_LOCATION_ARGS) {
  GALGAS_prio_5F_list result ;
  const GALGAS_prio_5F_list * p = (const GALGAS_prio_5F_list *) inObject.embeddedObject () ;
  if (NULL != p) {
    if (NULL != dynamic_cast <const GALGAS_prio_5F_list *> (p)) {
      result = *p ;
    }else{
      inCompiler->extractObjectError (inErrorLocation, "prio_list", p->dynamicTypeDescriptor () COMMA_THERE) ;
    }  
  }
  return result ;
}

//---------------------------------------------------------------------------*

cMapElement_prio_5F_map::cMapElement_prio_5F_map (const GALGAS_lstring & inKey,
                                                  const GALGAS_uint & in_prio,
                                                  const GALGAS_uint & in_act
                                                  COMMA_LOCATION_ARGS) :
cMapElement (inKey COMMA_THERE),
mAttribute_prio (in_prio),
mAttribute_act (in_act) {
}

//---------------------------------------------------------------------------*

bool cMapElement_prio_5F_map::isValid (void) const {
  return mAttribute_lkey.isValid () && mAttribute_prio.isValid () && mAttribute_act.isValid () ;
}

//---------------------------------------------------------------------------*

cMapElement * cMapElement_prio_5F_map::copy (void) {
  cMapElement * result = NULL ;
  macroMyNew (result, cMapElement_prio_5F_map (mAttribute_lkey, mAttribute_prio, mAttribute_act COMMA_HERE)) ;
  return result ;
}

//---------------------------------------------------------------------------*

void cMapElement_prio_5F_map::description (C_String & /* ioString */, const PMSInt32 /* inIndentation */) const {
// mAttribute_prio.description (ioString, inIndentation) ;
// mAttribute_act.description (ioString, inIndentation) ;
}

//---------------------------------------------------------------------------*

enumComparisonResult cMapElement_prio_5F_map::compare (const cCollectionElement * inOperand) const {
  cMapElement_prio_5F_map * operand = (cMapElement_prio_5F_map *) inOperand ;
  enumComparisonResult result = mAttribute_lkey.objectCompare (operand->mAttribute_lkey) ;
  if (kOperandEqual == result) {
    result = mAttribute_prio.objectCompare (operand->mAttribute_prio) ;
  }
  if (kOperandEqual == result) {
    result = mAttribute_act.objectCompare (operand->mAttribute_act) ;
  }
  return result ;
}

//---------------------------------------------------------------------------*

GALGAS_prio_5F_map::GALGAS_prio_5F_map (void) :
AC_GALGAS_map () {
}

//---------------------------------------------------------------------------*

GALGAS_prio_5F_map::GALGAS_prio_5F_map (const GALGAS_prio_5F_map & inSource) :
AC_GALGAS_map (inSource) {
}

//---------------------------------------------------------------------------*

GALGAS_prio_5F_map & GALGAS_prio_5F_map::operator = (const GALGAS_prio_5F_map & inSource) {
  * ((AC_GALGAS_map *) this) = inSource ;
  return * this ;
}

//---------------------------------------------------------------------------*

GALGAS_prio_5F_map GALGAS_prio_5F_map::constructor_emptyMap (LOCATION_ARGS) {
  GALGAS_prio_5F_map result ;
  result.makeNewEmptyMap (THERE) ;
  return result ;
}

//---------------------------------------------------------------------------*

GALGAS_prio_5F_map GALGAS_prio_5F_map::constructor_mapWithMapToOverride (const GALGAS_prio_5F_map & inMapToOverride
                                                                         COMMA_LOCATION_ARGS) {
  GALGAS_prio_5F_map result ;
  result.makeNewEmptyMapWithMapToOverride (inMapToOverride COMMA_THERE) ;
  return result ;
}

//---------------------------------------------------------------------------*

GALGAS_prio_5F_map GALGAS_prio_5F_map::reader_overriddenMap (UNUSED_LOCATION_ARGS) const {
  GALGAS_prio_5F_map result ;
  getOverridenMap (result) ;
  return result ;
}
//---------------------------------------------------------------------------*

void GALGAS_prio_5F_map::modifier_put (GALGAS_lstring inKey,
                                       GALGAS_uint inArgument0,
                                       GALGAS_uint inArgument1,
                                       C_Compiler * inCompiler
                                       COMMA_LOCATION_ARGS) {
  cMapElement_prio_5F_map * p = NULL ;
  macroMyNew (p, cMapElement_prio_5F_map (inKey, inArgument0, inArgument1 COMMA_HERE)) ;
  capCollectionElement attributes ;
  attributes.setPointer (p) ;
  macroDetachSharedObject (p) ;
  const char * kInsertErrorMessage = "Object %K is already defined in %L" ;
  const char * kShadowErrorMessage = "" ;
  performInsert (attributes, inCompiler, kInsertErrorMessage, kShadowErrorMessage COMMA_THERE) ;
}

//---------------------------------------------------------------------------*

const char * kSearchErrorMessage_prio_5F_map_get = "Object %K is unkown" ;

//---------------------------------------------------------------------------*

void GALGAS_prio_5F_map::method_get (GALGAS_lstring inKey,
                                     GALGAS_uint & outArgument0,
                                     GALGAS_uint & outArgument1,
                                     C_Compiler * inCompiler
                                     COMMA_LOCATION_ARGS) const {
  const cMapElement_prio_5F_map * p = (const cMapElement_prio_5F_map *) performSearch (inKey,
                                                                                         inCompiler,
                                                                                         kSearchErrorMessage_prio_5F_map_get
                                                                                         COMMA_THERE) ;
  if (NULL == p) {
    outArgument0.drop () ;
    outArgument1.drop () ;
  }else{
    macroValidSharedObject (p, const cMapElement_prio_5F_map) ;
    outArgument0 = p->mAttribute_prio ;
    outArgument1 = p->mAttribute_act ;
  }
}

//---------------------------------------------------------------------------*

GALGAS_uint GALGAS_prio_5F_map::reader_prioForKey (const GALGAS_string & inKey,
                                                   C_Compiler * inCompiler
                                                   COMMA_LOCATION_ARGS) const {
  const cCollectionElement * attributes = searchForReadingAttribute (inKey, inCompiler COMMA_THERE) ;
  const cMapElement_prio_5F_map * p = (const cMapElement_prio_5F_map *) attributes ;
  GALGAS_uint result ;
  if (NULL != p) {
    macroValidSharedObject (p, const cMapElement_prio_5F_map) ;
    result = p->mAttribute_prio ;
  }
  return result ;
}

//---------------------------------------------------------------------------*

GALGAS_uint GALGAS_prio_5F_map::reader_actForKey (const GALGAS_string & inKey,
                                                  C_Compiler * inCompiler
                                                  COMMA_LOCATION_ARGS) const {
  const cCollectionElement * attributes = searchForReadingAttribute (inKey, inCompiler COMMA_THERE) ;
  const cMapElement_prio_5F_map * p = (const cMapElement_prio_5F_map *) attributes ;
  GALGAS_uint result ;
  if (NULL != p) {
    macroValidSharedObject (p, const cMapElement_prio_5F_map) ;
    result = p->mAttribute_act ;
  }
  return result ;
}

//---------------------------------------------------------------------------*

void GALGAS_prio_5F_map::modifier_setPrioForKey (GALGAS_uint inAttributeValue,
                                                 GALGAS_string inKey,
                                                 C_Compiler * inCompiler
                                                 COMMA_LOCATION_ARGS) {
  cCollectionElement * attributes = searchForReadWriteAttribute (inKey, inCompiler COMMA_THERE) ;
  cMapElement_prio_5F_map * p = (cMapElement_prio_5F_map *) attributes ;
  if (NULL != p) {
    macroValidSharedObject (p, cMapElement_prio_5F_map) ;
    p->mAttribute_prio = inAttributeValue ;
  }
}

//---------------------------------------------------------------------------*

void GALGAS_prio_5F_map::modifier_setActForKey (GALGAS_uint inAttributeValue,
                                                GALGAS_string inKey,
                                                C_Compiler * inCompiler
                                                COMMA_LOCATION_ARGS) {
  cCollectionElement * attributes = searchForReadWriteAttribute (inKey, inCompiler COMMA_THERE) ;
  cMapElement_prio_5F_map * p = (cMapElement_prio_5F_map *) attributes ;
  if (NULL != p) {
    macroValidSharedObject (p, cMapElement_prio_5F_map) ;
    p->mAttribute_act = inAttributeValue ;
  }
}

//---------------------------------------------------------------------------*

cMapElement_prio_5F_map * GALGAS_prio_5F_map::readWriteAccessForWithInstruction_get (C_Compiler * inCompiler,
                                                                                     const GALGAS_lstring & inKey
                                                                                     COMMA_LOCATION_ARGS) {
  cMapElement * p = searchForReadWriteAttribute (inKey, inCompiler, kSearchErrorMessage_prio_5F_map_get COMMA_THERE) ;
  cMapElement_prio_5F_map * result = (cMapElement_prio_5F_map *) p ;
  macroNullOrValidSharedObject (result, cMapElement_prio_5F_map) ;
  return result ;
}

//---------------------------------------------------------------------------*

cMapElement_prio_5F_map * GALGAS_prio_5F_map::readWriteAccessForWithInstruction_hasKey (C_Compiler * inCompiler,
                                                                                        const GALGAS_string & inKey
                                                                                        COMMA_LOCATION_ARGS) {
  cMapElement * p = searchForReadWriteAttribute (inKey, inCompiler COMMA_THERE) ;
  cMapElement_prio_5F_map * result = (cMapElement_prio_5F_map *) p ;
  macroNullOrValidSharedObject (result, cMapElement_prio_5F_map) ;
  return result ;
}

//---------------------------------------------------------------------------*

cEnumerator_prio_5F_map::cEnumerator_prio_5F_map (const GALGAS_prio_5F_map & inEnumeratedObject,
                                                  const bool inAscending) :
cGenericAbstractEnumerator () {
  inEnumeratedObject.populateEnumerationArray (mEnumerationArray, inAscending) ;
}

//---------------------------------------------------------------------------*

GALGAS_lstring cEnumerator_prio_5F_map::current_lkey (LOCATION_ARGS) const {
  const cMapElement * p = (const cMapElement *) currentObjectPtr (THERE) ;
  macroValidSharedObject (p, const cMapElement) ;
  return p->mAttribute_lkey ;
}

//---------------------------------------------------------------------------*

GALGAS_uint cEnumerator_prio_5F_map::current_prio (LOCATION_ARGS) const {
  const cMapElement_prio_5F_map * p = (const cMapElement_prio_5F_map *) currentObjectPtr (THERE) ;
  macroValidSharedObject (p, const cMapElement_prio_5F_map) ;
  return p->mAttribute_prio ;
}

//---------------------------------------------------------------------------*

GALGAS_uint cEnumerator_prio_5F_map::current_act (LOCATION_ARGS) const {
  const cMapElement_prio_5F_map * p = (const cMapElement_prio_5F_map *) currentObjectPtr (THERE) ;
  macroValidSharedObject (p, const cMapElement_prio_5F_map) ;
  return p->mAttribute_act ;
}



//---------------------------------------------------------------------------*
//                                                                           *
//                              @prio_map type                               *
//                                                                           *
//---------------------------------------------------------------------------*

const C_galgas_type_descriptor
kTypeDescriptor_GALGAS_prio_5F_map ("prio_map",
                                    NULL) ;

//---------------------------------------------------------------------------*

const C_galgas_type_descriptor * GALGAS_prio_5F_map::staticTypeDescriptor (void) const {
  return & kTypeDescriptor_GALGAS_prio_5F_map ;
}

//---------------------------------------------------------------------------*

AC_GALGAS_root * GALGAS_prio_5F_map::clonedObject (void) const {
  AC_GALGAS_root * result = NULL ;
  if (isValid ()) {
    macroMyNew (result, GALGAS_prio_5F_map (*this)) ;
  }
  return result ;
}

//---------------------------------------------------------------------------*

GALGAS_prio_5F_map GALGAS_prio_5F_map::extractObject (const GALGAS_object & inObject,
                                                      C_Compiler * inCompiler,
                                                      const GALGAS_location & inErrorLocation
                                                      COMMA_LOCATION_ARGS) {
  GALGAS_prio_5F_map result ;
  const GALGAS_prio_5F_map * p = (const GALGAS_prio_5F_map *) inObject.embeddedObject () ;
  if (NULL != p) {
    if (NULL != dynamic_cast <const GALGAS_prio_5F_map *> (p)) {
      result = *p ;
    }else{
      inCompiler->extractObjectError (inErrorLocation, "prio_map", p->dynamicTypeDescriptor () COMMA_THERE) ;
    }  
  }
  return result ;
}

//---------------------------------------------------------------------------*

enumComparisonResult GALGAS_task_5F_obj::objectCompare (const GALGAS_task_5F_obj & inOperand) const {
  enumComparisonResult result = GALGAS_oil_5F_obj::objectCompare (inOperand) ;
  const cPtr_task_5F_obj * p = (const cPtr_task_5F_obj *) mObjectPtr ;
  macroNullOrValidSharedObject (p, const cPtr_task_5F_obj) ;
  const cPtr_task_5F_obj * q = (const cPtr_task_5F_obj *) inOperand.mObjectPtr ;
  macroNullOrValidSharedObject (q, const cPtr_task_5F_obj) ;
  if (kOperandEqual == result) {
    result = p->mAttribute_priority.objectCompare (q->mAttribute_priority) ;
  }
  if (kOperandEqual == result) {
    result = p->mAttribute_schedule.objectCompare (q->mAttribute_schedule) ;
  }
  if (kOperandEqual == result) {
    result = p->mAttribute_activation.objectCompare (q->mAttribute_activation) ;
  }
  if (kOperandEqual == result) {
    result = p->mAttribute_autostart.objectCompare (q->mAttribute_autostart) ;
  }
  if (kOperandEqual == result) {
    result = p->mAttribute_resources.objectCompare (q->mAttribute_resources) ;
  }
  if (kOperandEqual == result) {
    result = p->mAttribute_events.objectCompare (q->mAttribute_events) ;
  }
  if (kOperandEqual == result) {
    result = p->mAttribute_messages.objectCompare (q->mAttribute_messages) ;
  }
  if (kOperandEqual == result) {
    result = p->mAttribute_acc_5F_apps.objectCompare (q->mAttribute_acc_5F_apps) ;
  }
  if (kOperandEqual == result) {
    result = p->mAttribute_timing_5F_prot.objectCompare (q->mAttribute_timing_5F_prot) ;
  }
  if (kOperandEqual == result) {
    result = p->mAttribute_others.objectCompare (q->mAttribute_others) ;
  }
  return result ;
}


//---------------------------------------------------------------------------*

GALGAS_task_5F_obj::GALGAS_task_5F_obj (void) :
GALGAS_oil_5F_obj () {
}

//---------------------------------------------------------------------------*

GALGAS_task_5F_obj::GALGAS_task_5F_obj (const cPtr_task_5F_obj * inSourcePtr) :
GALGAS_oil_5F_obj (inSourcePtr) {
  macroNullOrValidSharedObject (inSourcePtr, const cPtr_task_5F_obj) ;
}

//---------------------------------------------------------------------------*

GALGAS_task_5F_obj GALGAS_task_5F_obj::constructor_new (const GALGAS_lstring & inAttribute_desc,
                                                        const GALGAS_basic_5F_type & inAttribute_priority,
                                                        const GALGAS_lstring & inAttribute_schedule,
                                                        const GALGAS_basic_5F_type & inAttribute_activation,
                                                        const GALGAS_task_5F_autostart_5F_obj & inAttribute_autostart,
                                                        const GALGAS_lstringlist & inAttribute_resources,
                                                        const GALGAS_lstringlist & inAttribute_events,
                                                        const GALGAS_lstringlist & inAttribute_messages,
                                                        const GALGAS_lstringlist & inAttribute_acc_5F_apps,
                                                        const GALGAS_timing_5F_prot & inAttribute_timing_5F_prot,
                                                        const GALGAS_ident_5F_map & inAttribute_others
                                                        COMMA_LOCATION_ARGS) {
  GALGAS_task_5F_obj result ;
  if (inAttribute_desc.isValid () && inAttribute_priority.isValid () && inAttribute_schedule.isValid () && inAttribute_activation.isValid () && inAttribute_autostart.isValid () && inAttribute_resources.isValid () && inAttribute_events.isValid () && inAttribute_messages.isValid () && inAttribute_acc_5F_apps.isValid () && inAttribute_timing_5F_prot.isValid () && inAttribute_others.isValid ()) {
    macroMyNew (result.mObjectPtr, cPtr_task_5F_obj (inAttribute_desc, inAttribute_priority, inAttribute_schedule, inAttribute_activation, inAttribute_autostart, inAttribute_resources, inAttribute_events, inAttribute_messages, inAttribute_acc_5F_apps, inAttribute_timing_5F_prot, inAttribute_others COMMA_THERE)) ;
  }
  return result ;
}

//---------------------------------------------------------------------------*

void GALGAS_task_5F_obj::insulate (LOCATION_ARGS) {
  if (isValid () && (mObjectPtr->retainCount () > 1)) {
    cPtr_task_5F_obj * p = (cPtr_task_5F_obj *) mObjectPtr ;
    macroValidSharedObject (p, cPtr_task_5F_obj) ;
    cPtr_task_5F_obj * r = NULL ;
    macroMyNew (r, cPtr_task_5F_obj (p->mAttribute_desc, p->mAttribute_priority, p->mAttribute_schedule, p->mAttribute_activation, p->mAttribute_autostart, p->mAttribute_resources, p->mAttribute_events, p->mAttribute_messages, p->mAttribute_acc_5F_apps, p->mAttribute_timing_5F_prot, p->mAttribute_others COMMA_THERE)) ;
    macroAssignSharedObject (mObjectPtr, r) ;
    macroDetachSharedObject (r) ;
  }
}

//---------------------------------------------------------------------------*

GALGAS_basic_5F_type GALGAS_task_5F_obj::reader_priority (UNUSED_LOCATION_ARGS) const {
  GALGAS_basic_5F_type result ;
  if (NULL != mObjectPtr) {
    const cPtr_task_5F_obj * p = (const cPtr_task_5F_obj *) mObjectPtr ;
    macroValidSharedObject (p, const cPtr_task_5F_obj) ;
    result = p->mAttribute_priority ;
  }
  return result ;
}

//---------------------------------------------------------------------------*

GALGAS_lstring GALGAS_task_5F_obj::reader_schedule (UNUSED_LOCATION_ARGS) const {
  GALGAS_lstring result ;
  if (NULL != mObjectPtr) {
    const cPtr_task_5F_obj * p = (const cPtr_task_5F_obj *) mObjectPtr ;
    macroValidSharedObject (p, const cPtr_task_5F_obj) ;
    result = p->mAttribute_schedule ;
  }
  return result ;
}

//---------------------------------------------------------------------------*

GALGAS_basic_5F_type GALGAS_task_5F_obj::reader_activation (UNUSED_LOCATION_ARGS) const {
  GALGAS_basic_5F_type result ;
  if (NULL != mObjectPtr) {
    const cPtr_task_5F_obj * p = (const cPtr_task_5F_obj *) mObjectPtr ;
    macroValidSharedObject (p, const cPtr_task_5F_obj) ;
    result = p->mAttribute_activation ;
  }
  return result ;
}

//---------------------------------------------------------------------------*

GALGAS_task_5F_autostart_5F_obj GALGAS_task_5F_obj::reader_autostart (UNUSED_LOCATION_ARGS) const {
  GALGAS_task_5F_autostart_5F_obj result ;
  if (NULL != mObjectPtr) {
    const cPtr_task_5F_obj * p = (const cPtr_task_5F_obj *) mObjectPtr ;
    macroValidSharedObject (p, const cPtr_task_5F_obj) ;
    result = p->mAttribute_autostart ;
  }
  return result ;
}

//---------------------------------------------------------------------------*

GALGAS_lstringlist GALGAS_task_5F_obj::reader_resources (UNUSED_LOCATION_ARGS) const {
  GALGAS_lstringlist result ;
  if (NULL != mObjectPtr) {
    const cPtr_task_5F_obj * p = (const cPtr_task_5F_obj *) mObjectPtr ;
    macroValidSharedObject (p, const cPtr_task_5F_obj) ;
    result = p->mAttribute_resources ;
  }
  return result ;
}

//---------------------------------------------------------------------------*

GALGAS_lstringlist GALGAS_task_5F_obj::reader_events (UNUSED_LOCATION_ARGS) const {
  GALGAS_lstringlist result ;
  if (NULL != mObjectPtr) {
    const cPtr_task_5F_obj * p = (const cPtr_task_5F_obj *) mObjectPtr ;
    macroValidSharedObject (p, const cPtr_task_5F_obj) ;
    result = p->mAttribute_events ;
  }
  return result ;
}

//---------------------------------------------------------------------------*

GALGAS_lstringlist GALGAS_task_5F_obj::reader_messages (UNUSED_LOCATION_ARGS) const {
  GALGAS_lstringlist result ;
  if (NULL != mObjectPtr) {
    const cPtr_task_5F_obj * p = (const cPtr_task_5F_obj *) mObjectPtr ;
    macroValidSharedObject (p, const cPtr_task_5F_obj) ;
    result = p->mAttribute_messages ;
  }
  return result ;
}

//---------------------------------------------------------------------------*

GALGAS_lstringlist GALGAS_task_5F_obj::reader_acc_5F_apps (UNUSED_LOCATION_ARGS) const {
  GALGAS_lstringlist result ;
  if (NULL != mObjectPtr) {
    const cPtr_task_5F_obj * p = (const cPtr_task_5F_obj *) mObjectPtr ;
    macroValidSharedObject (p, const cPtr_task_5F_obj) ;
    result = p->mAttribute_acc_5F_apps ;
  }
  return result ;
}

//---------------------------------------------------------------------------*

GALGAS_timing_5F_prot GALGAS_task_5F_obj::reader_timing_5F_prot (UNUSED_LOCATION_ARGS) const {
  GALGAS_timing_5F_prot result ;
  if (NULL != mObjectPtr) {
    const cPtr_task_5F_obj * p = (const cPtr_task_5F_obj *) mObjectPtr ;
    macroValidSharedObject (p, const cPtr_task_5F_obj) ;
    result = p->mAttribute_timing_5F_prot ;
  }
  return result ;
}

//---------------------------------------------------------------------------*

GALGAS_ident_5F_map GALGAS_task_5F_obj::reader_others (UNUSED_LOCATION_ARGS) const {
  GALGAS_ident_5F_map result ;
  if (NULL != mObjectPtr) {
    const cPtr_task_5F_obj * p = (const cPtr_task_5F_obj *) mObjectPtr ;
    macroValidSharedObject (p, const cPtr_task_5F_obj) ;
    result = p->mAttribute_others ;
  }
  return result ;
}

//---------------------------------------------------------------------------*

void GALGAS_task_5F_obj::modifier_setPriority (GALGAS_basic_5F_type inValue
                                               COMMA_UNUSED_LOCATION_ARGS) {
  if (NULL != mObjectPtr) {
    cPtr_task_5F_obj * p = (cPtr_task_5F_obj *) mObjectPtr ;
    macroValidSharedObject (p, cPtr_task_5F_obj) ;
    p->mAttribute_priority = inValue ;
  }
}

//---------------------------------------------------------------------------*

void GALGAS_task_5F_obj::modifier_setSchedule (GALGAS_lstring inValue
                                               COMMA_UNUSED_LOCATION_ARGS) {
  if (NULL != mObjectPtr) {
    cPtr_task_5F_obj * p = (cPtr_task_5F_obj *) mObjectPtr ;
    macroValidSharedObject (p, cPtr_task_5F_obj) ;
    p->mAttribute_schedule = inValue ;
  }
}

//---------------------------------------------------------------------------*

void GALGAS_task_5F_obj::modifier_setActivation (GALGAS_basic_5F_type inValue
                                                 COMMA_UNUSED_LOCATION_ARGS) {
  if (NULL != mObjectPtr) {
    cPtr_task_5F_obj * p = (cPtr_task_5F_obj *) mObjectPtr ;
    macroValidSharedObject (p, cPtr_task_5F_obj) ;
    p->mAttribute_activation = inValue ;
  }
}

//---------------------------------------------------------------------------*

void GALGAS_task_5F_obj::modifier_setAutostart (GALGAS_task_5F_autostart_5F_obj inValue
                                                COMMA_UNUSED_LOCATION_ARGS) {
  if (NULL != mObjectPtr) {
    cPtr_task_5F_obj * p = (cPtr_task_5F_obj *) mObjectPtr ;
    macroValidSharedObject (p, cPtr_task_5F_obj) ;
    p->mAttribute_autostart = inValue ;
  }
}

//---------------------------------------------------------------------------*

void GALGAS_task_5F_obj::modifier_setResources (GALGAS_lstringlist inValue
                                                COMMA_UNUSED_LOCATION_ARGS) {
  if (NULL != mObjectPtr) {
    cPtr_task_5F_obj * p = (cPtr_task_5F_obj *) mObjectPtr ;
    macroValidSharedObject (p, cPtr_task_5F_obj) ;
    p->mAttribute_resources = inValue ;
  }
}

//---------------------------------------------------------------------------*

void GALGAS_task_5F_obj::modifier_setEvents (GALGAS_lstringlist inValue
                                             COMMA_UNUSED_LOCATION_ARGS) {
  if (NULL != mObjectPtr) {
    cPtr_task_5F_obj * p = (cPtr_task_5F_obj *) mObjectPtr ;
    macroValidSharedObject (p, cPtr_task_5F_obj) ;
    p->mAttribute_events = inValue ;
  }
}

//---------------------------------------------------------------------------*

void GALGAS_task_5F_obj::modifier_setMessages (GALGAS_lstringlist inValue
                                               COMMA_UNUSED_LOCATION_ARGS) {
  if (NULL != mObjectPtr) {
    cPtr_task_5F_obj * p = (cPtr_task_5F_obj *) mObjectPtr ;
    macroValidSharedObject (p, cPtr_task_5F_obj) ;
    p->mAttribute_messages = inValue ;
  }
}

//---------------------------------------------------------------------------*

void GALGAS_task_5F_obj::modifier_setAcc_5F_apps (GALGAS_lstringlist inValue
                                                  COMMA_UNUSED_LOCATION_ARGS) {
  if (NULL != mObjectPtr) {
    cPtr_task_5F_obj * p = (cPtr_task_5F_obj *) mObjectPtr ;
    macroValidSharedObject (p, cPtr_task_5F_obj) ;
    p->mAttribute_acc_5F_apps = inValue ;
  }
}

//---------------------------------------------------------------------------*

void GALGAS_task_5F_obj::modifier_setTiming_5F_prot (GALGAS_timing_5F_prot inValue
                                                     COMMA_UNUSED_LOCATION_ARGS) {
  if (NULL != mObjectPtr) {
    cPtr_task_5F_obj * p = (cPtr_task_5F_obj *) mObjectPtr ;
    macroValidSharedObject (p, cPtr_task_5F_obj) ;
    p->mAttribute_timing_5F_prot = inValue ;
  }
}

//---------------------------------------------------------------------------*

void GALGAS_task_5F_obj::modifier_setOthers (GALGAS_ident_5F_map inValue
                                             COMMA_UNUSED_LOCATION_ARGS) {
  if (NULL != mObjectPtr) {
    cPtr_task_5F_obj * p = (cPtr_task_5F_obj *) mObjectPtr ;
    macroValidSharedObject (p, cPtr_task_5F_obj) ;
    p->mAttribute_others = inValue ;
  }
}

//---------------------------------------------------------------------------*
//                     Pointer class for @task_obj class                     *
//---------------------------------------------------------------------------*

cPtr_task_5F_obj::cPtr_task_5F_obj (const GALGAS_lstring & in_desc,
                                    const GALGAS_basic_5F_type & in_priority,
                                    const GALGAS_lstring & in_schedule,
                                    const GALGAS_basic_5F_type & in_activation,
                                    const GALGAS_task_5F_autostart_5F_obj & in_autostart,
                                    const GALGAS_lstringlist & in_resources,
                                    const GALGAS_lstringlist & in_events,
                                    const GALGAS_lstringlist & in_messages,
                                    const GALGAS_lstringlist & in_acc_5F_apps,
                                    const GALGAS_timing_5F_prot & in_timing_5F_prot,
                                    const GALGAS_ident_5F_map & in_others
                                    COMMA_LOCATION_ARGS) :
cPtr_oil_5F_obj (in_desc COMMA_THERE),
mAttribute_priority (in_priority),
mAttribute_schedule (in_schedule),
mAttribute_activation (in_activation),
mAttribute_autostart (in_autostart),
mAttribute_resources (in_resources),
mAttribute_events (in_events),
mAttribute_messages (in_messages),
mAttribute_acc_5F_apps (in_acc_5F_apps),
mAttribute_timing_5F_prot (in_timing_5F_prot),
mAttribute_others (in_others) {
}

//---------------------------------------------------------------------------*

const C_galgas_type_descriptor * cPtr_task_5F_obj::classDescriptor (void) const {
  return & kTypeDescriptor_GALGAS_task_5F_obj ;
}

void cPtr_task_5F_obj::description (C_String & ioString,
                                    const PMSInt32 inIndentation) const {
  ioString << "[@task_obj:" ;
  mAttribute_desc.description (ioString, inIndentation+1) ;
  ioString << ", " ;
  mAttribute_priority.description (ioString, inIndentation+1) ;
  ioString << ", " ;
  mAttribute_schedule.description (ioString, inIndentation+1) ;
  ioString << ", " ;
  mAttribute_activation.description (ioString, inIndentation+1) ;
  ioString << ", " ;
  mAttribute_autostart.description (ioString, inIndentation+1) ;
  ioString << ", " ;
  mAttribute_resources.description (ioString, inIndentation+1) ;
  ioString << ", " ;
  mAttribute_events.description (ioString, inIndentation+1) ;
  ioString << ", " ;
  mAttribute_messages.description (ioString, inIndentation+1) ;
  ioString << ", " ;
  mAttribute_acc_5F_apps.description (ioString, inIndentation+1) ;
  ioString << ", " ;
  mAttribute_timing_5F_prot.description (ioString, inIndentation+1) ;
  ioString << ", " ;
  mAttribute_others.description (ioString, inIndentation+1) ;
  ioString << "]" ;
}



//---------------------------------------------------------------------------*
//                                                                           *
//                              @task_obj type                               *
//                                                                           *
//---------------------------------------------------------------------------*

const C_galgas_type_descriptor
kTypeDescriptor_GALGAS_task_5F_obj ("task_obj",
                                    & kTypeDescriptor_GALGAS_oil_5F_obj) ;

//---------------------------------------------------------------------------*

const C_galgas_type_descriptor * GALGAS_task_5F_obj::staticTypeDescriptor (void) const {
  return & kTypeDescriptor_GALGAS_task_5F_obj ;
}

//---------------------------------------------------------------------------*

AC_GALGAS_root * GALGAS_task_5F_obj::clonedObject (void) const {
  AC_GALGAS_root * result = NULL ;
  if (isValid ()) {
    macroMyNew (result, GALGAS_task_5F_obj (*this)) ;
  }
  return result ;
}

//---------------------------------------------------------------------------*

GALGAS_task_5F_obj GALGAS_task_5F_obj::extractObject (const GALGAS_object & inObject,
                                                      C_Compiler * inCompiler,
                                                      const GALGAS_location & inErrorLocation
                                                      COMMA_LOCATION_ARGS) {
  GALGAS_task_5F_obj result ;
  const GALGAS_task_5F_obj * p = (const GALGAS_task_5F_obj *) inObject.embeddedObject () ;
  if (NULL != p) {
    if (NULL != dynamic_cast <const GALGAS_task_5F_obj *> (p)) {
      result = *p ;
    }else{
      inCompiler->extractObjectError (inErrorLocation, "task_obj", p->dynamicTypeDescriptor () COMMA_THERE) ;
    }  
  }
  return result ;
}

//---------------------------------------------------------------------------*

enumComparisonResult GALGAS_task_5F_autostart_5F_obj::objectCompare (const GALGAS_task_5F_autostart_5F_obj & inOperand) const {
  enumComparisonResult result = kOperandEqual ;
  const cPtr_task_5F_autostart_5F_obj * p = (const cPtr_task_5F_autostart_5F_obj *) mObjectPtr ;
  macroNullOrValidSharedObject (p, const cPtr_task_5F_autostart_5F_obj) ;
  const cPtr_task_5F_autostart_5F_obj * q = (const cPtr_task_5F_autostart_5F_obj *) inOperand.mObjectPtr ;
  macroNullOrValidSharedObject (q, const cPtr_task_5F_autostart_5F_obj) ;
  if (kOperandEqual == result) {
    result = p->mAttribute_location.objectCompare (q->mAttribute_location) ;
  }
  return result ;
}


//---------------------------------------------------------------------------*

GALGAS_task_5F_autostart_5F_obj::GALGAS_task_5F_autostart_5F_obj (void) :
AC_GALGAS_class () {
}

//---------------------------------------------------------------------------*

GALGAS_task_5F_autostart_5F_obj::GALGAS_task_5F_autostart_5F_obj (const cPtr_task_5F_autostart_5F_obj * inSourcePtr) :
AC_GALGAS_class (inSourcePtr) {
  macroNullOrValidSharedObject (inSourcePtr, const cPtr_task_5F_autostart_5F_obj) ;
}

//---------------------------------------------------------------------------*

GALGAS_location GALGAS_task_5F_autostart_5F_obj::reader_location (UNUSED_LOCATION_ARGS) const {
  GALGAS_location result ;
  if (NULL != mObjectPtr) {
    const cPtr_task_5F_autostart_5F_obj * p = (const cPtr_task_5F_autostart_5F_obj *) mObjectPtr ;
    macroValidSharedObject (p, const cPtr_task_5F_autostart_5F_obj) ;
    result = p->mAttribute_location ;
  }
  return result ;
}

//---------------------------------------------------------------------------*
//                Pointer class for @task_autostart_obj class                *
//---------------------------------------------------------------------------*

cPtr_task_5F_autostart_5F_obj::cPtr_task_5F_autostart_5F_obj (const GALGAS_location & in_location
                                                              COMMA_LOCATION_ARGS) :
acPtr_class (THERE),
mAttribute_location (in_location) {
}



//---------------------------------------------------------------------------*
//                                                                           *
//                         @task_autostart_obj type                          *
//                                                                           *
//---------------------------------------------------------------------------*

const C_galgas_type_descriptor
kTypeDescriptor_GALGAS_task_5F_autostart_5F_obj ("task_autostart_obj",
                                                 NULL) ;

//---------------------------------------------------------------------------*

const C_galgas_type_descriptor * GALGAS_task_5F_autostart_5F_obj::staticTypeDescriptor (void) const {
  return & kTypeDescriptor_GALGAS_task_5F_autostart_5F_obj ;
}

//---------------------------------------------------------------------------*

AC_GALGAS_root * GALGAS_task_5F_autostart_5F_obj::clonedObject (void) const {
  AC_GALGAS_root * result = NULL ;
  if (isValid ()) {
    macroMyNew (result, GALGAS_task_5F_autostart_5F_obj (*this)) ;
  }
  return result ;
}

//---------------------------------------------------------------------------*

GALGAS_task_5F_autostart_5F_obj GALGAS_task_5F_autostart_5F_obj::extractObject (const GALGAS_object & inObject,
                                                                                C_Compiler * inCompiler,
                                                                                const GALGAS_location & inErrorLocation
                                                                                COMMA_LOCATION_ARGS) {
  GALGAS_task_5F_autostart_5F_obj result ;
  const GALGAS_task_5F_autostart_5F_obj * p = (const GALGAS_task_5F_autostart_5F_obj *) inObject.embeddedObject () ;
  if (NULL != p) {
    if (NULL != dynamic_cast <const GALGAS_task_5F_autostart_5F_obj *> (p)) {
      result = *p ;
    }else{
      inCompiler->extractObjectError (inErrorLocation, "task_autostart_obj", p->dynamicTypeDescriptor () COMMA_THERE) ;
    }  
  }
  return result ;
}

//---------------------------------------------------------------------------*

enumComparisonResult GALGAS_task_5F_autostart_5F_false::objectCompare (const GALGAS_task_5F_autostart_5F_false & inOperand) const {
  return (isValid () && inOperand.isValid ()) ? kOperandEqual : kOperandNotValid ;
}


//---------------------------------------------------------------------------*

GALGAS_task_5F_autostart_5F_false::GALGAS_task_5F_autostart_5F_false (void) :
GALGAS_task_5F_autostart_5F_obj () {
}

//---------------------------------------------------------------------------*

GALGAS_task_5F_autostart_5F_false::GALGAS_task_5F_autostart_5F_false (const cPtr_task_5F_autostart_5F_false * inSourcePtr) :
GALGAS_task_5F_autostart_5F_obj (inSourcePtr) {
  macroNullOrValidSharedObject (inSourcePtr, const cPtr_task_5F_autostart_5F_false) ;
}

//---------------------------------------------------------------------------*

GALGAS_task_5F_autostart_5F_false GALGAS_task_5F_autostart_5F_false::constructor_new (const GALGAS_location & inAttribute_location
                                                                                      COMMA_LOCATION_ARGS) {
  GALGAS_task_5F_autostart_5F_false result ;
  if (inAttribute_location.isValid ()) {
    macroMyNew (result.mObjectPtr, cPtr_task_5F_autostart_5F_false (inAttribute_location COMMA_THERE)) ;
  }
  return result ;
}

//---------------------------------------------------------------------------*

void GALGAS_task_5F_autostart_5F_false::insulate (LOCATION_ARGS) {
  if (isValid () && (mObjectPtr->retainCount () > 1)) {
    cPtr_task_5F_autostart_5F_false * p = (cPtr_task_5F_autostart_5F_false *) mObjectPtr ;
    macroValidSharedObject (p, cPtr_task_5F_autostart_5F_false) ;
    cPtr_task_5F_autostart_5F_false * r = NULL ;
    macroMyNew (r, cPtr_task_5F_autostart_5F_false (p->mAttribute_location COMMA_THERE)) ;
    macroAssignSharedObject (mObjectPtr, r) ;
    macroDetachSharedObject (r) ;
  }
}

//---------------------------------------------------------------------------*
//               Pointer class for @task_autostart_false class               *
//---------------------------------------------------------------------------*

cPtr_task_5F_autostart_5F_false::cPtr_task_5F_autostart_5F_false (const GALGAS_location & in_location
                                                                  COMMA_LOCATION_ARGS) :
cPtr_task_5F_autostart_5F_obj (in_location COMMA_THERE) {
}

//---------------------------------------------------------------------------*

const C_galgas_type_descriptor * cPtr_task_5F_autostart_5F_false::classDescriptor (void) const {
  return & kTypeDescriptor_GALGAS_task_5F_autostart_5F_false ;
}

void cPtr_task_5F_autostart_5F_false::description (C_String & ioString,
                                                   const PMSInt32 inIndentation) const {
  ioString << "[@task_autostart_false:" ;
  mAttribute_location.description (ioString, inIndentation+1) ;
  ioString << "]" ;
}



//---------------------------------------------------------------------------*
//                                                                           *
//                        @task_autostart_false type                         *
//                                                                           *
//---------------------------------------------------------------------------*

const C_galgas_type_descriptor
kTypeDescriptor_GALGAS_task_5F_autostart_5F_false ("task_autostart_false",
                                                   & kTypeDescriptor_GALGAS_task_5F_autostart_5F_obj) ;

//---------------------------------------------------------------------------*

const C_galgas_type_descriptor * GALGAS_task_5F_autostart_5F_false::staticTypeDescriptor (void) const {
  return & kTypeDescriptor_GALGAS_task_5F_autostart_5F_false ;
}

//---------------------------------------------------------------------------*

AC_GALGAS_root * GALGAS_task_5F_autostart_5F_false::clonedObject (void) const {
  AC_GALGAS_root * result = NULL ;
  if (isValid ()) {
    macroMyNew (result, GALGAS_task_5F_autostart_5F_false (*this)) ;
  }
  return result ;
}

//---------------------------------------------------------------------------*

GALGAS_task_5F_autostart_5F_false GALGAS_task_5F_autostart_5F_false::extractObject (const GALGAS_object & inObject,
                                                                                    C_Compiler * inCompiler,
                                                                                    const GALGAS_location & inErrorLocation
                                                                                    COMMA_LOCATION_ARGS) {
  GALGAS_task_5F_autostart_5F_false result ;
  const GALGAS_task_5F_autostart_5F_false * p = (const GALGAS_task_5F_autostart_5F_false *) inObject.embeddedObject () ;
  if (NULL != p) {
    if (NULL != dynamic_cast <const GALGAS_task_5F_autostart_5F_false *> (p)) {
      result = *p ;
    }else{
      inCompiler->extractObjectError (inErrorLocation, "task_autostart_false", p->dynamicTypeDescriptor () COMMA_THERE) ;
    }  
  }
  return result ;
}

//---------------------------------------------------------------------------*

enumComparisonResult GALGAS_task_5F_autostart_5F_true::objectCompare (const GALGAS_task_5F_autostart_5F_true & inOperand) const {
  enumComparisonResult result = GALGAS_task_5F_autostart_5F_obj::objectCompare (inOperand) ;
  const cPtr_task_5F_autostart_5F_true * p = (const cPtr_task_5F_autostart_5F_true *) mObjectPtr ;
  macroNullOrValidSharedObject (p, const cPtr_task_5F_autostart_5F_true) ;
  const cPtr_task_5F_autostart_5F_true * q = (const cPtr_task_5F_autostart_5F_true *) inOperand.mObjectPtr ;
  macroNullOrValidSharedObject (q, const cPtr_task_5F_autostart_5F_true) ;
  if (kOperandEqual == result) {
    result = p->mAttribute_appmodes.objectCompare (q->mAttribute_appmodes) ;
  }
  return result ;
}


//---------------------------------------------------------------------------*

GALGAS_task_5F_autostart_5F_true::GALGAS_task_5F_autostart_5F_true (void) :
GALGAS_task_5F_autostart_5F_obj () {
}

//---------------------------------------------------------------------------*

GALGAS_task_5F_autostart_5F_true::GALGAS_task_5F_autostart_5F_true (const cPtr_task_5F_autostart_5F_true * inSourcePtr) :
GALGAS_task_5F_autostart_5F_obj (inSourcePtr) {
  macroNullOrValidSharedObject (inSourcePtr, const cPtr_task_5F_autostart_5F_true) ;
}

//---------------------------------------------------------------------------*

GALGAS_task_5F_autostart_5F_true GALGAS_task_5F_autostart_5F_true::constructor_new (const GALGAS_location & inAttribute_location,
                                                                                    const GALGAS_stringset & inAttribute_appmodes
                                                                                    COMMA_LOCATION_ARGS) {
  GALGAS_task_5F_autostart_5F_true result ;
  if (inAttribute_location.isValid () && inAttribute_appmodes.isValid ()) {
    macroMyNew (result.mObjectPtr, cPtr_task_5F_autostart_5F_true (inAttribute_location, inAttribute_appmodes COMMA_THERE)) ;
  }
  return result ;
}

//---------------------------------------------------------------------------*

void GALGAS_task_5F_autostart_5F_true::insulate (LOCATION_ARGS) {
  if (isValid () && (mObjectPtr->retainCount () > 1)) {
    cPtr_task_5F_autostart_5F_true * p = (cPtr_task_5F_autostart_5F_true *) mObjectPtr ;
    macroValidSharedObject (p, cPtr_task_5F_autostart_5F_true) ;
    cPtr_task_5F_autostart_5F_true * r = NULL ;
    macroMyNew (r, cPtr_task_5F_autostart_5F_true (p->mAttribute_location, p->mAttribute_appmodes COMMA_THERE)) ;
    macroAssignSharedObject (mObjectPtr, r) ;
    macroDetachSharedObject (r) ;
  }
}

//---------------------------------------------------------------------------*

GALGAS_stringset GALGAS_task_5F_autostart_5F_true::reader_appmodes (UNUSED_LOCATION_ARGS) const {
  GALGAS_stringset result ;
  if (NULL != mObjectPtr) {
    const cPtr_task_5F_autostart_5F_true * p = (const cPtr_task_5F_autostart_5F_true *) mObjectPtr ;
    macroValidSharedObject (p, const cPtr_task_5F_autostart_5F_true) ;
    result = p->mAttribute_appmodes ;
  }
  return result ;
}

//---------------------------------------------------------------------------*
//               Pointer class for @task_autostart_true class                *
//---------------------------------------------------------------------------*

cPtr_task_5F_autostart_5F_true::cPtr_task_5F_autostart_5F_true (const GALGAS_location & in_location,
                                                                const GALGAS_stringset & in_appmodes
                                                                COMMA_LOCATION_ARGS) :
cPtr_task_5F_autostart_5F_obj (in_location COMMA_THERE),
mAttribute_appmodes (in_appmodes) {
}

//---------------------------------------------------------------------------*

const C_galgas_type_descriptor * cPtr_task_5F_autostart_5F_true::classDescriptor (void) const {
  return & kTypeDescriptor_GALGAS_task_5F_autostart_5F_true ;
}

void cPtr_task_5F_autostart_5F_true::description (C_String & ioString,
                                                  const PMSInt32 inIndentation) const {
  ioString << "[@task_autostart_true:" ;
  mAttribute_location.description (ioString, inIndentation+1) ;
  ioString << ", " ;
  mAttribute_appmodes.description (ioString, inIndentation+1) ;
  ioString << "]" ;
}



//---------------------------------------------------------------------------*
//                                                                           *
//                         @task_autostart_true type                         *
//                                                                           *
//---------------------------------------------------------------------------*

const C_galgas_type_descriptor
kTypeDescriptor_GALGAS_task_5F_autostart_5F_true ("task_autostart_true",
                                                  & kTypeDescriptor_GALGAS_task_5F_autostart_5F_obj) ;

//---------------------------------------------------------------------------*

const C_galgas_type_descriptor * GALGAS_task_5F_autostart_5F_true::staticTypeDescriptor (void) const {
  return & kTypeDescriptor_GALGAS_task_5F_autostart_5F_true ;
}

//---------------------------------------------------------------------------*

AC_GALGAS_root * GALGAS_task_5F_autostart_5F_true::clonedObject (void) const {
  AC_GALGAS_root * result = NULL ;
  if (isValid ()) {
    macroMyNew (result, GALGAS_task_5F_autostart_5F_true (*this)) ;
  }
  return result ;
}

//---------------------------------------------------------------------------*

GALGAS_task_5F_autostart_5F_true GALGAS_task_5F_autostart_5F_true::extractObject (const GALGAS_object & inObject,
                                                                                  C_Compiler * inCompiler,
                                                                                  const GALGAS_location & inErrorLocation
                                                                                  COMMA_LOCATION_ARGS) {
  GALGAS_task_5F_autostart_5F_true result ;
  const GALGAS_task_5F_autostart_5F_true * p = (const GALGAS_task_5F_autostart_5F_true *) inObject.embeddedObject () ;
  if (NULL != p) {
    if (NULL != dynamic_cast <const GALGAS_task_5F_autostart_5F_true *> (p)) {
      result = *p ;
    }else{
      inCompiler->extractObjectError (inErrorLocation, "task_autostart_true", p->dynamicTypeDescriptor () COMMA_THERE) ;
    }  
  }
  return result ;
}

//---------------------------------------------------------------------------*

enumComparisonResult GALGAS_task_5F_autostart_5F_void::objectCompare (const GALGAS_task_5F_autostart_5F_void & inOperand) const {
  return (isValid () && inOperand.isValid ()) ? kOperandEqual : kOperandNotValid ;
}


//---------------------------------------------------------------------------*

GALGAS_task_5F_autostart_5F_void::GALGAS_task_5F_autostart_5F_void (void) :
GALGAS_task_5F_autostart_5F_obj () {
}

//---------------------------------------------------------------------------*

GALGAS_task_5F_autostart_5F_void::GALGAS_task_5F_autostart_5F_void (const cPtr_task_5F_autostart_5F_void * inSourcePtr) :
GALGAS_task_5F_autostart_5F_obj (inSourcePtr) {
  macroNullOrValidSharedObject (inSourcePtr, const cPtr_task_5F_autostart_5F_void) ;
}

//---------------------------------------------------------------------------*

GALGAS_task_5F_autostart_5F_void GALGAS_task_5F_autostart_5F_void::constructor_new (const GALGAS_location & inAttribute_location
                                                                                    COMMA_LOCATION_ARGS) {
  GALGAS_task_5F_autostart_5F_void result ;
  if (inAttribute_location.isValid ()) {
    macroMyNew (result.mObjectPtr, cPtr_task_5F_autostart_5F_void (inAttribute_location COMMA_THERE)) ;
  }
  return result ;
}

//---------------------------------------------------------------------------*

void GALGAS_task_5F_autostart_5F_void::insulate (LOCATION_ARGS) {
  if (isValid () && (mObjectPtr->retainCount () > 1)) {
    cPtr_task_5F_autostart_5F_void * p = (cPtr_task_5F_autostart_5F_void *) mObjectPtr ;
    macroValidSharedObject (p, cPtr_task_5F_autostart_5F_void) ;
    cPtr_task_5F_autostart_5F_void * r = NULL ;
    macroMyNew (r, cPtr_task_5F_autostart_5F_void (p->mAttribute_location COMMA_THERE)) ;
    macroAssignSharedObject (mObjectPtr, r) ;
    macroDetachSharedObject (r) ;
  }
}

//---------------------------------------------------------------------------*
//               Pointer class for @task_autostart_void class                *
//---------------------------------------------------------------------------*

cPtr_task_5F_autostart_5F_void::cPtr_task_5F_autostart_5F_void (const GALGAS_location & in_location
                                                                COMMA_LOCATION_ARGS) :
cPtr_task_5F_autostart_5F_obj (in_location COMMA_THERE) {
}

//---------------------------------------------------------------------------*

const C_galgas_type_descriptor * cPtr_task_5F_autostart_5F_void::classDescriptor (void) const {
  return & kTypeDescriptor_GALGAS_task_5F_autostart_5F_void ;
}

void cPtr_task_5F_autostart_5F_void::description (C_String & ioString,
                                                  const PMSInt32 inIndentation) const {
  ioString << "[@task_autostart_void:" ;
  mAttribute_location.description (ioString, inIndentation+1) ;
  ioString << "]" ;
}



//---------------------------------------------------------------------------*
//                                                                           *
//                         @task_autostart_void type                         *
//                                                                           *
//---------------------------------------------------------------------------*

const C_galgas_type_descriptor
kTypeDescriptor_GALGAS_task_5F_autostart_5F_void ("task_autostart_void",
                                                  & kTypeDescriptor_GALGAS_task_5F_autostart_5F_obj) ;

//---------------------------------------------------------------------------*

const C_galgas_type_descriptor * GALGAS_task_5F_autostart_5F_void::staticTypeDescriptor (void) const {
  return & kTypeDescriptor_GALGAS_task_5F_autostart_5F_void ;
}

//---------------------------------------------------------------------------*

AC_GALGAS_root * GALGAS_task_5F_autostart_5F_void::clonedObject (void) const {
  AC_GALGAS_root * result = NULL ;
  if (isValid ()) {
    macroMyNew (result, GALGAS_task_5F_autostart_5F_void (*this)) ;
  }
  return result ;
}

//---------------------------------------------------------------------------*

GALGAS_task_5F_autostart_5F_void GALGAS_task_5F_autostart_5F_void::extractObject (const GALGAS_object & inObject,
                                                                                  C_Compiler * inCompiler,
                                                                                  const GALGAS_location & inErrorLocation
                                                                                  COMMA_LOCATION_ARGS) {
  GALGAS_task_5F_autostart_5F_void result ;
  const GALGAS_task_5F_autostart_5F_void * p = (const GALGAS_task_5F_autostart_5F_void *) inObject.embeddedObject () ;
  if (NULL != p) {
    if (NULL != dynamic_cast <const GALGAS_task_5F_autostart_5F_void *> (p)) {
      result = *p ;
    }else{
      inCompiler->extractObjectError (inErrorLocation, "task_autostart_void", p->dynamicTypeDescriptor () COMMA_THERE) ;
    }  
  }
  return result ;
}

//--- START OF USER ZONE 2


//--- END OF USER ZONE 2


