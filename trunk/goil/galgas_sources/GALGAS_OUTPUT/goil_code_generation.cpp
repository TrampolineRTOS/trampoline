//---------------------------------------------------------------------------*
//                                                                           *
//                     File 'goil_code_generation.cpp'                       *
//                    Generated by version version 2.1.0                     *
//                     november 18th, 2010, at 7h24'8"                       *
//                                                                           *
//---------------------------------------------------------------------------*

//--- START OF USER ZONE 1


//--- END OF USER ZONE 1

#include "version_libpm.h"
#if CURRENT_LIBPM_VERSION != 909
  #error "This file has been compiled with a version of GALGAS that uses libpm version 909, different than the current version (CURRENT_LIBPM_VERSION) of libpm"
#endif

//---------------------------------------------------------------------------*

#include "goil_code_generation.h"
#include "galgas2/C_Compiler.h"
#include "galgas2/C_galgas_CLI_Options.h"

//---------------------------------------------------------------------------*

#include "goil_options.h"
#include "template_grammar.h"
#include "cfg_grammar.h"
#include "api_grammar.h"

//---------------------------------------------------------------------------*

#ifndef DO_NOT_GENERATE_CHECKINGS
  #define SOURCE_FILE_AT_LINE(line) "goil_code_generation.gSemantics", line
  #define COMMA_SOURCE_FILE_AT_LINE(line) , SOURCE_FILE_AT_LINE(line)
#else
  #define SOURCE_FILE_AT_LINE(line) 
  #define COMMA_SOURCE_FILE_AT_LINE(line) 
#endif

//---------------------------------------------------------------------------*
//                                                                           *
//                      Routine 'generate_signed_type'                       *
//                                                                           *
//---------------------------------------------------------------------------*

void routine_generate_5F_signed_5F_type (GALGAS_uint_36__34_ inArgument_count,
                                         GALGAS_string inArgument_err,
                                         GALGAS_string & outArgument_type,
                                         C_Compiler * inCompiler
                                         COMMA_UNUSED_LOCATION_ARGS) {
  outArgument_type.drop () ; // Release 'out' argument
  //-------- @localVariableOrConstantDeclarationWithSourceExpressionForGeneration
  GALGAS_uint_36__34_ var_max_5F_s_38_ = GALGAS_uint_36__34_ ((PMUInt64) 1ULL).left_shift_operation (GALGAS_uint ((PMUInt32) 7U) COMMA_SOURCE_FILE_AT_LINE (56)) ;
  //-------- @localVariableOrConstantDeclarationWithSourceExpressionForGeneration
  GALGAS_uint_36__34_ var_max_5F_s_31__36_ = GALGAS_uint_36__34_ ((PMUInt64) 1ULL).left_shift_operation (GALGAS_uint ((PMUInt32) 15U) COMMA_SOURCE_FILE_AT_LINE (57)) ;
  //-------- @localVariableOrConstantDeclarationWithSourceExpressionForGeneration
  GALGAS_uint_36__34_ var_max_5F_s_33__32_ = GALGAS_uint_36__34_ ((PMUInt64) 1ULL).left_shift_operation (GALGAS_uint ((PMUInt32) 31U) COMMA_SOURCE_FILE_AT_LINE (58)) ;
  //-------- @ifInstructionForGeneration
  if (GALGAS_bool (kIsStrictInf, inArgument_count.objectCompare (var_max_5F_s_38_)).isValidAndTrue ()) {
    //-------- @assignmentInstructionForGeneration
    outArgument_type = GALGAS_string ("s8") ;
  }else{
    //-------- @ifInstructionForGeneration
    if (GALGAS_bool (kIsStrictInf, inArgument_count.objectCompare (var_max_5F_s_31__36_)).isValidAndTrue ()) {
      //-------- @assignmentInstructionForGeneration
      outArgument_type = GALGAS_string ("s16") ;
    }else{
      //-------- @ifInstructionForGeneration
      if (GALGAS_bool (kIsStrictInf, inArgument_count.objectCompare (var_max_5F_s_33__32_)).isValidAndTrue ()) {
        //-------- @assignmentInstructionForGeneration
        outArgument_type = GALGAS_string ("s32") ;
      }else{
        //-------- @assignmentInstructionForGeneration
        outArgument_type = GALGAS_string ("") ;
        //-------- @errorInstructionForGeneration
        inCompiler->emitSemanticError (inCompiler->here (), inArgument_err COMMA_SOURCE_FILE_AT_LINE (70)) ;
      }
    }
  }
}


//---------------------------------------------------------------------------*
//                                                                           *
//                     Routine 'generate_unsigned_type'                      *
//                                                                           *
//---------------------------------------------------------------------------*

void routine_generate_5F_unsigned_5F_type (GALGAS_uint_36__34_ inArgument_count,
                                           GALGAS_string inArgument_err,
                                           GALGAS_string & outArgument_type,
                                           C_Compiler * inCompiler
                                           COMMA_UNUSED_LOCATION_ARGS) {
  outArgument_type.drop () ; // Release 'out' argument
  //-------- @localVariableOrConstantDeclarationWithSourceExpressionForGeneration
  GALGAS_uint_36__34_ var_max_5F_u_38_ = GALGAS_uint_36__34_ ((PMUInt64) 1ULL).left_shift_operation (GALGAS_uint ((PMUInt32) 8U) COMMA_SOURCE_FILE_AT_LINE (82)) ;
  //-------- @localVariableOrConstantDeclarationWithSourceExpressionForGeneration
  GALGAS_uint_36__34_ var_max_5F_u_31__36_ = GALGAS_uint_36__34_ ((PMUInt64) 1ULL).left_shift_operation (GALGAS_uint ((PMUInt32) 16U) COMMA_SOURCE_FILE_AT_LINE (83)) ;
  //-------- @localVariableOrConstantDeclarationWithSourceExpressionForGeneration
  GALGAS_uint_36__34_ var_max_5F_u_33__32_ = GALGAS_uint_36__34_ ((PMUInt64) 1ULL).left_shift_operation (GALGAS_uint ((PMUInt32) 32U) COMMA_SOURCE_FILE_AT_LINE (84)) ;
  //-------- @ifInstructionForGeneration
  if (GALGAS_bool (kIsStrictInf, inArgument_count.objectCompare (var_max_5F_u_38_)).isValidAndTrue ()) {
    //-------- @assignmentInstructionForGeneration
    outArgument_type = GALGAS_string ("u8") ;
  }else{
    //-------- @ifInstructionForGeneration
    if (GALGAS_bool (kIsStrictInf, inArgument_count.objectCompare (var_max_5F_u_31__36_)).isValidAndTrue ()) {
      //-------- @assignmentInstructionForGeneration
      outArgument_type = GALGAS_string ("u16") ;
    }else{
      //-------- @ifInstructionForGeneration
      if (GALGAS_bool (kIsStrictInf, inArgument_count.objectCompare (var_max_5F_u_33__32_)).isValidAndTrue ()) {
        //-------- @assignmentInstructionForGeneration
        outArgument_type = GALGAS_string ("u32") ;
      }else{
        //-------- @assignmentInstructionForGeneration
        outArgument_type = GALGAS_string ("") ;
        //-------- @errorInstructionForGeneration
        inCompiler->emitSemanticError (inCompiler->here (), inArgument_err COMMA_SOURCE_FILE_AT_LINE (96)) ;
      }
    }
  }
}


//---------------------------------------------------------------------------*
//                                                                           *
//                       Routine 'generate_mask_type'                        *
//                                                                           *
//---------------------------------------------------------------------------*

void routine_generate_5F_mask_5F_type (GALGAS_uint_36__34_ inArgument_count,
                                       GALGAS_string inArgument_err,
                                       GALGAS_string & outArgument_type,
                                       C_Compiler * inCompiler
                                       COMMA_UNUSED_LOCATION_ARGS) {
  outArgument_type.drop () ; // Release 'out' argument
  //-------- @localVariableOrConstantDeclarationWithSourceExpressionForGeneration
  GALGAS_uint_36__34_ var_max_5F_u_38_ = GALGAS_uint_36__34_ ((PMUInt64) 8ULL) ;
  //-------- @localVariableOrConstantDeclarationWithSourceExpressionForGeneration
  GALGAS_uint_36__34_ var_max_5F_u_31__36_ = GALGAS_uint_36__34_ ((PMUInt64) 16ULL) ;
  //-------- @localVariableOrConstantDeclarationWithSourceExpressionForGeneration
  GALGAS_uint_36__34_ var_max_5F_u_33__32_ = GALGAS_uint_36__34_ ((PMUInt64) 32ULL) ;
  //-------- @ifInstructionForGeneration
  if (GALGAS_bool (kIsInfOrEqual, inArgument_count.objectCompare (var_max_5F_u_38_)).isValidAndTrue ()) {
    //-------- @assignmentInstructionForGeneration
    outArgument_type = GALGAS_string ("u8") ;
  }else{
    //-------- @ifInstructionForGeneration
    if (GALGAS_bool (kIsInfOrEqual, inArgument_count.objectCompare (var_max_5F_u_31__36_)).isValidAndTrue ()) {
      //-------- @assignmentInstructionForGeneration
      outArgument_type = GALGAS_string ("u16") ;
    }else{
      //-------- @ifInstructionForGeneration
      if (GALGAS_bool (kIsInfOrEqual, inArgument_count.objectCompare (var_max_5F_u_33__32_)).isValidAndTrue ()) {
        //-------- @assignmentInstructionForGeneration
        outArgument_type = GALGAS_string ("u32") ;
      }else{
        //-------- @assignmentInstructionForGeneration
        outArgument_type = GALGAS_string ("") ;
        //-------- @errorInstructionForGeneration
        inCompiler->emitSemanticError (inCompiler->here (), inArgument_err COMMA_SOURCE_FILE_AT_LINE (122)) ;
      }
    }
  }
}


//---------------------------------------------------------------------------*
//                                                                           *
//                         Routine 'generate_types'                          *
//                                                                           *
//---------------------------------------------------------------------------*

void routine_generate_5F_types (GALGAS_task_5F_map inArgument_tasks,
                                GALGAS_isr_5F_map inArgument_isrs,
                                GALGAS_alarm_5F_map inArgument_alarms,
                                GALGAS_counter_5F_map inArgument_counters,
                                GALGAS_resource_5F_map inArgument_resources,
                                GALGAS_scheduletable_5F_map inArgument_schedtables,
                                GALGAS_app_5F_map inArgument_apps,
                                GALGAS_uint inArgument_max_5F_priority,
                                GALGAS_string & ioArgument_types,
                                C_Compiler * inCompiler
                                COMMA_UNUSED_LOCATION_ARGS) {
  //-------- @localVariableDeclarationForGeneration
  GALGAS_string var_type ;
  //-------- @localVariableOrConstantDeclarationWithSourceExpressionForGeneration
  GALGAS_uint_36__34_ var_max = GALGAS_uint_36__34_ ((PMUInt64) 0ULL) ;
  //-------- @localVariableDeclarationForGeneration
  GALGAS_uint_36__34_ var_c ;
  //-------- @assignmentInstructionForGeneration
  var_c = inArgument_tasks.reader_count (SOURCE_FILE_AT_LINE (144)).reader_uint_36__34_ (SOURCE_FILE_AT_LINE (144)).add_operation (inArgument_isrs.reader_count (SOURCE_FILE_AT_LINE (144)).reader_uint_36__34_ (SOURCE_FILE_AT_LINE (144)), inCompiler COMMA_SOURCE_FILE_AT_LINE (144)) ;
  //-------- @ifInstructionForGeneration
  if (GALGAS_bool (kIsStrictSup, var_c.objectCompare (var_max)).isValidAndTrue ()) {
    //-------- @assignmentInstructionForGeneration
    var_max = var_c ;
  }
  { //-------- @routineCallInstructionForGeneration
  routine_generate_5F_signed_5F_type (var_c, GALGAS_string ("Too many processes (tasks and ISRs)"), var_type, inCompiler COMMA_SOURCE_FILE_AT_LINE (146)) ;
  } //-------- @routineCallInstructionForGeneration
  //-------- @assignmentInstructionForGeneration
  ioArgument_types = ioArgument_types.reader_stringByReplacingStringByString (GALGAS_string ("$PROC_ID_T$"), var_type, inCompiler COMMA_SOURCE_FILE_AT_LINE (147)) ;
  { //-------- @routineCallInstructionForGeneration
  routine_generate_5F_signed_5F_type (inArgument_max_5F_priority.reader_uint_36__34_ (SOURCE_FILE_AT_LINE (150)), GALGAS_string ("Maximum priority too high"), var_type, inCompiler COMMA_SOURCE_FILE_AT_LINE (150)) ;
  } //-------- @routineCallInstructionForGeneration
  //-------- @assignmentInstructionForGeneration
  ioArgument_types = ioArgument_types.reader_stringByReplacingStringByString (GALGAS_string ("$PRIORITY_T$"), var_type, inCompiler COMMA_SOURCE_FILE_AT_LINE (152)) ;
  //-------- @localVariableOrConstantDeclarationWithSourceExpressionForGeneration
  GALGAS_uint var_max_5F_act = GALGAS_uint ((PMUInt32) 0U) ;
  //-------- @foreachInstructionForGeneration
  cEnumerator_task_5F_map enumerator_3625 (inArgument_tasks, true) ;
  //--- simple foreach instruction
  while (enumerator_3625.hasCurrentObject ()) {
    //-------- @structuredCastInstructionForGeneration
    if (enumerator_3625.current_task (HERE).reader_activation (SOURCE_FILE_AT_LINE (158)).isValid ()) {
      if (enumerator_3625.current_task (HERE).reader_activation (SOURCE_FILE_AT_LINE (158)).dynamicTypeDescriptor () == & kTypeDescriptor_GALGAS_uint_33__32__5F_class) {
        GALGAS_uint_33__32__5F_class cast_3715_ui ((cPtr_uint_33__32__5F_class *) enumerator_3625.current_task (HERE).reader_activation (SOURCE_FILE_AT_LINE (158)).ptr ()) ;
        //-------- @ifInstructionForGeneration
        if (GALGAS_bool (kIsStrictSup, cast_3715_ui.reader_value (SOURCE_FILE_AT_LINE (159)).objectCompare (var_max_5F_act)).isValidAndTrue ()) {
          //-------- @assignmentInstructionForGeneration
          var_max_5F_act = cast_3715_ui.reader_value (SOURCE_FILE_AT_LINE (159)) ;
        }
      }else{
        //-------- @errorInstructionForGeneration
        GALGAS_location location_0 (enumerator_3625.current_lkey (HERE).reader_location (HERE)) ; // Implicit use of 'location' reader
        inCompiler->emitSemanticError (location_0, GALGAS_string ("Internal error, task ").operator_concat (enumerator_3625.current_lkey (HERE).reader_string (SOURCE_FILE_AT_LINE (160)) COMMA_SOURCE_FILE_AT_LINE (160)).operator_concat (GALGAS_string (" has wrong type for the ACTIVATION attribute") COMMA_SOURCE_FILE_AT_LINE (160)) COMMA_SOURCE_FILE_AT_LINE (160)) ;
      }
    }
    enumerator_3625.gotoNextObject () ;
  }
  { //-------- @routineCallInstructionForGeneration
  routine_generate_5F_unsigned_5F_type (var_max_5F_act.reader_uint_36__34_ (SOURCE_FILE_AT_LINE (163)), GALGAS_string ("Maximum ACTIVATION too high"), var_type, inCompiler COMMA_SOURCE_FILE_AT_LINE (163)) ;
  } //-------- @routineCallInstructionForGeneration
  //-------- @assignmentInstructionForGeneration
  ioArgument_types = ioArgument_types.reader_stringByReplacingStringByString (GALGAS_string ("$ACTIVATION_T$"), var_type, inCompiler COMMA_SOURCE_FILE_AT_LINE (165)) ;
  //-------- @localVariableOrConstantDeclarationWithSourceExpressionForGeneration
  GALGAS_uint var_max_5F_ev = GALGAS_uint ((PMUInt32) 0U) ;
  //-------- @foreachInstructionForGeneration
  cEnumerator_task_5F_map enumerator_4265 (inArgument_tasks, true) ;
  //--- simple foreach instruction
  while (enumerator_4265.hasCurrentObject ()) {
    //-------- @localVariableOrConstantDeclarationWithSourceExpressionForGeneration
    GALGAS_lstringlist var_evts = enumerator_4265.current_task (HERE).reader_events (SOURCE_FILE_AT_LINE (171)) ;
    //-------- @ifInstructionForGeneration
    if (GALGAS_bool (kIsStrictSup, var_evts.reader_length (SOURCE_FILE_AT_LINE (172)).objectCompare (var_max_5F_ev)).isValidAndTrue ()) {
      //-------- @assignmentInstructionForGeneration
      var_max_5F_ev = var_evts.reader_length (SOURCE_FILE_AT_LINE (172)) ;
    }
    enumerator_4265.gotoNextObject () ;
  }
  { //-------- @routineCallInstructionForGeneration
  routine_generate_5F_mask_5F_type (var_max_5F_ev.reader_uint_36__34_ (SOURCE_FILE_AT_LINE (174)), GALGAS_string ("Too much events"), var_type, inCompiler COMMA_SOURCE_FILE_AT_LINE (174)) ;
  } //-------- @routineCallInstructionForGeneration
  //-------- @assignmentInstructionForGeneration
  ioArgument_types = ioArgument_types.reader_stringByReplacingStringByString (GALGAS_string ("$EVENTMASK_T$"), var_type, inCompiler COMMA_SOURCE_FILE_AT_LINE (175)) ;
  //-------- @assignmentInstructionForGeneration
  var_c = inArgument_alarms.reader_count (SOURCE_FILE_AT_LINE (178)).reader_uint_36__34_ (SOURCE_FILE_AT_LINE (178)) ;
  //-------- @ifInstructionForGeneration
  if (GALGAS_bool (kIsStrictSup, var_c.objectCompare (var_max)).isValidAndTrue ()) {
    //-------- @assignmentInstructionForGeneration
    var_max = var_c ;
  }
  { //-------- @routineCallInstructionForGeneration
  routine_generate_5F_unsigned_5F_type (var_c, GALGAS_string ("too many alarms"), var_type, inCompiler COMMA_SOURCE_FILE_AT_LINE (180)) ;
  } //-------- @routineCallInstructionForGeneration
  //-------- @assignmentInstructionForGeneration
  ioArgument_types = ioArgument_types.reader_stringByReplacingStringByString (GALGAS_string ("$ALARM_ID_T$"), var_type, inCompiler COMMA_SOURCE_FILE_AT_LINE (182)) ;
  //-------- @assignmentInstructionForGeneration
  var_c = inArgument_resources.reader_count (SOURCE_FILE_AT_LINE (185)).reader_uint_36__34_ (SOURCE_FILE_AT_LINE (185)) ;
  //-------- @ifInstructionForGeneration
  if (GALGAS_bool (kIsStrictSup, var_c.objectCompare (var_max)).isValidAndTrue ()) {
    //-------- @assignmentInstructionForGeneration
    var_max = var_c ;
  }
  { //-------- @routineCallInstructionForGeneration
  routine_generate_5F_unsigned_5F_type (var_c, GALGAS_string ("too many resources"), var_type, inCompiler COMMA_SOURCE_FILE_AT_LINE (187)) ;
  } //-------- @routineCallInstructionForGeneration
  //-------- @assignmentInstructionForGeneration
  ioArgument_types = ioArgument_types.reader_stringByReplacingStringByString (GALGAS_string ("$RESOURCE_ID_T$"), var_type, inCompiler COMMA_SOURCE_FILE_AT_LINE (189)) ;
  //-------- @assignmentInstructionForGeneration
  var_c = inArgument_counters.reader_count (SOURCE_FILE_AT_LINE (192)).reader_uint_36__34_ (SOURCE_FILE_AT_LINE (192)) ;
  //-------- @ifInstructionForGeneration
  if (GALGAS_bool (kIsStrictSup, var_c.objectCompare (var_max)).isValidAndTrue ()) {
    //-------- @assignmentInstructionForGeneration
    var_max = var_c ;
  }
  { //-------- @routineCallInstructionForGeneration
  routine_generate_5F_unsigned_5F_type (var_c, GALGAS_string ("too many counters"), var_type, inCompiler COMMA_SOURCE_FILE_AT_LINE (194)) ;
  } //-------- @routineCallInstructionForGeneration
  //-------- @assignmentInstructionForGeneration
  ioArgument_types = ioArgument_types.reader_stringByReplacingStringByString (GALGAS_string ("$COUNTER_ID_T$"), var_type, inCompiler COMMA_SOURCE_FILE_AT_LINE (196)) ;
  //-------- @assignmentInstructionForGeneration
  var_c = inArgument_schedtables.reader_count (SOURCE_FILE_AT_LINE (199)).reader_uint_36__34_ (SOURCE_FILE_AT_LINE (199)) ;
  //-------- @ifInstructionForGeneration
  if (GALGAS_bool (kIsStrictSup, var_c.objectCompare (var_max)).isValidAndTrue ()) {
    //-------- @assignmentInstructionForGeneration
    var_max = var_c ;
  }
  { //-------- @routineCallInstructionForGeneration
  routine_generate_5F_unsigned_5F_type (var_c, GALGAS_string ("too many schedule tables"), var_type, inCompiler COMMA_SOURCE_FILE_AT_LINE (201)) ;
  } //-------- @routineCallInstructionForGeneration
  //-------- @assignmentInstructionForGeneration
  ioArgument_types = ioArgument_types.reader_stringByReplacingStringByString (GALGAS_string ("$SCHEDTABLE_ID_T$"), var_type, inCompiler COMMA_SOURCE_FILE_AT_LINE (203)) ;
  //-------- @ifInstructionForGeneration
  if (GALGAS_bool (kIsStrictSup, inArgument_alarms.reader_count (SOURCE_FILE_AT_LINE (207)).objectCompare (inArgument_schedtables.reader_count (SOURCE_FILE_AT_LINE (207)))).isValidAndTrue ()) {
    //-------- @assignmentInstructionForGeneration
    var_c = inArgument_alarms.reader_count (SOURCE_FILE_AT_LINE (208)).reader_uint_36__34_ (SOURCE_FILE_AT_LINE (208)) ;
  }else{
    //-------- @assignmentInstructionForGeneration
    var_c = inArgument_schedtables.reader_count (SOURCE_FILE_AT_LINE (210)).reader_uint_36__34_ (SOURCE_FILE_AT_LINE (210)) ;
  }
  //-------- @ifInstructionForGeneration
  if (GALGAS_bool (kIsStrictSup, var_c.objectCompare (var_max)).isValidAndTrue ()) {
    //-------- @assignmentInstructionForGeneration
    var_max = var_c ;
  }
  { //-------- @routineCallInstructionForGeneration
  routine_generate_5F_unsigned_5F_type (var_c, GALGAS_string ("too many time objects"), var_type, inCompiler COMMA_SOURCE_FILE_AT_LINE (213)) ;
  } //-------- @routineCallInstructionForGeneration
  //-------- @assignmentInstructionForGeneration
  ioArgument_types = ioArgument_types.reader_stringByReplacingStringByString (GALGAS_string ("$TIMEOBJ_ID_T$"), var_type, inCompiler COMMA_SOURCE_FILE_AT_LINE (214)) ;
  { //-------- @routineCallInstructionForGeneration
  routine_generate_5F_unsigned_5F_type (inArgument_apps.reader_count (SOURCE_FILE_AT_LINE (217)).reader_uint_36__34_ (SOURCE_FILE_AT_LINE (217)).add_operation (GALGAS_uint_36__34_ ((PMUInt64) 1ULL), inCompiler COMMA_SOURCE_FILE_AT_LINE (217)), GALGAS_string ("too many OS applications"), var_type, inCompiler COMMA_SOURCE_FILE_AT_LINE (217)) ;
  } //-------- @routineCallInstructionForGeneration
  { //-------- @routineCallInstructionForGeneration
  routine_doReplace (ioArgument_types, GALGAS_string ("$OSAPPLICATION_ID_T$"), var_type, inCompiler COMMA_SOURCE_FILE_AT_LINE (219)) ;
  } //-------- @routineCallInstructionForGeneration
  //-------- @localVariableOrConstantDeclarationWithConstructorCallForGeneration
  GALGAS_stringset var_tfs = GALGAS_stringset::constructor_emptySet (SOURCE_FILE_AT_LINE (222)) ;
  //-------- @foreachInstructionForGeneration
  cEnumerator_app_5F_map enumerator_6477 (inArgument_apps, true) ;
  //--- simple foreach instruction
  while (enumerator_6477.hasCurrentObject ()) {
    //-------- @structuredCastInstructionForGeneration
    if (enumerator_6477.current_app (HERE).reader_trusted (SOURCE_FILE_AT_LINE (225)).isValid ()) {
      if (enumerator_6477.current_app (HERE).reader_trusted (SOURCE_FILE_AT_LINE (225)).dynamicTypeDescriptor () == & kTypeDescriptor_GALGAS_app_5F_trusted_5F_true) {
        GALGAS_app_5F_trusted_5F_true cast_6534_t ((cPtr_app_5F_trusted_5F_true *) enumerator_6477.current_app (HERE).reader_trusted (SOURCE_FILE_AT_LINE (225)).ptr ()) ;
        //-------- @foreachInstructionForGeneration
        cEnumerator_stringset enumerator_6570 (cast_6534_t.reader_trusted_5F_fcts (SOURCE_FILE_AT_LINE (227)), true) ;
        //--- simple foreach instruction
        while (enumerator_6570.hasCurrentObject ()) {
          //-------- @addAssignInstructionForGeneration
          var_tfs.addAssign_operation (enumerator_6570.current_key (HERE) COMMA_SOURCE_FILE_AT_LINE (228)) ;
          enumerator_6570.gotoNextObject () ;
        }
      }
    }
    enumerator_6477.gotoNextObject () ;
  }
  { //-------- @routineCallInstructionForGeneration
  routine_generate_5F_unsigned_5F_type (var_tfs.reader_count (SOURCE_FILE_AT_LINE (233)).reader_uint_36__34_ (SOURCE_FILE_AT_LINE (233)), GALGAS_string ("Too many Trusted Functions"), var_type, inCompiler COMMA_SOURCE_FILE_AT_LINE (233)) ;
  } //-------- @routineCallInstructionForGeneration
  { //-------- @routineCallInstructionForGeneration
  routine_doReplace (ioArgument_types, GALGAS_string ("$TRUSTED_FCT_ID_T$"), var_type, inCompiler COMMA_SOURCE_FILE_AT_LINE (234)) ;
  } //-------- @routineCallInstructionForGeneration
  { //-------- @routineCallInstructionForGeneration
  routine_generate_5F_unsigned_5F_type (var_max, GALGAS_string ("too many objects"), var_type, inCompiler COMMA_SOURCE_FILE_AT_LINE (237)) ;
  } //-------- @routineCallInstructionForGeneration
  { //-------- @routineCallInstructionForGeneration
  routine_doReplace (ioArgument_types, GALGAS_string ("$GENERIC_ID_T$"), var_type, inCompiler COMMA_SOURCE_FILE_AT_LINE (239)) ;
  } //-------- @routineCallInstructionForGeneration
}


//---------------------------------------------------------------------------*
//                                                                           *
//                      Routine 'generate_timing_prot'                       *
//                                                                           *
//---------------------------------------------------------------------------*

void routine_generate_5F_timing_5F_prot (GALGAS_task_5F_map inArgument_tasks,
                                         GALGAS_resource_5F_map inArgument_rez,
                                         GALGAS_string & ioArgument_obj_5F_header,
                                         C_Compiler * inCompiler
                                         COMMA_UNUSED_LOCATION_ARGS) {
  //-------- @localVariableOrConstantDeclarationWithSourceExpressionForGeneration
  GALGAS_uint var_max_5F_sched_5F_wd = inArgument_rez.reader_count (SOURCE_FILE_AT_LINE (249)).add_operation (GALGAS_uint ((PMUInt32) 4U) .multiply_operation (inArgument_tasks.reader_count (SOURCE_FILE_AT_LINE (249)), inCompiler COMMA_SOURCE_FILE_AT_LINE (249)), inCompiler COMMA_SOURCE_FILE_AT_LINE (249)) ;
  //-------- @assignmentInstructionForGeneration
  ioArgument_obj_5F_header = ioArgument_obj_5F_header.reader_stringByReplacingStringByString (GALGAS_string ("$MAX_WATCH_DOG$"), var_max_5F_sched_5F_wd.reader_string (SOURCE_FILE_AT_LINE (251)), inCompiler COMMA_SOURCE_FILE_AT_LINE (251)) ;
}


//---------------------------------------------------------------------------*
//                                                                           *
//                  Routine 'compute_actual_task_priority'                   *
//                                                                           *
//---------------------------------------------------------------------------*

void routine_compute_5F_actual_5F_task_5F_priority (GALGAS_task_5F_map inArgument_tasks,
                                                    GALGAS_prio_5F_map & ioArgument_prio_5F_for_5F_task,
                                                    GALGAS_uint & outArgument_max_5F_prio,
                                                    C_Compiler * inCompiler
                                                    COMMA_UNUSED_LOCATION_ARGS) {
  outArgument_max_5F_prio.drop () ; // Release 'out' argument
  //-------- @localVariableOrConstantDeclarationWithConstructorCallForGeneration
  GALGAS_objs_5F_by_5F_prio var_tl = GALGAS_objs_5F_by_5F_prio::constructor_emptySortedList (SOURCE_FILE_AT_LINE (262)) ;
  //-------- @foreachInstructionForGeneration
  cEnumerator_task_5F_map enumerator_7833 (inArgument_tasks, true) ;
  //--- simple foreach instruction
  while (enumerator_7833.hasCurrentObject ()) {
    //-------- @localVariableDeclarationForGeneration
    GALGAS_basic_5F_type var_prio_5F_as_5F_basic ;
    //-------- @localVariableDeclarationForGeneration
    GALGAS_basic_5F_type var_act_5F_as_5F_basic ;
    //-------- @localVariableOrConstantDeclarationWithSourceExpressionForGeneration
    GALGAS_uint var_prio = GALGAS_uint ((PMUInt32) 0U) ;
    //-------- @localVariableOrConstantDeclarationWithSourceExpressionForGeneration
    GALGAS_uint var_act = GALGAS_uint ((PMUInt32) 0U) ;
    //-------- @assignmentInstructionForGeneration
    var_prio_5F_as_5F_basic = enumerator_7833.current_task (HERE).reader_priority (SOURCE_FILE_AT_LINE (274)) ;
    //-------- @assignmentInstructionForGeneration
    var_act_5F_as_5F_basic = enumerator_7833.current_task (HERE).reader_activation (SOURCE_FILE_AT_LINE (275)) ;
    //-------- @structuredCastInstructionForGeneration
    if (var_prio_5F_as_5F_basic.isValid ()) {
      if (var_prio_5F_as_5F_basic.dynamicTypeDescriptor () == & kTypeDescriptor_GALGAS_uint_33__32__5F_class) {
        GALGAS_uint_33__32__5F_class cast_8136_ui ((cPtr_uint_33__32__5F_class *) var_prio_5F_as_5F_basic.ptr ()) ;
        //-------- @assignmentInstructionForGeneration
        var_prio = cast_8136_ui.reader_value (SOURCE_FILE_AT_LINE (278)) ;
      }else{
        //-------- @errorInstructionForGeneration
        inCompiler->emitSemanticError (var_prio_5F_as_5F_basic.reader_location (SOURCE_FILE_AT_LINE (279)), GALGAS_string ("TASK PRIORITY attribute undefined") COMMA_SOURCE_FILE_AT_LINE (279)) ;
      }
    }
    //-------- @structuredCastInstructionForGeneration
    if (var_act_5F_as_5F_basic.isValid ()) {
      if (var_act_5F_as_5F_basic.dynamicTypeDescriptor () == & kTypeDescriptor_GALGAS_uint_33__32__5F_class) {
        GALGAS_uint_33__32__5F_class cast_8322_ui ((cPtr_uint_33__32__5F_class *) var_act_5F_as_5F_basic.ptr ()) ;
        //-------- @assignmentInstructionForGeneration
        var_act = cast_8322_ui.reader_value (SOURCE_FILE_AT_LINE (283)) ;
      }else{
        //-------- @errorInstructionForGeneration
        inCompiler->emitSemanticError (var_act_5F_as_5F_basic.reader_location (SOURCE_FILE_AT_LINE (284)), GALGAS_string ("TASK ACTIVATION attribute undefined") COMMA_SOURCE_FILE_AT_LINE (284)) ;
      }
    }
    //-------- @addAssignInstructionForGeneration
    var_tl.addAssign_operation (var_prio, var_act, enumerator_7833.current_lkey (HERE) COMMA_SOURCE_FILE_AT_LINE (287)) ;
    enumerator_7833.gotoNextObject () ;
  }
  //-------- @localVariableOrConstantDeclarationWithSourceExpressionForGeneration
  GALGAS_uint var_actual_5F_prio = GALGAS_uint ((PMUInt32) 1U) ;
  //-------- @localVariableOrConstantDeclarationWithSourceExpressionForGeneration
  GALGAS_uint var_cur_5F_rel_5F_prio = GALGAS_uint ((PMUInt32) 0U) ;
  //-------- @ifInstructionForGeneration
  if (GALGAS_bool (kIsStrictSup, var_tl.reader_length (SOURCE_FILE_AT_LINE (295)).objectCompare (GALGAS_uint ((PMUInt32) 0U))).isValidAndTrue ()) {
    //-------- @methodCallInstructionForGeneration
    GALGAS_uint joker_8668_0 ; // Joker input parameter
    GALGAS_lstring joker_8671_0 ; // Joker input parameter
    var_tl.method_smallest (var_cur_5F_rel_5F_prio, joker_8668_0, joker_8671_0, inCompiler COMMA_SOURCE_FILE_AT_LINE (296)) ;
    //-------- END @methodCallInstructionForGeneration
  }
  //-------- @foreachInstructionForGeneration
  cEnumerator_objs_5F_by_5F_prio enumerator_8778 (var_tl, true) ;
  //--- simple foreach instruction
  while (enumerator_8778.hasCurrentObject ()) {
    //-------- @ifInstructionForGeneration
    if (GALGAS_bool (kIsStrictSup, enumerator_8778.current_prio (HERE).objectCompare (var_cur_5F_rel_5F_prio)).isValidAndTrue ()) {
      //-------- @assignmentInstructionForGeneration
      var_cur_5F_rel_5F_prio = enumerator_8778.current_prio (HERE) ;
      //-------- @incrementInstructionForGeneration
      var_actual_5F_prio.increment_operation (inCompiler COMMA_SOURCE_FILE_AT_LINE (306)) ;
    }
    { //-------- @modifierCallInstructionForGeneration
    ioArgument_prio_5F_for_5F_task.modifier_put (enumerator_8778.current_name (HERE), var_actual_5F_prio, enumerator_8778.current_act (HERE), inCompiler COMMA_SOURCE_FILE_AT_LINE (309)) ;
    } //-------- END @typeMethodInstructionForGeneration
    enumerator_8778.gotoNextObject () ;
  }
  //-------- @assignmentInstructionForGeneration
  outArgument_max_5F_prio = var_actual_5F_prio ;
}


//---------------------------------------------------------------------------*
//                                                                           *
//                   Routine 'compute_actual_isr_priority'                   *
//                                                                           *
//---------------------------------------------------------------------------*

void routine_compute_5F_actual_5F_isr_5F_priority (GALGAS_isr_5F_map inArgument_isrs,
                                                   GALGAS_prio_5F_map & ioArgument_prio_5F_for_5F_isr,
                                                   GALGAS_uint inArgument_floor,
                                                   GALGAS_uint & outArgument_max_5F_prio,
                                                   C_Compiler * inCompiler
                                                   COMMA_UNUSED_LOCATION_ARGS) {
  outArgument_max_5F_prio.drop () ; // Release 'out' argument
  //-------- @localVariableOrConstantDeclarationWithConstructorCallForGeneration
  GALGAS_objs_5F_by_5F_prio var_il = GALGAS_objs_5F_by_5F_prio::constructor_emptySortedList (SOURCE_FILE_AT_LINE (325)) ;
  //-------- @ifInstructionForGeneration
  if (GALGAS_bool (kIsNotEqual, inArgument_isrs.reader_count (SOURCE_FILE_AT_LINE (327)).objectCompare (GALGAS_uint ((PMUInt32) 0U))).isValidAndTrue ()) {
    //-------- @foreachInstructionForGeneration
    cEnumerator_isr_5F_map enumerator_9786 (inArgument_isrs, true) ;
    //--- simple foreach instruction
    while (enumerator_9786.hasCurrentObject ()) {
      //-------- @localVariableDeclarationForGeneration
      GALGAS_basic_5F_type var_prio_5F_as_5F_basic ;
      //-------- @localVariableOrConstantDeclarationWithSourceExpressionForGeneration
      GALGAS_uint var_prio = GALGAS_uint ((PMUInt32) 0U) ;
      //-------- @assignmentInstructionForGeneration
      var_prio_5F_as_5F_basic = enumerator_9786.current_isr (HERE).reader_priority (SOURCE_FILE_AT_LINE (338)) ;
      //-------- @structuredCastInstructionForGeneration
      if (var_prio_5F_as_5F_basic.isValid ()) {
        if (var_prio_5F_as_5F_basic.dynamicTypeDescriptor () == & kTypeDescriptor_GALGAS_uint_33__32__5F_class) {
          GALGAS_uint_33__32__5F_class cast_10074_ui ((cPtr_uint_33__32__5F_class *) var_prio_5F_as_5F_basic.ptr ()) ;
          //-------- @assignmentInstructionForGeneration
          var_prio = cast_10074_ui.reader_value (SOURCE_FILE_AT_LINE (342)) ;
        }else{
          //-------- @errorInstructionForGeneration
          inCompiler->emitSemanticError (var_prio_5F_as_5F_basic.reader_location (SOURCE_FILE_AT_LINE (343)), GALGAS_string ("ISR PRIORITY attribute undefined") COMMA_SOURCE_FILE_AT_LINE (343)) ;
        }
      }
      //-------- @addAssignInstructionForGeneration
      var_il.addAssign_operation (var_prio, GALGAS_uint ((PMUInt32) 1U), enumerator_9786.current_lkey (HERE) COMMA_SOURCE_FILE_AT_LINE (351)) ;
      enumerator_9786.gotoNextObject () ;
    }
    //-------- @localVariableOrConstantDeclarationWithSourceExpressionForGeneration
    GALGAS_uint var_actual_5F_prio = inArgument_floor.add_operation (GALGAS_uint ((PMUInt32) 1U), inCompiler COMMA_SOURCE_FILE_AT_LINE (357)) ;
    //-------- @localVariableOrConstantDeclarationWithSourceExpressionForGeneration
    GALGAS_uint var_cur_5F_rel_5F_prio = GALGAS_uint ((PMUInt32) 0U) ;
    //-------- @ifInstructionForGeneration
    if (GALGAS_bool (kIsStrictSup, var_il.reader_length (SOURCE_FILE_AT_LINE (359)).objectCompare (GALGAS_uint ((PMUInt32) 0U))).isValidAndTrue ()) {
      //-------- @methodCallInstructionForGeneration
      GALGAS_uint joker_10673_0 ; // Joker input parameter
      GALGAS_lstring joker_10676_0 ; // Joker input parameter
      var_il.method_smallest (var_cur_5F_rel_5F_prio, joker_10673_0, joker_10676_0, inCompiler COMMA_SOURCE_FILE_AT_LINE (360)) ;
      //-------- END @methodCallInstructionForGeneration
    }
    //-------- @foreachInstructionForGeneration
    cEnumerator_objs_5F_by_5F_prio enumerator_10810 (var_il, true) ;
    //--- simple foreach instruction
    while (enumerator_10810.hasCurrentObject ()) {
      //-------- @ifInstructionForGeneration
      if (GALGAS_bool (kIsStrictSup, enumerator_10810.current_prio (HERE).objectCompare (var_cur_5F_rel_5F_prio)).isValidAndTrue ()) {
        //-------- @assignmentInstructionForGeneration
        var_cur_5F_rel_5F_prio = enumerator_10810.current_prio (HERE) ;
        //-------- @incrementInstructionForGeneration
        var_actual_5F_prio.increment_operation (inCompiler COMMA_SOURCE_FILE_AT_LINE (370)) ;
      }
      { //-------- @modifierCallInstructionForGeneration
      ioArgument_prio_5F_for_5F_isr.modifier_put (enumerator_10810.current_name (HERE), var_actual_5F_prio, enumerator_10810.current_act (HERE), inCompiler COMMA_SOURCE_FILE_AT_LINE (373)) ;
      } //-------- END @typeMethodInstructionForGeneration
      enumerator_10810.gotoNextObject () ;
    }
    //-------- @assignmentInstructionForGeneration
    outArgument_max_5F_prio = var_actual_5F_prio ;
  }else{
    //-------- @assignmentInstructionForGeneration
    outArgument_max_5F_prio = inArgument_floor ;
  }
}


//---------------------------------------------------------------------------*
//                                                                           *
//                      Routine 'compute_rez_priority'                       *
//                                                                           *
//---------------------------------------------------------------------------*

void routine_compute_5F_rez_5F_priority (GALGAS_resource_5F_map inArgument_rez,
                                         GALGAS_task_5F_map inArgument_tasks,
                                         GALGAS_isr_5F_map inArgument_isrs,
                                         GALGAS_prio_5F_map inArgument_prio_5F_for_5F_process,
                                         GALGAS_prio_5F_map & outArgument_prio_5F_for_5F_rez,
                                         GALGAS_stringMap & outArgument_comments,
                                         C_Compiler * inCompiler
                                         COMMA_UNUSED_LOCATION_ARGS) {
  outArgument_prio_5F_for_5F_rez.drop () ; // Release 'out' argument
  outArgument_comments.drop () ; // Release 'out' argument
  //-------- @assignmentInstructionForGeneration
  outArgument_prio_5F_for_5F_rez = GALGAS_prio_5F_map::constructor_emptyMap (SOURCE_FILE_AT_LINE (394)) ;
  //-------- @assignmentInstructionForGeneration
  outArgument_comments = GALGAS_stringMap::constructor_emptyMap (SOURCE_FILE_AT_LINE (395)) ;
  //-------- @foreachInstructionForGeneration
  cEnumerator_resource_5F_map enumerator_12163 (inArgument_rez, true) ;
  //--- simple foreach instruction
  while (enumerator_12163.hasCurrentObject ()) {
    //-------- @localVariableOrConstantDeclarationWithSourceExpressionForGeneration
    GALGAS_uint var_rez_5F_prio = GALGAS_uint ((PMUInt32) 0U) ;
    //-------- @localVariableOrConstantDeclarationWithSourceExpressionForGeneration
    GALGAS_uint var_rez_5F_act = GALGAS_uint ((PMUInt32) 0U) ;
    //-------- @localVariableOrConstantDeclarationWithSourceExpressionForGeneration
    GALGAS_string var_rez_5F_comment = GALGAS_string ("") ;
    //-------- @foreachInstructionForGeneration
    cEnumerator_task_5F_map enumerator_12304 (inArgument_tasks, true) ;
    //--- simple foreach instruction
    while (enumerator_12304.hasCurrentObject ()) {
      //-------- @localVariableOrConstantDeclarationWithSourceExpressionForGeneration
      GALGAS_lstringlist var_owned_5F_rez = enumerator_12304.current_task (HERE).reader_resources (SOURCE_FILE_AT_LINE (411)) ;
      //-------- @localVariableDeclarationForGeneration
      GALGAS_bool var_owned ;
      { //-------- @routineCallInstructionForGeneration
      GALGAS_lstring joker_12463_0 ; // Joker input parameter
      routine_is_5F_in_5F_lstringlist (var_owned_5F_rez, enumerator_12163.current_lkey (HERE), joker_12463_0, var_owned, inCompiler COMMA_SOURCE_FILE_AT_LINE (413)) ;
      } //-------- @routineCallInstructionForGeneration
      //-------- @ifInstructionForGeneration
      if (var_owned.isValidAndTrue ()) {
        //-------- @localVariableDeclarationForGeneration
        GALGAS_uint var_prio ;
        //-------- @localVariableDeclarationForGeneration
        GALGAS_uint var_act ;
        //-------- @methodCallInstructionForGeneration
        inArgument_prio_5F_for_5F_process.method_get (enumerator_12304.current_lkey (HERE), var_prio, var_act, inCompiler COMMA_SOURCE_FILE_AT_LINE (417)) ;
        //-------- END @methodCallInstructionForGeneration
        //-------- @ifInstructionForGeneration
        if (GALGAS_bool (kIsStrictSup, var_prio.objectCompare (var_rez_5F_prio)).isValidAndTrue ()) {
          //-------- @assignmentInstructionForGeneration
          var_rez_5F_prio = var_prio ;
        }
        //-------- @assignmentInstructionForGeneration
        var_rez_5F_act = var_rez_5F_act.add_operation (var_act, inCompiler COMMA_SOURCE_FILE_AT_LINE (421)) ;
        //-------- @appendInstructionForGeneration
        var_rez_5F_comment.dotAssign_operation (GALGAS_string (" used by task ").operator_concat (enumerator_12304.current_lkey (HERE).reader_string (SOURCE_FILE_AT_LINE (422)) COMMA_SOURCE_FILE_AT_LINE (422)).operator_concat (GALGAS_string (" (") COMMA_SOURCE_FILE_AT_LINE (422)).operator_concat (var_prio.reader_string (SOURCE_FILE_AT_LINE (422)) COMMA_SOURCE_FILE_AT_LINE (422)).operator_concat (GALGAS_string (")\n") COMMA_SOURCE_FILE_AT_LINE (422)) COMMA_SOURCE_FILE_AT_LINE (422)) ;
      }
      enumerator_12304.gotoNextObject () ;
    }
    //-------- @foreachInstructionForGeneration
    cEnumerator_isr_5F_map enumerator_12901 (inArgument_isrs, true) ;
    //--- simple foreach instruction
    while (enumerator_12901.hasCurrentObject ()) {
      //-------- @localVariableOrConstantDeclarationWithSourceExpressionForGeneration
      GALGAS_lstringlist var_owned_5F_rez = enumerator_12901.current_isr (HERE).reader_resources (SOURCE_FILE_AT_LINE (426)) ;
      //-------- @localVariableDeclarationForGeneration
      GALGAS_bool var_owned ;
      { //-------- @routineCallInstructionForGeneration
      GALGAS_lstring joker_13060_0 ; // Joker input parameter
      routine_is_5F_in_5F_lstringlist (var_owned_5F_rez, enumerator_12163.current_lkey (HERE), joker_13060_0, var_owned, inCompiler COMMA_SOURCE_FILE_AT_LINE (428)) ;
      } //-------- @routineCallInstructionForGeneration
      //-------- @ifInstructionForGeneration
      if (var_owned.isValidAndTrue ()) {
        //-------- @localVariableDeclarationForGeneration
        GALGAS_uint var_prio ;
        //-------- @localVariableDeclarationForGeneration
        GALGAS_uint var_act ;
        //-------- @methodCallInstructionForGeneration
        inArgument_prio_5F_for_5F_process.method_get (enumerator_12901.current_lkey (HERE), var_prio, var_act, inCompiler COMMA_SOURCE_FILE_AT_LINE (432)) ;
        //-------- END @methodCallInstructionForGeneration
        //-------- @ifInstructionForGeneration
        if (GALGAS_bool (kIsStrictSup, var_prio.objectCompare (var_rez_5F_prio)).isValidAndTrue ()) {
          //-------- @assignmentInstructionForGeneration
          var_rez_5F_prio = var_prio ;
        }
        //-------- @assignmentInstructionForGeneration
        var_rez_5F_act = var_rez_5F_act.add_operation (var_act, inCompiler COMMA_SOURCE_FILE_AT_LINE (436)) ;
        //-------- @appendInstructionForGeneration
        var_rez_5F_comment.dotAssign_operation (GALGAS_string (" used by isr ").operator_concat (enumerator_12901.current_lkey (HERE).reader_string (SOURCE_FILE_AT_LINE (437)) COMMA_SOURCE_FILE_AT_LINE (437)).operator_concat (GALGAS_string (" (") COMMA_SOURCE_FILE_AT_LINE (437)).operator_concat (var_prio.reader_string (SOURCE_FILE_AT_LINE (437)) COMMA_SOURCE_FILE_AT_LINE (437)).operator_concat (GALGAS_string (")\n") COMMA_SOURCE_FILE_AT_LINE (437)) COMMA_SOURCE_FILE_AT_LINE (437)) ;
      }
      enumerator_12901.gotoNextObject () ;
    }
    //-------- @ifInstructionForGeneration
    if (GALGAS_bool (kIsEqual, var_rez_5F_comment.objectCompare (GALGAS_string (""))).isValidAndTrue ()) {
      //-------- @assignmentInstructionForGeneration
      var_rez_5F_comment = GALGAS_string (" none\n") ;
    }
    //-------- @foreachInstructionForGeneration
    cEnumerator_task_5F_map enumerator_13752 (inArgument_tasks, true) ;
    //--- simple foreach instruction
    while (enumerator_13752.hasCurrentObject ()) {
      //-------- @localVariableOrConstantDeclarationWithSourceExpressionForGeneration
      GALGAS_lstringlist var_owned_5F_rez = enumerator_13752.current_task (HERE).reader_resources (SOURCE_FILE_AT_LINE (450)) ;
      //-------- @localVariableDeclarationForGeneration
      GALGAS_bool var_owned ;
      { //-------- @routineCallInstructionForGeneration
      GALGAS_lstring joker_13911_0 ; // Joker input parameter
      routine_is_5F_in_5F_lstringlist (var_owned_5F_rez, enumerator_12163.current_lkey (HERE), joker_13911_0, var_owned, inCompiler COMMA_SOURCE_FILE_AT_LINE (452)) ;
      } //-------- @routineCallInstructionForGeneration
      //-------- @ifInstructionForGeneration
      if (var_owned.isValidAndTrue ()) {
        //-------- @localVariableDeclarationForGeneration
        GALGAS_uint var_prio ;
        //-------- @localVariableDeclarationForGeneration
        GALGAS_uint var_act ;
        //-------- @methodCallInstructionForGeneration
        inArgument_prio_5F_for_5F_process.method_get (enumerator_13752.current_lkey (HERE), var_prio, var_act, inCompiler COMMA_SOURCE_FILE_AT_LINE (456)) ;
        //-------- END @methodCallInstructionForGeneration
        //-------- @ifInstructionForGeneration
        if (GALGAS_bool (kIsEqual, var_prio.objectCompare (var_rez_5F_prio)).isValidAndTrue ()) {
          //-------- @assignmentInstructionForGeneration
          var_rez_5F_act = var_rez_5F_act.substract_operation (var_act, inCompiler COMMA_SOURCE_FILE_AT_LINE (458)) ;
        }
      }
      enumerator_13752.gotoNextObject () ;
    }
    //-------- @foreachInstructionForGeneration
    cEnumerator_isr_5F_map enumerator_14230 (inArgument_isrs, true) ;
    //--- simple foreach instruction
    while (enumerator_14230.hasCurrentObject ()) {
      //-------- @localVariableOrConstantDeclarationWithSourceExpressionForGeneration
      GALGAS_lstringlist var_owned_5F_rez = enumerator_14230.current_isr (HERE).reader_resources (SOURCE_FILE_AT_LINE (463)) ;
      //-------- @localVariableDeclarationForGeneration
      GALGAS_bool var_owned ;
      { //-------- @routineCallInstructionForGeneration
      GALGAS_lstring joker_14389_0 ; // Joker input parameter
      routine_is_5F_in_5F_lstringlist (var_owned_5F_rez, enumerator_12163.current_lkey (HERE), joker_14389_0, var_owned, inCompiler COMMA_SOURCE_FILE_AT_LINE (465)) ;
      } //-------- @routineCallInstructionForGeneration
      //-------- @ifInstructionForGeneration
      if (var_owned.isValidAndTrue ()) {
        //-------- @localVariableDeclarationForGeneration
        GALGAS_uint var_prio ;
        //-------- @localVariableDeclarationForGeneration
        GALGAS_uint var_act ;
        //-------- @methodCallInstructionForGeneration
        inArgument_prio_5F_for_5F_process.method_get (enumerator_14230.current_lkey (HERE), var_prio, var_act, inCompiler COMMA_SOURCE_FILE_AT_LINE (469)) ;
        //-------- END @methodCallInstructionForGeneration
        //-------- @ifInstructionForGeneration
        if (GALGAS_bool (kIsEqual, var_prio.objectCompare (var_rez_5F_prio)).isValidAndTrue ()) {
          //-------- @assignmentInstructionForGeneration
          var_rez_5F_act = var_rez_5F_act.substract_operation (var_act, inCompiler COMMA_SOURCE_FILE_AT_LINE (471)) ;
        }
      }
      enumerator_14230.gotoNextObject () ;
    }
    { //-------- @modifierCallInstructionForGeneration
    outArgument_prio_5F_for_5F_rez.modifier_put (enumerator_12163.current_lkey (HERE), var_rez_5F_prio, var_rez_5F_act, inCompiler COMMA_SOURCE_FILE_AT_LINE (476)) ;
    } //-------- END @typeMethodInstructionForGeneration
    { //-------- @modifierCallInstructionForGeneration
    outArgument_comments.modifier_put (enumerator_12163.current_lkey (HERE), var_rez_5F_comment, inCompiler COMMA_SOURCE_FILE_AT_LINE (477)) ;
    } //-------- END @typeMethodInstructionForGeneration
    enumerator_12163.gotoNextObject () ;
  }
}


//---------------------------------------------------------------------------*
//                                                                           *
//                       Routine 'compute_ready_list'                        *
//                                                                           *
//---------------------------------------------------------------------------*

void routine_compute_5F_ready_5F_list (const GALGAS_root_5F_obj constinArgument_cpu,
                                       const GALGAS_prio_5F_map constinArgument_prio_5F_for_5F_process,
                                       const GALGAS_prio_5F_map constinArgument_prio_5F_for_5F_rez,
                                       const GALGAS_uint constinArgument_max_5F_task_5F_prio,
                                       const GALGAS_uint constinArgument_max_5F_prio,
                                       GALGAS_prio_5F_list & outArgument_ready_5F_list,
                                       C_Compiler * inCompiler
                                       COMMA_UNUSED_LOCATION_ARGS) {
  outArgument_ready_5F_list.drop () ; // Release 'out' argument
  //-------- @assignmentInstructionForGeneration
  outArgument_ready_5F_list = GALGAS_prio_5F_list::constructor_emptyList (SOURCE_FILE_AT_LINE (494)) ;
  //-------- @addAssignInstructionForGeneration
  outArgument_ready_5F_list.addAssign_operation (GALGAS_uint ((PMUInt32) 1U) COMMA_SOURCE_FILE_AT_LINE (497)) ;
  //-------- @localVariableOrConstantDeclarationWithSourceExpressionForGeneration
  GALGAS_uint var_prio = GALGAS_uint ((PMUInt32) 1U) ;
  //-------- @loopInstructionForGeneration
  if (constinArgument_max_5F_prio.isValid ()) {
    PMUInt32 variant_15519 = constinArgument_max_5F_prio.uintValue () ;
    bool loop_15519 = true ;
    while (loop_15519) {
      loop_15519 = GALGAS_bool (kIsInfOrEqual, var_prio.objectCompare (constinArgument_max_5F_prio)).isValid () ;
      if (loop_15519) {
        loop_15519 = GALGAS_bool (kIsInfOrEqual, var_prio.objectCompare (constinArgument_max_5F_prio)).boolValue () ;
      }
      if (loop_15519 && (0 == variant_15519)) {
        loop_15519 = false ;
        inCompiler->loopRunTimeVariantError (SOURCE_FILE_AT_LINE (502)) ;
      }
      if (loop_15519) {
        variant_15519 -- ;
        //-------- @localVariableOrConstantDeclarationWithSourceExpressionForGeneration
        GALGAS_uint var_fifosize = GALGAS_uint ((PMUInt32) 0U) ;
        //-------- @foreachInstructionForGeneration
        cEnumerator_prio_5F_map enumerator_15665 (constinArgument_prio_5F_for_5F_process, true) ;
        //--- simple foreach instruction
        while (enumerator_15665.hasCurrentObject ()) {
          //-------- @ifInstructionForGeneration
          if (GALGAS_bool (kIsEqual, enumerator_15665.current_prio (HERE).objectCompare (var_prio)).isValidAndTrue ()) {
            //-------- @assignmentInstructionForGeneration
            var_fifosize = var_fifosize.add_operation (enumerator_15665.current_act (HERE), inCompiler COMMA_SOURCE_FILE_AT_LINE (507)) ;
          }
          enumerator_15665.gotoNextObject () ;
        }
        //-------- @foreachInstructionForGeneration
        cEnumerator_prio_5F_map enumerator_15811 (constinArgument_prio_5F_for_5F_rez, true) ;
        //--- simple foreach instruction
        while (enumerator_15811.hasCurrentObject ()) {
          //-------- @ifInstructionForGeneration
          if (GALGAS_bool (kIsEqual, enumerator_15811.current_prio (HERE).objectCompare (var_prio)).isValidAndTrue ()) {
            //-------- @assignmentInstructionForGeneration
            var_fifosize = var_fifosize.add_operation (enumerator_15811.current_act (HERE), inCompiler COMMA_SOURCE_FILE_AT_LINE (510)) ;
          }
          enumerator_15811.gotoNextObject () ;
        }
        //-------- @ifInstructionForGeneration
        if (GALGAS_bool (kIsEqual, var_prio.objectCompare (constinArgument_max_5F_task_5F_prio)).isValidAndTrue ()) {
          //-------- @incrementInstructionForGeneration
          var_fifosize.increment_operation (inCompiler COMMA_SOURCE_FILE_AT_LINE (516)) ;
          //-------- @foreachInstructionForGeneration
          cEnumerator_app_5F_map enumerator_16251 (constinArgument_cpu.reader_applis (SOURCE_FILE_AT_LINE (519)), true) ;
          //--- simple foreach instruction
          while (enumerator_16251.hasCurrentObject ()) {
            //-------- @structuredCastInstructionForGeneration
            if (enumerator_16251.current_app (HERE).reader_startuphook (SOURCE_FILE_AT_LINE (520)).isValid ()) {
              if (enumerator_16251.current_app (HERE).reader_startuphook (SOURCE_FILE_AT_LINE (520)).dynamicTypeDescriptor () == & kTypeDescriptor_GALGAS_bool_5F_class) {
                GALGAS_bool_5F_class cast_16322_sh ((cPtr_bool_5F_class *) enumerator_16251.current_app (HERE).reader_startuphook (SOURCE_FILE_AT_LINE (520)).ptr ()) ;
                //-------- @ifInstructionForGeneration
                if (cast_16322_sh.reader_value (SOURCE_FILE_AT_LINE (521)).isValidAndTrue ()) {
                  //-------- @incrementInstructionForGeneration
                  var_fifosize.increment_operation (inCompiler COMMA_SOURCE_FILE_AT_LINE (521)) ;
                }
              }
            }
            //-------- @structuredCastInstructionForGeneration
            if (enumerator_16251.current_app (HERE).reader_shutdownhook (SOURCE_FILE_AT_LINE (523)).isValid ()) {
              if (enumerator_16251.current_app (HERE).reader_shutdownhook (SOURCE_FILE_AT_LINE (523)).dynamicTypeDescriptor () == & kTypeDescriptor_GALGAS_bool_5F_class) {
                GALGAS_bool_5F_class cast_16463_sh ((cPtr_bool_5F_class *) enumerator_16251.current_app (HERE).reader_shutdownhook (SOURCE_FILE_AT_LINE (523)).ptr ()) ;
                //-------- @ifInstructionForGeneration
                if (cast_16463_sh.reader_value (SOURCE_FILE_AT_LINE (524)).isValidAndTrue ()) {
                  //-------- @incrementInstructionForGeneration
                  var_fifosize.increment_operation (inCompiler COMMA_SOURCE_FILE_AT_LINE (524)) ;
                }
              }
            }
            enumerator_16251.gotoNextObject () ;
          }
        }
        //-------- @addAssignInstructionForGeneration
        outArgument_ready_5F_list.addAssign_operation (var_fifosize COMMA_SOURCE_FILE_AT_LINE (529)) ;
        //-------- @incrementInstructionForGeneration
        var_prio.increment_operation (inCompiler COMMA_SOURCE_FILE_AT_LINE (530)) ;
      }
    }
  }
}


//---------------------------------------------------------------------------*
//                                                                           *
//                       Routine 'compute_app_for_obj'                       *
//                                                                           *
//---------------------------------------------------------------------------*

void routine_compute_5F_app_5F_for_5F_obj (GALGAS_app_5F_map inArgument_apps,
                                           GALGAS_stringMap & outArgument_app_5F_for_5F_obj,
                                           C_Compiler * inCompiler
                                           COMMA_UNUSED_LOCATION_ARGS) {
  outArgument_app_5F_for_5F_obj.drop () ; // Release 'out' argument
  //-------- @assignmentInstructionForGeneration
  outArgument_app_5F_for_5F_obj = GALGAS_stringMap::constructor_emptyMap (SOURCE_FILE_AT_LINE (540)) ;
  //-------- @foreachInstructionForGeneration
  cEnumerator_app_5F_map enumerator_16806 (inArgument_apps, true) ;
  //--- simple foreach instruction
  while (enumerator_16806.hasCurrentObject ()) {
    //-------- @localVariableOrConstantDeclarationWithSourceExpressionForGeneration
    GALGAS_string var_app_5F_name = enumerator_16806.current_lkey (HERE).reader_string (SOURCE_FILE_AT_LINE (543)) ;
    //-------- @foreachInstructionForGeneration
    cEnumerator_ident_5F_map enumerator_16872 (enumerator_16806.current_app (HERE).reader_tasks (SOURCE_FILE_AT_LINE (544)), true) ;
    //--- simple foreach instruction
    while (enumerator_16872.hasCurrentObject ()) {
      //-------- @ifInstructionForGeneration
      if (outArgument_app_5F_for_5F_obj.reader_hasKey (enumerator_16872.current_lkey (HERE).reader_string (SOURCE_FILE_AT_LINE (545)) COMMA_SOURCE_FILE_AT_LINE (545)).operator_not (SOURCE_FILE_AT_LINE (545)).isValidAndTrue ()) {
        { //-------- @modifierCallInstructionForGeneration
        outArgument_app_5F_for_5F_obj.modifier_put (enumerator_16872.current_lkey (HERE), var_app_5F_name, inCompiler COMMA_SOURCE_FILE_AT_LINE (546)) ;
        } //-------- END @typeMethodInstructionForGeneration
      }
      enumerator_16872.gotoNextObject () ;
    }
    //-------- @foreachInstructionForGeneration
    cEnumerator_ident_5F_map enumerator_17028 (enumerator_16806.current_app (HERE).reader_isrs (SOURCE_FILE_AT_LINE (549)), true) ;
    //--- simple foreach instruction
    while (enumerator_17028.hasCurrentObject ()) {
      //-------- @ifInstructionForGeneration
      if (outArgument_app_5F_for_5F_obj.reader_hasKey (enumerator_17028.current_lkey (HERE).reader_string (SOURCE_FILE_AT_LINE (550)) COMMA_SOURCE_FILE_AT_LINE (550)).operator_not (SOURCE_FILE_AT_LINE (550)).isValidAndTrue ()) {
        { //-------- @modifierCallInstructionForGeneration
        outArgument_app_5F_for_5F_obj.modifier_put (enumerator_17028.current_lkey (HERE), var_app_5F_name, inCompiler COMMA_SOURCE_FILE_AT_LINE (551)) ;
        } //-------- END @typeMethodInstructionForGeneration
      }
      enumerator_17028.gotoNextObject () ;
    }
    //-------- @foreachInstructionForGeneration
    cEnumerator_ident_5F_map enumerator_17186 (enumerator_16806.current_app (HERE).reader_alarms (SOURCE_FILE_AT_LINE (554)), true) ;
    //--- simple foreach instruction
    while (enumerator_17186.hasCurrentObject ()) {
      //-------- @ifInstructionForGeneration
      if (outArgument_app_5F_for_5F_obj.reader_hasKey (enumerator_17186.current_lkey (HERE).reader_string (SOURCE_FILE_AT_LINE (555)) COMMA_SOURCE_FILE_AT_LINE (555)).operator_not (SOURCE_FILE_AT_LINE (555)).isValidAndTrue ()) {
        { //-------- @modifierCallInstructionForGeneration
        outArgument_app_5F_for_5F_obj.modifier_put (enumerator_17186.current_lkey (HERE), var_app_5F_name, inCompiler COMMA_SOURCE_FILE_AT_LINE (556)) ;
        } //-------- END @typeMethodInstructionForGeneration
      }
      enumerator_17186.gotoNextObject () ;
    }
    //-------- @foreachInstructionForGeneration
    cEnumerator_ident_5F_map enumerator_17352 (enumerator_16806.current_app (HERE).reader_scheduletables (SOURCE_FILE_AT_LINE (559)), true) ;
    //--- simple foreach instruction
    while (enumerator_17352.hasCurrentObject ()) {
      //-------- @ifInstructionForGeneration
      if (outArgument_app_5F_for_5F_obj.reader_hasKey (enumerator_17352.current_lkey (HERE).reader_string (SOURCE_FILE_AT_LINE (560)) COMMA_SOURCE_FILE_AT_LINE (560)).operator_not (SOURCE_FILE_AT_LINE (560)).isValidAndTrue ()) {
        { //-------- @modifierCallInstructionForGeneration
        outArgument_app_5F_for_5F_obj.modifier_put (enumerator_17352.current_lkey (HERE), var_app_5F_name, inCompiler COMMA_SOURCE_FILE_AT_LINE (561)) ;
        } //-------- END @typeMethodInstructionForGeneration
      }
      enumerator_17352.gotoNextObject () ;
    }
    //-------- @foreachInstructionForGeneration
    cEnumerator_ident_5F_map enumerator_17512 (enumerator_16806.current_app (HERE).reader_counters (SOURCE_FILE_AT_LINE (564)), true) ;
    //--- simple foreach instruction
    while (enumerator_17512.hasCurrentObject ()) {
      //-------- @ifInstructionForGeneration
      if (outArgument_app_5F_for_5F_obj.reader_hasKey (enumerator_17512.current_lkey (HERE).reader_string (SOURCE_FILE_AT_LINE (565)) COMMA_SOURCE_FILE_AT_LINE (565)).operator_not (SOURCE_FILE_AT_LINE (565)).isValidAndTrue ()) {
        { //-------- @modifierCallInstructionForGeneration
        outArgument_app_5F_for_5F_obj.modifier_put (enumerator_17512.current_lkey (HERE), var_app_5F_name, inCompiler COMMA_SOURCE_FILE_AT_LINE (566)) ;
        } //-------- END @typeMethodInstructionForGeneration
      }
      enumerator_17512.gotoNextObject () ;
    }
    //-------- @foreachInstructionForGeneration
    cEnumerator_ident_5F_map enumerator_17673 (enumerator_16806.current_app (HERE).reader_resources (SOURCE_FILE_AT_LINE (569)), true) ;
    //--- simple foreach instruction
    while (enumerator_17673.hasCurrentObject ()) {
      //-------- @ifInstructionForGeneration
      if (outArgument_app_5F_for_5F_obj.reader_hasKey (enumerator_17673.current_lkey (HERE).reader_string (SOURCE_FILE_AT_LINE (570)) COMMA_SOURCE_FILE_AT_LINE (570)).operator_not (SOURCE_FILE_AT_LINE (570)).isValidAndTrue ()) {
        { //-------- @modifierCallInstructionForGeneration
        outArgument_app_5F_for_5F_obj.modifier_put (enumerator_17673.current_lkey (HERE), var_app_5F_name, inCompiler COMMA_SOURCE_FILE_AT_LINE (571)) ;
        } //-------- END @typeMethodInstructionForGeneration
      }
      enumerator_17673.gotoNextObject () ;
    }
    enumerator_16806.gotoNextObject () ;
  }
}


//---------------------------------------------------------------------------*
//                                                                           *
//                          Routine 'computeEvents'                          *
//                                                                           *
//---------------------------------------------------------------------------*

void routine_computeEvents (const GALGAS_root_5F_obj constinArgument_cpu,
                            GALGAS_eventMaskMap & outArgument_eventMasks,
                            C_Compiler * inCompiler
                            COMMA_UNUSED_LOCATION_ARGS) {
  outArgument_eventMasks.drop () ; // Release 'out' argument
  //-------- @assignmentInstructionForGeneration
  outArgument_eventMasks = GALGAS_eventMaskMap::constructor_emptyMap (SOURCE_FILE_AT_LINE (584)) ;
  //-------- @localVariableOrConstantDeclarationWithSourceExpressionForGeneration
  GALGAS_task_5F_mask var_maskForTask = GALGAS_task_5F_mask::constructor_emptyMap (SOURCE_FILE_AT_LINE (585)) ;
  //-------- @localVariableOrConstantDeclarationWithConstructorCallForGeneration
  GALGAS_event_5F_usage_5F_map var_evt_5F_usage = GALGAS_event_5F_usage_5F_map::constructor_emptyMap (SOURCE_FILE_AT_LINE (598)) ;
  //-------- @localVariableOrConstantDeclarationWithConstructorCallForGeneration
  GALGAS_stringset_5F_map var_tasksForEvent = GALGAS_stringset_5F_map::constructor_emptyMap (SOURCE_FILE_AT_LINE (599)) ;
  //-------- @foreachInstructionForGeneration
  cEnumerator_task_5F_map enumerator_18695 (constinArgument_cpu.reader_tasks (SOURCE_FILE_AT_LINE (601)), true) ;
  //--- simple foreach instruction
  while (enumerator_18695.hasCurrentObject ()) {
    //-------- @localVariableDeclarationForGeneration
    GALGAS_lstringlist var_events_5F_used ;
    //-------- @assignmentInstructionForGeneration
    var_events_5F_used = enumerator_18695.current_task (HERE).reader_events (SOURCE_FILE_AT_LINE (603)) ;
    //-------- @localVariableOrConstantDeclarationWithSourceExpressionForGeneration
    GALGAS_uint_36__34_ var_event_5F_mask = GALGAS_uint_36__34_ ((PMUInt64) 0ULL) ;
    //-------- @foreachInstructionForGeneration
    cEnumerator_lstringlist enumerator_18851 (var_events_5F_used, true) ;
    //--- simple foreach instruction
    while (enumerator_18851.hasCurrentObject ()) {
      //-------- @localVariableDeclarationForGeneration
      GALGAS_event_5F_obj var_event ;
      //-------- @methodCallInstructionForGeneration
      constinArgument_cpu.reader_events (SOURCE_FILE_AT_LINE (607)).method_get (enumerator_18851.current_mValue (HERE), var_event, inCompiler COMMA_SOURCE_FILE_AT_LINE (607)) ;
      //-------- END @methodCallInstructionForGeneration
      //-------- @localVariableDeclarationForGeneration
      GALGAS_event_5F_mask_5F_obj var_mask_5F_obj ;
      //-------- @assignmentInstructionForGeneration
      var_mask_5F_obj = var_event.reader_mask (SOURCE_FILE_AT_LINE (609)) ;
      //-------- @structuredCastInstructionForGeneration
      if (var_mask_5F_obj.isValid ()) {
        if (var_mask_5F_obj.dynamicTypeDescriptor () == & kTypeDescriptor_GALGAS_event_5F_mask_5F_user_5F_obj) {
          GALGAS_event_5F_mask_5F_user_5F_obj cast_19064_emu ((cPtr_event_5F_mask_5F_user_5F_obj *) var_mask_5F_obj.ptr ()) ;
          //-------- @ifInstructionForGeneration
          if (GALGAS_bool (kIsEqual, var_event_5F_mask.operator_and (cast_19064_emu.reader_mask (SOURCE_FILE_AT_LINE (612)).reader_uint_36__34_ (SOURCE_FILE_AT_LINE (612)) COMMA_SOURCE_FILE_AT_LINE (612)).objectCompare (GALGAS_uint_36__34_ ((PMUInt64) 0ULL))).isValidAndTrue ()) {
            //-------- @assignmentInstructionForGeneration
            var_event_5F_mask = var_event_5F_mask.operator_or (cast_19064_emu.reader_mask (SOURCE_FILE_AT_LINE (613)).reader_uint_36__34_ (SOURCE_FILE_AT_LINE (613)) COMMA_SOURCE_FILE_AT_LINE (613)) ;
          }else{
            //-------- @errorInstructionForGeneration
            GALGAS_location location_0 (cast_19064_emu.reader_mask (SOURCE_FILE_AT_LINE (615)).reader_location (HERE)) ; // Implicit use of 'location' reader
            inCompiler->emitSemanticError (location_0, GALGAS_string ("MASK of event ").operator_concat (enumerator_18851.current_mValue (HERE).reader_string (SOURCE_FILE_AT_LINE (615)) COMMA_SOURCE_FILE_AT_LINE (615)).operator_concat (GALGAS_string (" conflicts with previous declarations") COMMA_SOURCE_FILE_AT_LINE (615)) COMMA_SOURCE_FILE_AT_LINE (615)) ;
          }
        }else if (var_mask_5F_obj.dynamicTypeDescriptor () == & kTypeDescriptor_GALGAS_event_5F_mask_5F_auto_5F_obj) {
          //-------- @localVariableDeclarationForGeneration
          GALGAS_uint var_count ;
          //-------- @ifInstructionForGeneration
          if (var_evt_5F_usage.reader_hasKey (enumerator_18851.current_mValue (HERE).reader_string (SOURCE_FILE_AT_LINE (619)) COMMA_SOURCE_FILE_AT_LINE (619)).isValidAndTrue ()) {
            { //-------- @modifierCallInstructionForGeneration
            var_evt_5F_usage.modifier_delete (enumerator_18851.current_mValue (HERE), var_count, inCompiler COMMA_SOURCE_FILE_AT_LINE (620)) ;
            } //-------- END @typeMethodInstructionForGeneration
            //-------- @incrementInstructionForGeneration
            var_count.increment_operation (inCompiler COMMA_SOURCE_FILE_AT_LINE (621)) ;
          }else{
            //-------- @assignmentInstructionForGeneration
            var_count = GALGAS_uint ((PMUInt32) 1U) ;
          }
          { //-------- @modifierCallInstructionForGeneration
          var_evt_5F_usage.modifier_insert_5F_count (enumerator_18851.current_mValue (HERE), var_count, inCompiler COMMA_SOURCE_FILE_AT_LINE (625)) ;
          } //-------- END @typeMethodInstructionForGeneration
        }
      }
      //-------- @localVariableOrConstantDeclarationWithConstructorCallForGeneration
      GALGAS_stringset var_refTasks = GALGAS_stringset::constructor_emptySet (SOURCE_FILE_AT_LINE (628)) ;
      //-------- @ifInstructionForGeneration
      if (var_tasksForEvent.reader_hasKey (enumerator_18851.current_mValue (HERE).reader_string (SOURCE_FILE_AT_LINE (629)) COMMA_SOURCE_FILE_AT_LINE (629)).isValidAndTrue ()) {
        { //-------- @modifierCallInstructionForGeneration
        var_tasksForEvent.modifier_delete (enumerator_18851.current_mValue (HERE), var_refTasks, inCompiler COMMA_SOURCE_FILE_AT_LINE (630)) ;
        } //-------- END @typeMethodInstructionForGeneration
      }
      //-------- @addAssignInstructionForGeneration
      var_refTasks.addAssign_operation (enumerator_18695.current_lkey (HERE).reader_string (SOURCE_FILE_AT_LINE (632)) COMMA_SOURCE_FILE_AT_LINE (632)) ;
      { //-------- @modifierCallInstructionForGeneration
      var_tasksForEvent.modifier_add (enumerator_18851.current_mValue (HERE), var_refTasks, inCompiler COMMA_SOURCE_FILE_AT_LINE (633)) ;
      } //-------- END @typeMethodInstructionForGeneration
      enumerator_18851.gotoNextObject () ;
    }
    { //-------- @modifierCallInstructionForGeneration
    var_maskForTask.modifier_insert_5F_mask (enumerator_18695.current_lkey (HERE), var_event_5F_mask, inCompiler COMMA_SOURCE_FILE_AT_LINE (635)) ;
    } //-------- END @typeMethodInstructionForGeneration
    enumerator_18695.gotoNextObject () ;
  }
  //-------- @foreachInstructionForGeneration
  cEnumerator_event_5F_map enumerator_20025 (constinArgument_cpu.reader_events (SOURCE_FILE_AT_LINE (641)), true) ;
  //--- simple foreach instruction
  while (enumerator_20025.hasCurrentObject ()) {
    //-------- @localVariableOrConstantDeclarationWithSourceExpressionForGeneration
    GALGAS_event_5F_mask_5F_obj var_eventMask = enumerator_20025.current_event (HERE).reader_mask (SOURCE_FILE_AT_LINE (642)) ;
    //-------- @structuredCastInstructionForGeneration
    if (var_eventMask.isValid ()) {
      if (var_eventMask.dynamicTypeDescriptor () == & kTypeDescriptor_GALGAS_event_5F_mask_5F_user_5F_obj) {
        GALGAS_event_5F_mask_5F_user_5F_obj cast_20169_emu ((cPtr_event_5F_mask_5F_user_5F_obj *) var_eventMask.ptr ()) ;
        { //-------- @modifierCallInstructionForGeneration
        outArgument_eventMasks.modifier_put (enumerator_20025.current_lkey (HERE), cast_20169_emu.reader_mask (SOURCE_FILE_AT_LINE (645)).reader_uint_36__34_ (SOURCE_FILE_AT_LINE (645)), inCompiler COMMA_SOURCE_FILE_AT_LINE (645)) ;
        } //-------- END @typeMethodInstructionForGeneration
      }
    }
    enumerator_20025.gotoNextObject () ;
  }
  //-------- @localVariableOrConstantDeclarationWithConstructorCallForGeneration
  GALGAS_sorted_5F_events var_sortedEvents = GALGAS_sorted_5F_events::constructor_emptySortedList (SOURCE_FILE_AT_LINE (653)) ;
  //-------- @foreachInstructionForGeneration
  cEnumerator_event_5F_usage_5F_map enumerator_20410 (var_evt_5F_usage, true) ;
  //--- simple foreach instruction
  while (enumerator_20410.hasCurrentObject ()) {
    //-------- @addAssignInstructionForGeneration
    var_sortedEvents.addAssign_operation (enumerator_20410.current_lkey (HERE), enumerator_20410.current_count (HERE) COMMA_SOURCE_FILE_AT_LINE (655)) ;
    enumerator_20410.gotoNextObject () ;
  }
  //-------- @foreachInstructionForGeneration
  cEnumerator_sorted_5F_events enumerator_20587 (var_sortedEvents, true) ;
  //--- simple foreach instruction
  while (enumerator_20587.hasCurrentObject ()) {
    //-------- @ifInstructionForGeneration
    if (var_tasksForEvent.reader_hasKey (enumerator_20587.current_event_5F_name (HERE).reader_string (SOURCE_FILE_AT_LINE (665)) COMMA_SOURCE_FILE_AT_LINE (665)).isValidAndTrue ()) {
      //-------- @localVariableDeclarationForGeneration
      GALGAS_stringset var_tasks ;
      //-------- @methodCallInstructionForGeneration
      var_tasksForEvent.method_get (enumerator_20587.current_event_5F_name (HERE), var_tasks, inCompiler COMMA_SOURCE_FILE_AT_LINE (667)) ;
      //-------- END @methodCallInstructionForGeneration
      //-------- @localVariableOrConstantDeclarationWithSourceExpressionForGeneration
      GALGAS_uint_36__34_ var_mask = GALGAS_uint_36__34_ ((PMUInt64) 0ULL) ;
      //-------- @foreachInstructionForGeneration
      cEnumerator_stringset enumerator_20761 (var_tasks, true) ;
      //--- simple foreach instruction
      while (enumerator_20761.hasCurrentObject ()) {
        //-------- @localVariableDeclarationForGeneration
        GALGAS_uint_36__34_ var_tm ;
        //-------- @methodCallInstructionForGeneration
        var_maskForTask.method_get_5F_mask (GALGAS_lstring::constructor_new (enumerator_20761.current_key (HERE), inCompiler->here () COMMA_SOURCE_FILE_AT_LINE (671)), var_tm, inCompiler COMMA_SOURCE_FILE_AT_LINE (671)) ;
        //-------- END @methodCallInstructionForGeneration
        //-------- @assignmentInstructionForGeneration
        var_mask = var_mask.operator_or (var_tm COMMA_SOURCE_FILE_AT_LINE (672)) ;
        enumerator_20761.gotoNextObject () ;
      }
      //-------- @localVariableOrConstantDeclarationWithSourceExpressionForGeneration
      GALGAS_uint_36__34_ var_bit = GALGAS_uint_36__34_ ((PMUInt64) 1ULL) ;
      //-------- @loopInstructionForGeneration
      if (GALGAS_uint ((PMUInt32) 32U).isValid ()) {
        PMUInt32 variant_21045 = GALGAS_uint ((PMUInt32) 32U).uintValue () ;
        bool loop_21045 = true ;
        while (loop_21045) {
          loop_21045 = GALGAS_bool (kIsStrictInf, var_bit.objectCompare (GALGAS_uint::constructor_max (SOURCE_FILE_AT_LINE (678)).reader_uint_36__34_ (SOURCE_FILE_AT_LINE (678)))).operator_and (GALGAS_bool (kIsEqual, var_bit.operator_and (var_mask.operator_tilde (SOURCE_FILE_AT_LINE (678)) COMMA_SOURCE_FILE_AT_LINE (678)).objectCompare (GALGAS_uint_36__34_ ((PMUInt64) 0ULL))) COMMA_SOURCE_FILE_AT_LINE (678)).isValid () ;
          if (loop_21045) {
            loop_21045 = GALGAS_bool (kIsStrictInf, var_bit.objectCompare (GALGAS_uint::constructor_max (SOURCE_FILE_AT_LINE (678)).reader_uint_36__34_ (SOURCE_FILE_AT_LINE (678)))).operator_and (GALGAS_bool (kIsEqual, var_bit.operator_and (var_mask.operator_tilde (SOURCE_FILE_AT_LINE (678)) COMMA_SOURCE_FILE_AT_LINE (678)).objectCompare (GALGAS_uint_36__34_ ((PMUInt64) 0ULL))) COMMA_SOURCE_FILE_AT_LINE (678)).boolValue () ;
          }
          if (loop_21045 && (0 == variant_21045)) {
            loop_21045 = false ;
            inCompiler->loopRunTimeVariantError (SOURCE_FILE_AT_LINE (677)) ;
          }
          if (loop_21045) {
            variant_21045 -- ;
            //-------- @assignmentInstructionForGeneration
            var_bit = var_bit.left_shift_operation (GALGAS_uint ((PMUInt32) 1U) COMMA_SOURCE_FILE_AT_LINE (679)) ;
          }
        }
      }
      //-------- @ifInstructionForGeneration
      if (GALGAS_bool (kIsStrictSup, var_bit.objectCompare (GALGAS_uint::constructor_max (SOURCE_FILE_AT_LINE (681)).reader_uint_36__34_ (SOURCE_FILE_AT_LINE (681)))).isValidAndTrue ()) {
        //-------- @errorInstructionForGeneration
        GALGAS_location location_1 (enumerator_20587.current_event_5F_name (HERE).reader_location (HERE)) ; // Implicit use of 'location' reader
        inCompiler->emitSemanticError (location_1, GALGAS_string ("All event mask bits are already use, event ").operator_concat (enumerator_20587.current_event_5F_name (HERE).reader_string (SOURCE_FILE_AT_LINE (682)) COMMA_SOURCE_FILE_AT_LINE (682)).operator_concat (GALGAS_string (" can't be created") COMMA_SOURCE_FILE_AT_LINE (682)) COMMA_SOURCE_FILE_AT_LINE (682)) ;
      }
      //-------- @foreachInstructionForGeneration
      cEnumerator_stringset enumerator_21448 (var_tasks, true) ;
      //--- simple foreach instruction
      while (enumerator_21448.hasCurrentObject ()) {
        //-------- @localVariableDeclarationForGeneration
        GALGAS_uint_36__34_ var_tm ;
        { //-------- @modifierCallInstructionForGeneration
        var_maskForTask.modifier_del_5F_mask (GALGAS_lstring::constructor_new (enumerator_21448.current_key (HERE), inCompiler->here () COMMA_SOURCE_FILE_AT_LINE (688)), var_tm, inCompiler COMMA_SOURCE_FILE_AT_LINE (688)) ;
        } //-------- END @typeMethodInstructionForGeneration
        //-------- @assignmentInstructionForGeneration
        var_tm = var_bit.operator_or (var_tm COMMA_SOURCE_FILE_AT_LINE (689)) ;
        { //-------- @modifierCallInstructionForGeneration
        var_maskForTask.modifier_insert_5F_mask (GALGAS_lstring::constructor_new (enumerator_21448.current_key (HERE), inCompiler->here () COMMA_SOURCE_FILE_AT_LINE (690)), var_tm, inCompiler COMMA_SOURCE_FILE_AT_LINE (690)) ;
        } //-------- END @typeMethodInstructionForGeneration
        enumerator_21448.gotoNextObject () ;
      }
      { //-------- @modifierCallInstructionForGeneration
      outArgument_eventMasks.modifier_put (enumerator_20587.current_event_5F_name (HERE), var_bit, inCompiler COMMA_SOURCE_FILE_AT_LINE (693)) ;
      } //-------- END @typeMethodInstructionForGeneration
    }
    enumerator_20587.gotoNextObject () ;
  }
}


//---------------------------------------------------------------------------*
//                                                                           *
//                          Routine 'generate_all'                           *
//                                                                           *
//---------------------------------------------------------------------------*

void routine_generate_5F_all (const GALGAS_root_5F_obj constinArgument_cpu,
                              C_Compiler * inCompiler
                              COMMA_UNUSED_LOCATION_ARGS) {
  //-------- @localVariableOrConstantDeclarationWithSourceExpressionForGeneration
  GALGAS_string var_temp_5F_dir = function_templates_5F_directory (GALGAS_string ("code"), inCompiler COMMA_SOURCE_FILE_AT_LINE (717)) ;
  //-------- @ifInstructionForGeneration
  if (GALGAS_bool (kIsNotEqual, var_temp_5F_dir.objectCompare (GALGAS_string (""))).isValidAndTrue ()) {
    //-------- @localVariableOrConstantDeclarationWithSourceExpressionForGeneration
    GALGAS_string var_target = GALGAS_string (gOption_goil_5F_options_target_5F_platform.reader_value ()) ;
    //-------- @ifInstructionForGeneration
    if (GALGAS_bool (kIsNotEqual, var_target.objectCompare (GALGAS_string (""))).isValidAndTrue ()) {
      //-------- @localVariableOrConstantDeclarationWithSourceExpressionForGeneration
      GALGAS_string var_types = function_template_5F_string (GALGAS_string ("code"), GALGAS_string ("types"), inCompiler COMMA_SOURCE_FILE_AT_LINE (723)) ;
      //-------- @localVariableOrConstantDeclarationWithConstructorCallForGeneration
      GALGAS_config var_cfg = GALGAS_config::constructor_emptyMap (SOURCE_FILE_AT_LINE (725)) ;
      //-------- @localVariableOrConstantDeclarationWithSourceExpressionForGeneration
      GALGAS_lstring var_cfg_5F_file = function_config_5F_file (inCompiler COMMA_SOURCE_FILE_AT_LINE (726)) ;
      //-------- @ifInstructionForGeneration
      if (GALGAS_bool (kIsNotEqual, var_cfg_5F_file.reader_string (SOURCE_FILE_AT_LINE (727)).objectCompare (GALGAS_string (""))).isValidAndTrue ()) {
        { //-------- @grammarInstructionWithSourceFileForGeneration
        cGrammar_cfg_5F_grammar::_performSourceFileParsing_ (inCompiler, var_cfg_5F_file, var_cfg COMMA_SOURCE_FILE_AT_LINE (728)) ;
        } //-------- END @grammarInstructionWithSourceFileForGeneration
      }
      //-------- @localVariableOrConstantDeclarationWithSourceExpressionForGeneration
      GALGAS_lstring var_extra_5F_cfg_5F_file = function_extra_5F_config_5F_file (inCompiler COMMA_SOURCE_FILE_AT_LINE (731)) ;
      //-------- @ifInstructionForGeneration
      if (GALGAS_bool (kIsNotEqual, var_extra_5F_cfg_5F_file.reader_string (SOURCE_FILE_AT_LINE (732)).objectCompare (GALGAS_string (""))).isValidAndTrue ()) {
        { //-------- @grammarInstructionWithSourceFileForGeneration
        cGrammar_cfg_5F_grammar::_performSourceFileParsing_ (inCompiler, var_extra_5F_cfg_5F_file, var_cfg COMMA_SOURCE_FILE_AT_LINE (733)) ;
        } //-------- END @grammarInstructionWithSourceFileForGeneration
      }
      //-------- @localVariableOrConstantDeclarationWithSourceExpressionForGeneration
      GALGAS_os_5F_config var_generated_5F_conf = function_os_5F_cfg (constinArgument_cpu, inCompiler COMMA_SOURCE_FILE_AT_LINE (736)) ;
      //-------- @localVariableDeclarationForGeneration
      GALGAS_uint var_max_5F_task_5F_prio ;
      //-------- @localVariableDeclarationForGeneration
      GALGAS_uint var_max_5F_prio ;
      //-------- @localVariableOrConstantDeclarationWithConstructorCallForGeneration
      GALGAS_prio_5F_map var_actual_5F_prio = GALGAS_prio_5F_map::constructor_emptyMap (SOURCE_FILE_AT_LINE (740)) ;
      { //-------- @routineCallInstructionForGeneration
      routine_compute_5F_actual_5F_task_5F_priority (constinArgument_cpu.reader_tasks (SOURCE_FILE_AT_LINE (742)), var_actual_5F_prio, var_max_5F_task_5F_prio, inCompiler COMMA_SOURCE_FILE_AT_LINE (741)) ;
      } //-------- @routineCallInstructionForGeneration
      { //-------- @routineCallInstructionForGeneration
      routine_compute_5F_actual_5F_isr_5F_priority (constinArgument_cpu.reader_isrs (SOURCE_FILE_AT_LINE (747)), var_actual_5F_prio, var_max_5F_task_5F_prio, var_max_5F_prio, inCompiler COMMA_SOURCE_FILE_AT_LINE (746)) ;
      } //-------- @routineCallInstructionForGeneration
      //-------- @localVariableDeclarationForGeneration
      GALGAS_prio_5F_map var_rez_5F_actual_5F_prio ;
      //-------- @localVariableDeclarationForGeneration
      GALGAS_stringMap var_rez_5F_comments ;
      { //-------- @routineCallInstructionForGeneration
      routine_compute_5F_rez_5F_priority (constinArgument_cpu.reader_resources (SOURCE_FILE_AT_LINE (755)), constinArgument_cpu.reader_tasks (SOURCE_FILE_AT_LINE (756)), constinArgument_cpu.reader_isrs (SOURCE_FILE_AT_LINE (757)), var_actual_5F_prio, var_rez_5F_actual_5F_prio, var_rez_5F_comments, inCompiler COMMA_SOURCE_FILE_AT_LINE (754)) ;
      } //-------- @routineCallInstructionForGeneration
      //-------- @localVariableDeclarationForGeneration
      GALGAS_prio_5F_list var_ready_5F_list ;
      { //-------- @routineCallInstructionForGeneration
      routine_compute_5F_ready_5F_list (constinArgument_cpu, var_actual_5F_prio, var_rez_5F_actual_5F_prio, var_max_5F_task_5F_prio, var_max_5F_prio, var_ready_5F_list, inCompiler COMMA_SOURCE_FILE_AT_LINE (763)) ;
      } //-------- @routineCallInstructionForGeneration
      //-------- @localVariableDeclarationForGeneration
      GALGAS_stringMap var_app_5F_for_5F_obj ;
      { //-------- @routineCallInstructionForGeneration
      routine_compute_5F_app_5F_for_5F_obj (constinArgument_cpu.reader_applis (SOURCE_FILE_AT_LINE (773)), var_app_5F_for_5F_obj, inCompiler COMMA_SOURCE_FILE_AT_LINE (772)) ;
      } //-------- @routineCallInstructionForGeneration
      { //-------- @routineCallInstructionForGeneration
      routine_generate_5F_types (constinArgument_cpu.reader_tasks (SOURCE_FILE_AT_LINE (778)), constinArgument_cpu.reader_isrs (SOURCE_FILE_AT_LINE (779)), constinArgument_cpu.reader_alarms (SOURCE_FILE_AT_LINE (780)), constinArgument_cpu.reader_counters (SOURCE_FILE_AT_LINE (781)), constinArgument_cpu.reader_resources (SOURCE_FILE_AT_LINE (782)), constinArgument_cpu.reader_scheduletables (SOURCE_FILE_AT_LINE (783)), constinArgument_cpu.reader_applis (SOURCE_FILE_AT_LINE (784)), var_max_5F_prio, var_types, inCompiler COMMA_SOURCE_FILE_AT_LINE (777)) ;
      } //-------- @routineCallInstructionForGeneration
      //-------- @localVariableDeclarationForGeneration
      GALGAS_eventMaskMap var_eventMasks ;
      { //-------- @routineCallInstructionForGeneration
      routine_computeEvents (constinArgument_cpu, var_eventMasks, inCompiler COMMA_SOURCE_FILE_AT_LINE (789)) ;
      } //-------- @routineCallInstructionForGeneration
      //-------- @localVariableOrConstantDeclarationWithConstructorCallForGeneration
      GALGAS_goilTemplateVariableMap var_sysCfg = GALGAS_goilTemplateVariableMap::constructor_emptyMap (SOURCE_FILE_AT_LINE (791)) ;
      { //-------- @routineCallInstructionForGeneration
      routine_setEnvData (constinArgument_cpu, var_sysCfg, inCompiler COMMA_SOURCE_FILE_AT_LINE (793)) ;
      } //-------- @routineCallInstructionForGeneration
      { //-------- @routineCallInstructionForGeneration
      routine_setProcessesList (constinArgument_cpu, var_actual_5F_prio, var_app_5F_for_5F_obj, var_sysCfg, inCompiler COMMA_SOURCE_FILE_AT_LINE (794)) ;
      } //-------- @routineCallInstructionForGeneration
      { //-------- @routineCallInstructionForGeneration
      routine_setBasicTasksList (constinArgument_cpu, var_actual_5F_prio, var_app_5F_for_5F_obj, var_sysCfg, inCompiler COMMA_SOURCE_FILE_AT_LINE (795)) ;
      } //-------- @routineCallInstructionForGeneration
      { //-------- @routineCallInstructionForGeneration
      routine_setExtendedTasksList (constinArgument_cpu, var_actual_5F_prio, var_app_5F_for_5F_obj, var_sysCfg, inCompiler COMMA_SOURCE_FILE_AT_LINE (796)) ;
      } //-------- @routineCallInstructionForGeneration
      { //-------- @routineCallInstructionForGeneration
      routine_setTasksList (constinArgument_cpu, var_actual_5F_prio, var_app_5F_for_5F_obj, var_sysCfg, inCompiler COMMA_SOURCE_FILE_AT_LINE (797)) ;
      } //-------- @routineCallInstructionForGeneration
      { //-------- @routineCallInstructionForGeneration
      routine_setISRs_31_List (constinArgument_cpu, var_actual_5F_prio, var_app_5F_for_5F_obj, var_sysCfg, inCompiler COMMA_SOURCE_FILE_AT_LINE (798)) ;
      } //-------- @routineCallInstructionForGeneration
      { //-------- @routineCallInstructionForGeneration
      routine_setISRs_32_List (constinArgument_cpu, var_actual_5F_prio, var_app_5F_for_5F_obj, var_sysCfg, inCompiler COMMA_SOURCE_FILE_AT_LINE (799)) ;
      } //-------- @routineCallInstructionForGeneration
      { //-------- @routineCallInstructionForGeneration
      routine_setCountersList (constinArgument_cpu, var_app_5F_for_5F_obj, var_sysCfg, inCompiler COMMA_SOURCE_FILE_AT_LINE (800)) ;
      } //-------- @routineCallInstructionForGeneration
      { //-------- @routineCallInstructionForGeneration
      routine_setEventsList (constinArgument_cpu, var_eventMasks, var_sysCfg, inCompiler COMMA_SOURCE_FILE_AT_LINE (801)) ;
      } //-------- @routineCallInstructionForGeneration
      { //-------- @routineCallInstructionForGeneration
      routine_setAlarmsList (constinArgument_cpu, var_app_5F_for_5F_obj, var_sysCfg, inCompiler COMMA_SOURCE_FILE_AT_LINE (802)) ;
      } //-------- @routineCallInstructionForGeneration
      { //-------- @routineCallInstructionForGeneration
      routine_setResourcesList (constinArgument_cpu, var_rez_5F_actual_5F_prio, var_app_5F_for_5F_obj, var_sysCfg, inCompiler COMMA_SOURCE_FILE_AT_LINE (803)) ;
      } //-------- @routineCallInstructionForGeneration
      { //-------- @routineCallInstructionForGeneration
      routine_setMessagesList (constinArgument_cpu, var_app_5F_for_5F_obj, var_sysCfg, inCompiler COMMA_SOURCE_FILE_AT_LINE (804)) ;
      } //-------- @routineCallInstructionForGeneration
      { //-------- @routineCallInstructionForGeneration
      routine_setScheduletablesList (constinArgument_cpu, var_app_5F_for_5F_obj, var_sysCfg, inCompiler COMMA_SOURCE_FILE_AT_LINE (805)) ;
      } //-------- @routineCallInstructionForGeneration
      { //-------- @routineCallInstructionForGeneration
      routine_setOsapplicationsList (constinArgument_cpu, var_app_5F_for_5F_obj, var_sysCfg, inCompiler COMMA_SOURCE_FILE_AT_LINE (806)) ;
      } //-------- @routineCallInstructionForGeneration
      { //-------- @routineCallInstructionForGeneration
      routine_setProcessCount (constinArgument_cpu, var_sysCfg, inCompiler COMMA_SOURCE_FILE_AT_LINE (807)) ;
      } //-------- @routineCallInstructionForGeneration
      { //-------- @routineCallInstructionForGeneration
      routine_setBuildConfig (constinArgument_cpu, var_sysCfg, inCompiler COMMA_SOURCE_FILE_AT_LINE (808)) ;
      } //-------- @routineCallInstructionForGeneration
      { //-------- @routineCallInstructionForGeneration
      routine_setReadyList (constinArgument_cpu, var_ready_5F_list, var_sysCfg, inCompiler COMMA_SOURCE_FILE_AT_LINE (809)) ;
      } //-------- @routineCallInstructionForGeneration
      { //-------- @routineCallInstructionForGeneration
      routine_addBoolValue (var_sysCfg, GALGAS_lstring::constructor_new (GALGAS_string ("AUTOSAR"), inCompiler->here () COMMA_SOURCE_FILE_AT_LINE (810)), GALGAS_bool (gOption_goil_5F_options_autosar_5F_on.reader_value ()), inCompiler COMMA_SOURCE_FILE_AT_LINE (810)) ;
      } //-------- @routineCallInstructionForGeneration
      { //-------- @routineCallInstructionForGeneration
      routine_addUnsignedValue (var_sysCfg, function_lstringWith (GALGAS_string ("MAXTASKPRIORITY"), inCompiler COMMA_SOURCE_FILE_AT_LINE (811)), var_max_5F_task_5F_prio.reader_uint_36__34_ (SOURCE_FILE_AT_LINE (811)), inCompiler COMMA_SOURCE_FILE_AT_LINE (811)) ;
      } //-------- @routineCallInstructionForGeneration
      { //-------- @routineCallInstructionForGeneration
      routine_setOsConfig (constinArgument_cpu, var_sysCfg, inCompiler COMMA_SOURCE_FILE_AT_LINE (812)) ;
      } //-------- @routineCallInstructionForGeneration
      { //-------- @routineCallInstructionForGeneration
      routine_setInterruptSources (var_cfg, var_sysCfg, inCompiler COMMA_SOURCE_FILE_AT_LINE (813)) ;
      } //-------- @routineCallInstructionForGeneration
      //-------- @localVariableOrConstantDeclarationWithSourceExpressionForGeneration
      GALGAS_string var_apiDescriptionFile = function_templateFilePath (GALGAS_string ("config"), GALGAS_string ("api.desc"), inCompiler COMMA_SOURCE_FILE_AT_LINE (820)) ;
      //-------- @ifInstructionForGeneration
      if (GALGAS_bool (kIsNotEqual, var_apiDescriptionFile.objectCompare (GALGAS_string (""))).isValidAndTrue ()) {
        { //-------- @grammarInstructionWithSourceFileForGeneration
        cGrammar_api_5F_grammar::_performSourceFileParsing_ (inCompiler, function_lstringWith (var_apiDescriptionFile, inCompiler COMMA_SOURCE_FILE_AT_LINE (822)), var_sysCfg COMMA_SOURCE_FILE_AT_LINE (822)) ;
        } //-------- END @grammarInstructionWithSourceFileForGeneration
      }else{
        //-------- @errorInstructionForGeneration
        inCompiler->emitSemanticError (inCompiler->here (), GALGAS_string ("No api.desc file found in config templates") COMMA_SOURCE_FILE_AT_LINE (824)) ;
      }
      //-------- @localVariableOrConstantDeclarationWithSourceExpressionForGeneration
      GALGAS_string var_goilLog = function_computeTemplate (GALGAS_string (""), var_sysCfg, GALGAS_string ("root"), inCompiler COMMA_SOURCE_FILE_AT_LINE (827)) ;
      //-------- @ifInstructionForGeneration
      if (GALGAS_bool (gOption_goil_5F_options_generate_5F_log.reader_value ()).isValidAndTrue ()) {
        //-------- @methodCallInstructionForGeneration
        var_goilLog.method_writeToFile (GALGAS_string ("goil.log"), inCompiler COMMA_SOURCE_FILE_AT_LINE (829)) ;
        //-------- END @methodCallInstructionForGeneration
      }
      //-------- @localVariableOrConstantDeclarationWithSourceExpressionForGeneration
      GALGAS_string var_directory = function_projectName (inCompiler COMMA_SOURCE_FILE_AT_LINE (833)) ;
      //-------- @localVariableOrConstantDeclarationWithSourceExpressionForGeneration
      GALGAS_string var_types_5F_file = GALGAS_string ("tpl_app_custom_types.h") ;
      //-------- @localVariableOrConstantDeclarationWithSourceExpressionForGeneration
      GALGAS_uint var_error_5F_count = GALGAS_uint::constructor_errorCount (inCompiler COMMA_SOURCE_FILE_AT_LINE (837)) ;
      //-------- @assignmentInstructionForGeneration
      var_types_5F_file = var_directory.operator_concat (GALGAS_string ("/") COMMA_SOURCE_FILE_AT_LINE (839)).operator_concat (var_types_5F_file COMMA_SOURCE_FILE_AT_LINE (839)) ;
      //-------- @ifInstructionForGeneration
      if (GALGAS_bool (kIsEqual, var_error_5F_count.objectCompare (GALGAS_uint ((PMUInt32) 0U))).isValidAndTrue ()) {
        //-------- @ifInstructionForGeneration
        if (GALGAS_bool (gOption_galgas_5F_cli_5F_options_verbose_5F_output.reader_value ()).isValidAndTrue ()) {
          //-------- @messageInstructionForGeneration
          inCompiler->printMessage (GALGAS_string ("creating ").operator_concat (var_types_5F_file COMMA_SOURCE_FILE_AT_LINE (843)).operator_concat (GALGAS_string ("\n") COMMA_SOURCE_FILE_AT_LINE (843)) COMMA_SOURCE_FILE_AT_LINE (843)) ;
        }
        //-------- @methodCallInstructionForGeneration
        var_types.method_makeDirectoryAndWriteToFile (var_types_5F_file, inCompiler COMMA_SOURCE_FILE_AT_LINE (845)) ;
        //-------- END @methodCallInstructionForGeneration
      }
    }else{
      //-------- @messageInstructionForGeneration
      inCompiler->printMessage (GALGAS_string ("No target platform given, compiling aborted\n") COMMA_SOURCE_FILE_AT_LINE (849)) ;
    }
  }else{
    //-------- @messageInstructionForGeneration
    inCompiler->printMessage (GALGAS_string ("No template directory defined, compiling aborted\n") COMMA_SOURCE_FILE_AT_LINE (852)) ;
  }
}


//--- START OF USER ZONE 2


//--- END OF USER ZONE 2


