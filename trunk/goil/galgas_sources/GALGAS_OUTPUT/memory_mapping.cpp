//---------------------------------------------------------------------------*
//                                                                           *
//                        File 'memory_mapping.cpp'                          *
//                        Generated by version 1.9.7                         *
//                    december 18th, 2009, at 15h36'15"                      *
//                                                                           *
//---------------------------------------------------------------------------*

//--- START OF USER ZONE 1


//--- END OF USER ZONE 1

//---------------------------------------------------------------------------*

#include "version_libpm.h"
#if LIBPM_VERSION != 629
  #error "This file has been compiled with a version of GALGAS different than the version of libpm"
#endif

//---------------------------------------------------------------------------*

#include <typeinfo>
#include "utilities/MF_MemoryControl.h"
#include "files/C_TextFileWrite.h"
#include "galgas/C_galgas_CLI_Options.h"
#include "memory_mapping.h"

//---------------------------------------------------------------------------*

#ifndef DO_NOT_GENERATE_CHECKINGS
  #define SOURCE_FILE_AT_LINE(line) "memory_mapping.ggs", line
  #define COMMA_SOURCE_FILE_AT_LINE(line) , SOURCE_FILE_AT_LINE(line)
#else
  #define SOURCE_FILE_AT_LINE(line) 
  #define COMMA_SOURCE_FILE_AT_LINE(line) 
#endif


//--- START OF USER ZONE 2


//--- END OF USER ZONE 2

//---------------------------------------------------------------------------*
//                                                                           *
//                 Implementation of routine "generate_mp"                   *
//                                                                           *
//---------------------------------------------------------------------------*

void routine_generate_mp (C_Compiler & inLexique,
                                const GGS_root_obj   var_cas_cpu,
                                const GGS_string_map   var_cas_app_for_obj,
                                GGS_string & /* var_cas_header */,
                                GGS_string & var_cas_implementation,
                                GGS_string & /* var_cas_obj_header */ COMMA_UNUSED_LOCATION_ARGS) {
  #ifdef DEBUG_TRACE_ENABLED
    printf ("ENTER routine_generate_mp at %s:%d\n", __FILE__, __LINE__) ;
  #endif
  const GGS_bool cond_4315 = function_memory_protection_on (inLexique, var_cas_cpu.reader_os (inLexique COMMA_SOURCE_FILE_AT_LINE (47)) COMMA_SOURCE_FILE_AT_LINE (47)) ;
  if (cond_4315.isBuiltAndTrue ()) {
    GGS_string var_cas_tpl_mp = function_template_string_if_exist (inLexique, GGS_string ("code"), GGS_string ("mp") COMMA_SOURCE_FILE_AT_LINE (48)) ;
    GGS_string var_cas_tpl_mp_desc = function_template_string_if_exist (inLexique, GGS_string ("code"), GGS_string ("mp_desc") COMMA_SOURCE_FILE_AT_LINE (49)) ;
    GGS_string var_cas_dec = GGS_string ("") ;
    GGS_string var_cas_ext = GGS_string ("") ;
    ::routine_doReplace (inLexique,  var_cas_tpl_mp,  GGS_string ("$TIMESTAMP$"),  GGS_string::constructor_stringWithCurrentDateTime (inLexique COMMA_HERE) COMMA_SOURCE_FILE_AT_LINE (53)) ;
    GGS_stringset  var_cas_known_osapp = GGS_stringset ::constructor_emptySet () ;
    {
      GGS_task_map::cEnumerator enumerator_1469 (var_cas_cpu.reader_tasks (inLexique COMMA_SOURCE_FILE_AT_LINE (57)), true) ;
      const GGS_task_map::cElement * operand_1469 = NULL ;
      while (((operand_1469 = enumerator_1469.nextObject ()))) {
        macroValidPointer (operand_1469) ;
        GGS_string var_cas_desc = var_cas_tpl_mp_desc.reader_stringByReplacingStringByString (inLexique, GGS_string ("$NAME$"), operand_1469->mKey.reader_string (inLexique COMMA_SOURCE_FILE_AT_LINE (58)) COMMA_SOURCE_FILE_AT_LINE (58)) ;
        const GGS_bool cond_2084 = gOption_goil_5F_options_autosar_5F_on.reader_value () ;
        if (cond_2084.isBuiltAndTrue ()) {
          const GGS_bool cond_2069 = (var_cas_app_for_obj.reader_count ()).operator_strictSup (GGS_uint (0U)) ;
          if (cond_2069.isBuiltAndTrue ()) {
            GGS_string var_cas_app_name ;
            const GGS_string_map  temp_1724 = var_cas_app_for_obj ;
            if (temp_1724.isBuilt ()) {
              temp_1724 (HERE)->method_get (inLexique, operand_1469->mKey, var_cas_app_name COMMA_SOURCE_FILE_AT_LINE (62)) ;
            }
            const GGS_bool cond_2052 = (var_cas_known_osapp.reader_hasKey (var_cas_app_name)).operator_not () ;
            if (cond_2052.isBuiltAndTrue ()) {
              var_cas_ext.appendCString ("extern void *__SEG_START_APP_") ;
              var_cas_ext.dotAssign_operation (var_cas_app_name) ;
              var_cas_ext.appendCString ("_VAR_RGN;\n") ;
              var_cas_ext.appendCString ("extern void *__SEG_END_APP_") ;
              var_cas_ext.dotAssign_operation (var_cas_app_name) ;
              var_cas_ext.appendCString ("_VAR_RGN;\n") ;
              ::routine_doReplace (inLexique,  var_cas_desc,  GGS_string ("$APP_NAME$"),  var_cas_app_name COMMA_SOURCE_FILE_AT_LINE (66)) ;
              var_cas_known_osapp.addAssign_operation (var_cas_app_name) ;
            }
          }
        }
        var_cas_dec.dotAssign_operation (var_cas_desc) ;
      }
    }
    {
      GGS_isr_map::cEnumerator enumerator_2141 (var_cas_cpu.reader_isrs (inLexique COMMA_SOURCE_FILE_AT_LINE (74)), true) ;
      const GGS_isr_map::cElement * operand_2141 = NULL ;
      while (((operand_2141 = enumerator_2141.nextObject ()))) {
        macroValidPointer (operand_2141) ;
        GGS_string var_cas_desc = var_cas_tpl_mp_desc.reader_stringByReplacingStringByString (inLexique, GGS_string ("$NAME$"), operand_2141->mKey.reader_string (inLexique COMMA_SOURCE_FILE_AT_LINE (75)) COMMA_SOURCE_FILE_AT_LINE (75)) ;
        const GGS_bool cond_2701 = gOption_goil_5F_options_autosar_5F_on.reader_value () ;
        if (cond_2701.isBuiltAndTrue ()) {
          const GGS_bool cond_2686 = (var_cas_app_for_obj.reader_count ()).operator_strictSup (GGS_uint (0U)) ;
          if (cond_2686.isBuiltAndTrue ()) {
            GGS_string var_cas_app_name ;
            const GGS_string_map  temp_2395 = var_cas_app_for_obj ;
            if (temp_2395.isBuilt ()) {
              temp_2395 (HERE)->method_get (inLexique, operand_2141->mKey, var_cas_app_name COMMA_SOURCE_FILE_AT_LINE (79)) ;
            }
            const GGS_bool cond_2669 = (var_cas_known_osapp.reader_hasKey (var_cas_app_name)).operator_not () ;
            if (cond_2669.isBuiltAndTrue ()) {
              var_cas_ext.appendCString ("extern void *__SEG_START_APP_") ;
              var_cas_ext.dotAssign_operation (var_cas_app_name) ;
              var_cas_ext.appendCString ("_VAR_RGN;\n") ;
              var_cas_ext.appendCString ("extern void *__SEG_END_APP_") ;
              var_cas_ext.dotAssign_operation (var_cas_app_name) ;
              var_cas_ext.appendCString ("_VAR_RGN;\n") ;
              var_cas_known_osapp.addAssign_operation (var_cas_app_name) ;
            }
          }
        }
        var_cas_dec.dotAssign_operation (var_cas_desc) ;
      }
    }
    GGS_tasks_by_type  var_cas_stasks = GGS_tasks_by_type ::constructor_emptySortedList () ;
    {
      GGS_task_map::cEnumerator enumerator_2858 (var_cas_cpu.reader_tasks (inLexique COMMA_SOURCE_FILE_AT_LINE (92)), true) ;
      const GGS_task_map::cElement * operand_2858 = NULL ;
      while (((operand_2858 = enumerator_2858.nextObject ()))) {
        macroValidPointer (operand_2858) ;
        const GGS_bool cond_2960 = (operand_2858->mInfo.task.reader_events (inLexique COMMA_SOURCE_FILE_AT_LINE (93)).reader_length ()).operator_strictSup (GGS_uint (0U)) ;
        if (cond_2960.isBuiltAndTrue ()) {
          var_cas_stasks.addAssign_operation (GGS_uint (0U), operand_2858->mKey.reader_string (inLexique COMMA_SOURCE_FILE_AT_LINE (94))) ;
        }else if (cond_2960.isBuiltAndFalse ()) {
          var_cas_stasks.addAssign_operation (GGS_uint (1U), operand_2858->mKey.reader_string (inLexique COMMA_SOURCE_FILE_AT_LINE (96))) ;
        }
      }
    }
    GGS_string var_cas_mp_table = GGS_string ("CONSTP2CONST(tpl_mem_prot_desc, AUTOMATIC, OS_VAR) tpl_mp_table[TASK_COUNT + ISR_COUNT + 1] = {\n") ;
    {
      GGS_tasks_by_type::cEnumerator enumerator_3176 (var_cas_stasks, true) ;
      const GGS_tasks_by_type::cElement * operand_3176 = NULL ;
      while (((operand_3176 = enumerator_3176.nextObject ()))) {
        macroValidPointer (operand_3176) ;
        const GGS_bool cond_3796 = gOption_goil_5F_options_autosar_5F_on.reader_value () ;
        if (cond_3796.isBuiltAndTrue ()) {
          const GGS_bool cond_3780 = (var_cas_app_for_obj.reader_count ()).operator_strictSup (GGS_uint (0U)) ;
          if (cond_3780.isBuiltAndTrue ()) {
            GGS_string var_cas_app_name ;
            const GGS_string_map  temp_3438 = var_cas_app_for_obj ;
            if (temp_3438.isBuilt ()) {
              temp_3438 (HERE)->method_get (inLexique, GGS_lstring ::constructor_new (inLexique, operand_3176->name, GGS_location (inLexique) COMMA_HERE), var_cas_app_name COMMA_SOURCE_FILE_AT_LINE (107)) ;
            }
            GGS_app_obj  var_cas_app ;
            const GGS_app_map  temp_3532 = var_cas_cpu.reader_applis (inLexique COMMA_SOURCE_FILE_AT_LINE (109)) ;
            if (temp_3532.isBuilt ()) {
              temp_3532 (HERE)->method_get (inLexique, GGS_lstring ::constructor_new (inLexique, var_cas_app_name, GGS_location (inLexique) COMMA_HERE), var_cas_app COMMA_SOURCE_FILE_AT_LINE (109)) ;
            }
            { const GGS_app_trusted_obj _var_3760 = var_cas_app.reader_trusted (inLexique COMMA_SOURCE_FILE_AT_LINE (110)) ; // CAST instruction
              if (_var_3760.getPtr () != NULL) {
                macroValidPointer (_var_3760.getPtr ()) ;
                if (typeid (cPtr_app_trusted_true) == typeid (* (_var_3760.getPtr ()))) {
                  var_cas_mp_table.appendCString ("  NULL,\n") ;
                }else{
                  var_cas_mp_table.appendCString ("  &") ;
                  var_cas_mp_table.dotAssign_operation (operand_3176->name) ;
                  var_cas_mp_table.appendCString ("_mp_desc,\n") ;
                }
              }
            }
          }
        }else if (cond_3796.isBuiltAndFalse ()) {
          var_cas_mp_table.appendCString ("  &") ;
          var_cas_mp_table.dotAssign_operation (operand_3176->name) ;
          var_cas_mp_table.appendCString ("_mp_desc,\n") ;
        }
      }
    }
    {
      GGS_isr_map::cEnumerator enumerator_3890 (var_cas_cpu.reader_isrs (inLexique COMMA_SOURCE_FILE_AT_LINE (122)), true) ;
      const GGS_isr_map::cElement * operand_3890 = NULL ;
      while (((operand_3890 = enumerator_3890.nextObject ()))) {
        macroValidPointer (operand_3890) ;
        var_cas_mp_table.appendCString ("  &") ;
        var_cas_mp_table.dotAssign_operation (operand_3890->mKey.reader_string (inLexique COMMA_SOURCE_FILE_AT_LINE (123))) ;
        var_cas_mp_table.appendCString ("_mp_desc,\n") ;
      }
    }
    var_cas_mp_table.appendCString ("  NULL\n"
      "};") ;
    GGS_string var_cas_directory = function_project_name (inLexique COMMA_SOURCE_FILE_AT_LINE (127)) ;
    ::routine_doReplace (inLexique,  var_cas_tpl_mp,  GGS_string ("$APPLICATION$"),  var_cas_directory COMMA_SOURCE_FILE_AT_LINE (129)) ;
    ::routine_doReplace (inLexique,  var_cas_tpl_mp,  GGS_string ("$LINKER_SYM$"),  var_cas_ext COMMA_SOURCE_FILE_AT_LINE (130)) ;
    ::routine_doReplace (inLexique,  var_cas_tpl_mp,  GGS_string ("$REGION_DESC$"),  var_cas_dec COMMA_SOURCE_FILE_AT_LINE (131)) ;
    ::routine_doReplace (inLexique,  var_cas_tpl_mp,  GGS_string ("$DESC_TABLE$"),  var_cas_mp_table COMMA_SOURCE_FILE_AT_LINE (132)) ;
    ::routine_doReplace (inLexique,  var_cas_implementation,  GGS_string ("$MEMORY_PROTECTION$"),  var_cas_tpl_mp COMMA_SOURCE_FILE_AT_LINE (134)) ;
  }
  #ifdef DEBUG_TRACE_ENABLED
    printf ("LEAVE routine_generate_mp\n") ;
  #endif
}

//---------------------------------------------------------------------------*
//                                                                           *
//           Implementation of routine "generate_link_script_new"            *
//                                                                           *
//---------------------------------------------------------------------------*

void routine_generate_link_script_new (C_Compiler & inLexique,
                                const GGS_root_obj   var_cas_cpu,
                                const GGS_goilTemplateVariableMap   var_cas_cfg COMMA_UNUSED_LOCATION_ARGS) {
  #ifdef DEBUG_TRACE_ENABLED
    printf ("ENTER routine_generate_link_script_new at %s:%d\n", __FILE__, __LINE__) ;
  #endif
  GGS_string var_cas_linker = function_linker (inLexique, var_cas_cpu.reader_os (inLexique COMMA_SOURCE_FILE_AT_LINE (142)).reader_memmap (inLexique COMMA_SOURCE_FILE_AT_LINE (142)) COMMA_SOURCE_FILE_AT_LINE (142)) ;
  const GGS_bool cond_4905 = (var_cas_linker).operator_isNotEqual (GGS_string ("")) ;
  if (cond_4905.isBuiltAndTrue ()) {
    GGS_string var_cas_linkerScript = function_goil_template (inLexique, var_cas_linker, var_cas_cfg, GGS_string ("script") COMMA_SOURCE_FILE_AT_LINE (144)) ;
    GGS_string var_cas_scriptFile = ((function_project_name (inLexique COMMA_SOURCE_FILE_AT_LINE (145))).operator_concat (GGS_string ("/"))).operator_concat (function_link_script_name (inLexique, var_cas_cpu.reader_os (inLexique COMMA_SOURCE_FILE_AT_LINE (145)).reader_memmap (inLexique COMMA_SOURCE_FILE_AT_LINE (145)) COMMA_SOURCE_FILE_AT_LINE (145))) ;
    GGS_uint  var_cas_error_count = GGS_uint ::constructor_errorCount (inLexique COMMA_HERE) ;
    const GGS_bool cond_4895 = (var_cas_error_count).operator_isEqual (GGS_uint (0U)) ;
    if (cond_4895.isBuiltAndTrue ()) {
      const GGS_bool cond_4821 = gOption_galgas_5F_cli_5F_options_verbose_5F_output.reader_value () ;
      if (cond_4821.isBuiltAndTrue ()) {
        inLexique.printMessage (((GGS_string ("creating ")).operator_concat (var_cas_scriptFile)).operator_concat (GGS_string ("\n")) COMMA_SOURCE_FILE_AT_LINE (149)) ;
      }
      const GGS_string temp_4873 = var_cas_linkerScript ;
      if (temp_4873.isBuilt ()) {
        temp_4873 (HERE)->method_makeDirectoryAndWriteToFile (inLexique, var_cas_scriptFile COMMA_SOURCE_FILE_AT_LINE (151)) ;
      }
    }
  }
  #ifdef DEBUG_TRACE_ENABLED
    printf ("LEAVE routine_generate_link_script_new\n") ;
  #endif
}

//---------------------------------------------------------------------------*
//                                                                           *
//             Implementation of routine "generate_link_script"              *
//                                                                           *
//---------------------------------------------------------------------------*

void routine_generate_link_script (C_Compiler & inLexique,
                                const GGS_root_obj   var_cas_cpu COMMA_UNUSED_LOCATION_ARGS) {
  #ifdef DEBUG_TRACE_ENABLED
    printf ("ENTER routine_generate_link_script at %s:%d\n", __FILE__, __LINE__) ;
  #endif
  GGS_string var_cas_linker = function_linker (inLexique, var_cas_cpu.reader_os (inLexique COMMA_SOURCE_FILE_AT_LINE (159)).reader_memmap (inLexique COMMA_SOURCE_FILE_AT_LINE (159)) COMMA_SOURCE_FILE_AT_LINE (159)) ;
  const GGS_bool cond_7848 = (var_cas_linker).operator_isNotEqual (GGS_string ("")) ;
  if (cond_7848.isBuiltAndTrue ()) {
    GGS_string var_cas_task_vars = GGS_string ("") ;
    GGS_string var_cas_isr_vars = GGS_string ("") ;
    GGS_string var_cas_task_stack = GGS_string ("") ;
    GGS_string var_cas_isr_stack = GGS_string ("") ;
    GGS_string var_cas_app_vars = GGS_string ("") ;
    GGS_string var_cas_user_consts = GGS_string ("") ;
    GGS_string var_cas_user_code = GGS_string ("") ;
    GGS_string var_cas_var_tpl = function_template_string_if_exist (inLexique, var_cas_linker, GGS_string ("task_var") COMMA_SOURCE_FILE_AT_LINE (170)) ;
    GGS_string var_cas_stack_tpl = function_template_string_if_exist (inLexique, var_cas_linker, GGS_string ("task_stack") COMMA_SOURCE_FILE_AT_LINE (171)) ;
    GGS_string var_cas_const_tpl = function_template_string_if_exist (inLexique, var_cas_linker, GGS_string ("task_const") COMMA_SOURCE_FILE_AT_LINE (172)) ;
    GGS_string var_cas_code_tpl = function_template_string_if_exist (inLexique, var_cas_linker, GGS_string ("task_code") COMMA_SOURCE_FILE_AT_LINE (173)) ;
    {
      GGS_task_map::cEnumerator enumerator_5593 (var_cas_cpu.reader_tasks (inLexique COMMA_SOURCE_FILE_AT_LINE (174)), true) ;
      const GGS_task_map::cElement * operand_5593 = NULL ;
      while (((operand_5593 = enumerator_5593.nextObject ()))) {
        macroValidPointer (operand_5593) ;
        var_cas_task_vars.dotAssign_operation (var_cas_var_tpl.reader_stringByReplacingStringByString (inLexique, GGS_string ("$TASK_NAME$"), operand_5593->mKey.reader_string (inLexique COMMA_SOURCE_FILE_AT_LINE (175)) COMMA_SOURCE_FILE_AT_LINE (175))) ;
        var_cas_task_stack.dotAssign_operation (var_cas_stack_tpl.reader_stringByReplacingStringByString (inLexique, GGS_string ("$TASK_NAME$"), operand_5593->mKey.reader_string (inLexique COMMA_SOURCE_FILE_AT_LINE (176)) COMMA_SOURCE_FILE_AT_LINE (176))) ;
        var_cas_user_consts.dotAssign_operation (var_cas_const_tpl.reader_stringByReplacingStringByString (inLexique, GGS_string ("$TASK_NAME$"), operand_5593->mKey.reader_string (inLexique COMMA_SOURCE_FILE_AT_LINE (177)) COMMA_SOURCE_FILE_AT_LINE (177))) ;
        var_cas_user_code.dotAssign_operation (var_cas_code_tpl.reader_stringByReplacingStringByString (inLexique, GGS_string ("$TASK_NAME$"), operand_5593->mKey.reader_string (inLexique COMMA_SOURCE_FILE_AT_LINE (178)) COMMA_SOURCE_FILE_AT_LINE (178))) ;
      }
    }
    var_cas_var_tpl = function_template_string_if_exist (inLexique, var_cas_linker, GGS_string ("isr_var") COMMA_SOURCE_FILE_AT_LINE (182)) ;
    var_cas_stack_tpl = function_template_string_if_exist (inLexique, var_cas_linker, GGS_string ("isr_stack") COMMA_SOURCE_FILE_AT_LINE (183)) ;
    var_cas_const_tpl = function_template_string_if_exist (inLexique, var_cas_linker, GGS_string ("isr_const") COMMA_SOURCE_FILE_AT_LINE (184)) ;
    var_cas_code_tpl = function_template_string_if_exist (inLexique, var_cas_linker, GGS_string ("isr_code") COMMA_SOURCE_FILE_AT_LINE (185)) ;
    {
      GGS_isr_map::cEnumerator enumerator_6306 (var_cas_cpu.reader_isrs (inLexique COMMA_SOURCE_FILE_AT_LINE (186)), true) ;
      const GGS_isr_map::cElement * operand_6306 = NULL ;
      while (((operand_6306 = enumerator_6306.nextObject ()))) {
        macroValidPointer (operand_6306) ;
        var_cas_isr_vars.dotAssign_operation (var_cas_var_tpl.reader_stringByReplacingStringByString (inLexique, GGS_string ("$ISR_NAME$"), operand_6306->mKey.reader_string (inLexique COMMA_SOURCE_FILE_AT_LINE (187)) COMMA_SOURCE_FILE_AT_LINE (187))) ;
        var_cas_isr_stack.dotAssign_operation (var_cas_stack_tpl.reader_stringByReplacingStringByString (inLexique, GGS_string ("$TASK_NAME$"), operand_6306->mKey.reader_string (inLexique COMMA_SOURCE_FILE_AT_LINE (188)) COMMA_SOURCE_FILE_AT_LINE (188))) ;
        var_cas_user_consts.dotAssign_operation (var_cas_const_tpl.reader_stringByReplacingStringByString (inLexique, GGS_string ("$ISR_NAME$"), operand_6306->mKey.reader_string (inLexique COMMA_SOURCE_FILE_AT_LINE (189)) COMMA_SOURCE_FILE_AT_LINE (189))) ;
        var_cas_user_code.dotAssign_operation (var_cas_code_tpl.reader_stringByReplacingStringByString (inLexique, GGS_string ("$ISR_NAME$"), operand_6306->mKey.reader_string (inLexique COMMA_SOURCE_FILE_AT_LINE (190)) COMMA_SOURCE_FILE_AT_LINE (190))) ;
      }
    }
    var_cas_var_tpl = function_template_string_if_exist (inLexique, var_cas_linker, GGS_string ("app_var") COMMA_SOURCE_FILE_AT_LINE (194)) ;
    var_cas_const_tpl = function_template_string_if_exist (inLexique, var_cas_linker, GGS_string ("app_const") COMMA_SOURCE_FILE_AT_LINE (195)) ;
    {
      GGS_app_map::cEnumerator enumerator_6899 (var_cas_cpu.reader_applis (inLexique COMMA_SOURCE_FILE_AT_LINE (196)), true) ;
      const GGS_app_map::cElement * operand_6899 = NULL ;
      while (((operand_6899 = enumerator_6899.nextObject ()))) {
        macroValidPointer (operand_6899) ;
        var_cas_app_vars.dotAssign_operation (var_cas_var_tpl.reader_stringByReplacingStringByString (inLexique, GGS_string ("$APP_NAME$"), operand_6899->mKey.reader_string (inLexique COMMA_SOURCE_FILE_AT_LINE (197)) COMMA_SOURCE_FILE_AT_LINE (197))) ;
        var_cas_user_consts.dotAssign_operation (var_cas_const_tpl.reader_stringByReplacingStringByString (inLexique, GGS_string ("$APP_NAME$"), operand_6899->mKey.reader_string (inLexique COMMA_SOURCE_FILE_AT_LINE (198)) COMMA_SOURCE_FILE_AT_LINE (198))) ;
      }
    }
    GGS_string var_cas_script = function_template_string_if_exist (inLexique, var_cas_linker, GGS_string ("script") COMMA_SOURCE_FILE_AT_LINE (202)) ;
    ::routine_doReplace (inLexique,  var_cas_script,  GGS_string ("$USER_CODE$"),  var_cas_user_code COMMA_SOURCE_FILE_AT_LINE (203)) ;
    ::routine_doReplace (inLexique,  var_cas_script,  GGS_string ("$USER_CONST$"),  var_cas_user_consts COMMA_SOURCE_FILE_AT_LINE (204)) ;
    ::routine_doReplace (inLexique,  var_cas_script,  GGS_string ("$PROC_VAR$"),  (var_cas_task_vars).operator_concat (var_cas_isr_vars) COMMA_SOURCE_FILE_AT_LINE (205)) ;
    ::routine_doReplace (inLexique,  var_cas_script,  GGS_string ("$PROC_STACK$"),  (var_cas_task_stack).operator_concat (var_cas_isr_stack) COMMA_SOURCE_FILE_AT_LINE (206)) ;
    ::routine_doReplace (inLexique,  var_cas_script,  GGS_string ("$APP_VAR$"),  var_cas_app_vars COMMA_SOURCE_FILE_AT_LINE (207)) ;
    GGS_string var_cas_script_file = ((function_project_name (inLexique COMMA_SOURCE_FILE_AT_LINE (210))).operator_concat (GGS_string ("/"))).operator_concat (function_link_script_name (inLexique, var_cas_cpu.reader_os (inLexique COMMA_SOURCE_FILE_AT_LINE (210)).reader_memmap (inLexique COMMA_SOURCE_FILE_AT_LINE (210)) COMMA_SOURCE_FILE_AT_LINE (210))) ;
    GGS_uint  var_cas_error_count = GGS_uint ::constructor_errorCount (inLexique COMMA_HERE) ;
    const GGS_bool cond_7838 = (var_cas_error_count).operator_isEqual (GGS_uint (0U)) ;
    if (cond_7838.isBuiltAndTrue ()) {
      const GGS_bool cond_7769 = gOption_galgas_5F_cli_5F_options_verbose_5F_output.reader_value () ;
      if (cond_7769.isBuiltAndTrue ()) {
        inLexique.printMessage (((GGS_string ("creating ")).operator_concat (var_cas_script_file)).operator_concat (GGS_string ("\n")) COMMA_SOURCE_FILE_AT_LINE (214)) ;
      }
      const GGS_string temp_7815 = var_cas_script ;
      if (temp_7815.isBuilt ()) {
        temp_7815 (HERE)->method_makeDirectoryAndWriteToFile (inLexique, var_cas_script_file COMMA_SOURCE_FILE_AT_LINE (216)) ;
      }
    }
  }
  #ifdef DEBUG_TRACE_ENABLED
    printf ("LEAVE routine_generate_link_script\n") ;
  #endif
}

//---------------------------------------------------------------------------*
//                                                                           *
//               Implementation of routine "generate_memmap"                 *
//                                                                           *
//---------------------------------------------------------------------------*

void routine_generate_memmap (C_Compiler & inLexique,
                                const GGS_root_obj   var_cas_cpu COMMA_UNUSED_LOCATION_ARGS) {
  #ifdef DEBUG_TRACE_ENABLED
    printf ("ENTER routine_generate_memmap at %s:%d\n", __FILE__, __LINE__) ;
  #endif
  GGS_string var_cas_cc = function_compiler (inLexique, var_cas_cpu.reader_os (inLexique COMMA_SOURCE_FILE_AT_LINE (224)).reader_memmap (inLexique COMMA_SOURCE_FILE_AT_LINE (224)) COMMA_SOURCE_FILE_AT_LINE (224)) ;
  const GGS_bool cond_18166 = (var_cas_cc).operator_isNotEqual (GGS_string ("")) ;
  if (cond_18166.isBuiltAndTrue ()) {
    GGS_string var_cas_mm = function_template_string_if_exist (inLexique, var_cas_cc, GGS_string ("MemMap.h") COMMA_SOURCE_FILE_AT_LINE (226)) ;
    GGS_string var_cas_result = GGS_string ("") ;
    GGS_string var_cas_gen_tpl = function_template_string_if_exist (inLexique, var_cas_cc, GGS_string ("generic_section") COMMA_SOURCE_FILE_AT_LINE (228)) ;
    GGS_string var_cas_section_tpl = var_cas_gen_tpl.reader_stringByReplacingStringByString (inLexique, GGS_string ("$CONT$"), GGS_string ("SEC") COMMA_SOURCE_FILE_AT_LINE (229)) ;
    GGS_string var_cas_config_tpl = var_cas_gen_tpl.reader_stringByReplacingStringByString (inLexique, GGS_string ("$CONT$"), GGS_string ("CONFIG") COMMA_SOURCE_FILE_AT_LINE (230)) ;
    GGS_stringlist  var_cas_data_size = GGS_stringlist ::constructor_emptyList () ;
    var_cas_data_size.addAssign_operation (GGS_string ("_32BIT")) ;
    var_cas_data_size.addAssign_operation (GGS_string ("_16BIT")) ;
    var_cas_data_size.addAssign_operation (GGS_string ("_8BIT")) ;
    var_cas_data_size.addAssign_operation (GGS_string ("_BOOLEAN")) ;
    var_cas_data_size.addAssign_operation (GGS_string ("_UNSPECIFIED")) ;
    GGS_stringlist  var_cas_sub_kind = GGS_stringlist ::constructor_emptyList () ;
    var_cas_sub_kind.addAssign_operation (GGS_string ("_NOINIT")) ;
    var_cas_sub_kind.addAssign_operation (GGS_string ("_POWER_ON_INIT")) ;
    var_cas_sub_kind.addAssign_operation (GGS_string ("_FAST")) ;
    var_cas_sub_kind.addAssign_operation (GGS_string ("")) ;
    GGS_string var_cas_obj_tpl = var_cas_section_tpl.reader_stringByReplacingStringByString (inLexique, GGS_string ("$OBJ$"), GGS_string ("Task") COMMA_SOURCE_FILE_AT_LINE (243)) ;
    {
      GGS_task_map::cEnumerator enumerator_8749 (var_cas_cpu.reader_tasks (inLexique COMMA_SOURCE_FILE_AT_LINE (244)), true) ;
      const GGS_task_map::cElement * operand_8749 = NULL ;
      while (((operand_8749 = enumerator_8749.nextObject ()))) {
        macroValidPointer (operand_8749) ;
        GGS_string var_cas_named_sec = var_cas_obj_tpl.reader_stringByReplacingStringByString (inLexique, GGS_string ("$NAME$"), operand_8749->mKey.reader_string (inLexique COMMA_SOURCE_FILE_AT_LINE (245)) COMMA_SOURCE_FILE_AT_LINE (245)) ;
        GGS_string var_cas_code_sec_tpl = var_cas_named_sec.reader_stringByReplacingStringByString (inLexique, GGS_string ("$KIND$"), GGS_string ("CODE") COMMA_SOURCE_FILE_AT_LINE (247)) ;
        ::routine_doReplace (inLexique,  var_cas_code_sec_tpl,  GGS_string ("$SUBKIND$"),  GGS_string ("") COMMA_SOURCE_FILE_AT_LINE (248)) ;
        ::routine_doReplace (inLexique,  var_cas_code_sec_tpl,  GGS_string ("$SIZE$"),  GGS_string ("") COMMA_SOURCE_FILE_AT_LINE (249)) ;
        ::routine_doReplace (inLexique,  var_cas_code_sec_tpl,  GGS_string ("$TYPE$"),  GGS_string ("CODE") COMMA_SOURCE_FILE_AT_LINE (250)) ;
        ::routine_doReplace (inLexique,  var_cas_code_sec_tpl,  GGS_string ("$SECTION_KIND$"),  GGS_string ("code") COMMA_SOURCE_FILE_AT_LINE (251)) ;
        var_cas_result.dotAssign_operation (var_cas_code_sec_tpl) ;
        GGS_string var_cas_var_sec_tpl = var_cas_named_sec.reader_stringByReplacingStringByString (inLexique, GGS_string ("$KIND$"), GGS_string ("VAR") COMMA_SOURCE_FILE_AT_LINE (254)) ;
        ::routine_doReplace (inLexique,  var_cas_var_sec_tpl,  GGS_string ("$TYPE$"),  GGS_string ("DATA") COMMA_SOURCE_FILE_AT_LINE (255)) ;
        ::routine_doReplace (inLexique,  var_cas_var_sec_tpl,  GGS_string ("$SECTION_KIND$"),  GGS_string ("data") COMMA_SOURCE_FILE_AT_LINE (256)) ;
        {
          GGS_stringlist::cEnumerator enumerator_9476 (var_cas_sub_kind, true) ;
          const GGS_stringlist::cElement * operand_9476 = NULL ;
          while (((operand_9476 = enumerator_9476.nextObject ()))) {
            macroValidPointer (operand_9476) ;
            GGS_string var_cas_var_sec_sk_tpl = var_cas_var_sec_tpl.reader_stringByReplacingStringByString (inLexique, GGS_string ("$SUBKIND$"), operand_9476->mValue COMMA_SOURCE_FILE_AT_LINE (258)) ;
            {
              GGS_stringlist::cEnumerator enumerator_9616 (var_cas_data_size, true) ;
              const GGS_stringlist::cElement * operand_9616 = NULL ;
              while (((operand_9616 = enumerator_9616.nextObject ()))) {
                macroValidPointer (operand_9616) ;
                GGS_string var_cas_partial_result = var_cas_var_sec_sk_tpl.reader_stringByReplacingStringByString (inLexique, GGS_string ("$SIZE$"), operand_9616->mValue COMMA_SOURCE_FILE_AT_LINE (260)) ;
                var_cas_result.dotAssign_operation (var_cas_partial_result) ;
              }
            }
          }
        }
        GGS_string var_cas_const_sec_tpl = var_cas_named_sec.reader_stringByReplacingStringByString (inLexique, GGS_string ("$KIND$"), GGS_string ("CONST") COMMA_SOURCE_FILE_AT_LINE (265)) ;
        ::routine_doReplace (inLexique,  var_cas_const_sec_tpl,  GGS_string ("$TYPE$"),  GGS_string ("DATA") COMMA_SOURCE_FILE_AT_LINE (266)) ;
        ::routine_doReplace (inLexique,  var_cas_const_sec_tpl,  GGS_string ("$SECTION_KIND$"),  GGS_string ("const") COMMA_SOURCE_FILE_AT_LINE (267)) ;
        var_cas_const_sec_tpl = var_cas_const_sec_tpl.reader_stringByReplacingStringByString (inLexique, GGS_string ("$SUBKIND$"), GGS_string ("") COMMA_SOURCE_FILE_AT_LINE (268)) ;
        {
          GGS_stringlist::cEnumerator enumerator_10171 (var_cas_data_size, true) ;
          const GGS_stringlist::cElement * operand_10171 = NULL ;
          while (((operand_10171 = enumerator_10171.nextObject ()))) {
            macroValidPointer (operand_10171) ;
            GGS_string var_cas_partial_result = var_cas_const_sec_tpl.reader_stringByReplacingStringByString (inLexique, GGS_string ("$SIZE$"), operand_10171->mValue COMMA_SOURCE_FILE_AT_LINE (270)) ;
            var_cas_result.dotAssign_operation (var_cas_partial_result) ;
          }
        }
        var_cas_const_sec_tpl = var_cas_named_sec.reader_stringByReplacingStringByString (inLexique, GGS_string ("$KIND$"), GGS_string ("CALIB") COMMA_SOURCE_FILE_AT_LINE (273)) ;
        ::routine_doReplace (inLexique,  var_cas_const_sec_tpl,  GGS_string ("$TYPE$"),  GGS_string ("DATA") COMMA_SOURCE_FILE_AT_LINE (274)) ;
        var_cas_const_sec_tpl = var_cas_const_sec_tpl.reader_stringByReplacingStringByString (inLexique, GGS_string ("$SUBKIND$"), GGS_string ("") COMMA_SOURCE_FILE_AT_LINE (275)) ;
        {
          GGS_stringlist::cEnumerator enumerator_10592 (var_cas_data_size, true) ;
          const GGS_stringlist::cElement * operand_10592 = NULL ;
          while (((operand_10592 = enumerator_10592.nextObject ()))) {
            macroValidPointer (operand_10592) ;
            GGS_string var_cas_partial_result = var_cas_const_sec_tpl.reader_stringByReplacingStringByString (inLexique, GGS_string ("$SIZE$"), operand_10592->mValue COMMA_SOURCE_FILE_AT_LINE (277)) ;
            var_cas_result.dotAssign_operation (var_cas_partial_result) ;
          }
        }
        var_cas_const_sec_tpl = var_cas_named_sec.reader_stringByReplacingStringByString (inLexique, GGS_string ("$KIND$"), GGS_string ("CARTO") COMMA_SOURCE_FILE_AT_LINE (280)) ;
        ::routine_doReplace (inLexique,  var_cas_const_sec_tpl,  GGS_string ("$TYPE$"),  GGS_string ("DATA") COMMA_SOURCE_FILE_AT_LINE (281)) ;
        var_cas_const_sec_tpl = var_cas_const_sec_tpl.reader_stringByReplacingStringByString (inLexique, GGS_string ("$SUBKIND$"), GGS_string ("") COMMA_SOURCE_FILE_AT_LINE (282)) ;
        {
          GGS_stringlist::cEnumerator enumerator_11013 (var_cas_data_size, true) ;
          const GGS_stringlist::cElement * operand_11013 = NULL ;
          while (((operand_11013 = enumerator_11013.nextObject ()))) {
            macroValidPointer (operand_11013) ;
            GGS_string var_cas_partial_result = var_cas_const_sec_tpl.reader_stringByReplacingStringByString (inLexique, GGS_string ("$SIZE$"), operand_11013->mValue COMMA_SOURCE_FILE_AT_LINE (284)) ;
            var_cas_result.dotAssign_operation (var_cas_partial_result) ;
          }
        }
        GGS_string var_cas_cfg_data = var_cas_config_tpl.reader_stringByReplacingStringByString (inLexique, GGS_string ("$KIND$"), GGS_string ("DATA") COMMA_SOURCE_FILE_AT_LINE (288)) ;
        ::routine_doReplace (inLexique,  var_cas_cfg_data,  GGS_string ("$TYPE$"),  GGS_string ("DATA") COMMA_SOURCE_FILE_AT_LINE (289)) ;
        ::routine_doReplace (inLexique,  var_cas_cfg_data,  GGS_string ("$SECTION_KIND$"),  GGS_string ("data") COMMA_SOURCE_FILE_AT_LINE (290)) ;
        var_cas_cfg_data = var_cas_cfg_data.reader_stringByReplacingStringByString (inLexique, GGS_string ("$SUBKIND$"), GGS_string ("") COMMA_SOURCE_FILE_AT_LINE (291)) ;
        var_cas_cfg_data = var_cas_cfg_data.reader_stringByReplacingStringByString (inLexique, GGS_string ("$OBJ$"), GGS_string ("Task") COMMA_SOURCE_FILE_AT_LINE (292)) ;
        var_cas_cfg_data = var_cas_cfg_data.reader_stringByReplacingStringByString (inLexique, GGS_string ("$NAME$"), operand_8749->mKey.reader_string (inLexique COMMA_SOURCE_FILE_AT_LINE (293)) COMMA_SOURCE_FILE_AT_LINE (293)) ;
        {
          GGS_stringlist::cEnumerator enumerator_11685 (var_cas_data_size, true) ;
          const GGS_stringlist::cElement * operand_11685 = NULL ;
          while (((operand_11685 = enumerator_11685.nextObject ()))) {
            macroValidPointer (operand_11685) ;
            GGS_string var_cas_partial_result = var_cas_cfg_data.reader_stringByReplacingStringByString (inLexique, GGS_string ("$SIZE$"), operand_11685->mValue COMMA_SOURCE_FILE_AT_LINE (295)) ;
            var_cas_result.dotAssign_operation (var_cas_partial_result) ;
          }
        }
        GGS_string var_cas_stack_data = var_cas_named_sec.reader_stringByReplacingStringByString (inLexique, GGS_string ("$KIND$"), GGS_string ("STACK") COMMA_SOURCE_FILE_AT_LINE (299)) ;
        ::routine_doReplace (inLexique,  var_cas_stack_data,  GGS_string ("$TYPE$"),  GGS_string ("DATA") COMMA_SOURCE_FILE_AT_LINE (300)) ;
        ::routine_doReplace (inLexique,  var_cas_stack_data,  GGS_string ("$SECTION_KIND$"),  GGS_string ("data") COMMA_SOURCE_FILE_AT_LINE (301)) ;
        ::routine_doReplace (inLexique,  var_cas_stack_data,  GGS_string ("$SUBKIND$"),  GGS_string ("") COMMA_SOURCE_FILE_AT_LINE (302)) ;
        ::routine_doReplace (inLexique,  var_cas_stack_data,  GGS_string ("$SIZE$"),  GGS_string ("") COMMA_SOURCE_FILE_AT_LINE (303)) ;
        var_cas_result.dotAssign_operation (var_cas_stack_data) ;
      }
    }
    var_cas_obj_tpl = var_cas_section_tpl.reader_stringByReplacingStringByString (inLexique, GGS_string ("$OBJ$"), GGS_string ("ISR") COMMA_SOURCE_FILE_AT_LINE (307)) ;
    {
      GGS_isr_map::cEnumerator enumerator_12314 (var_cas_cpu.reader_isrs (inLexique COMMA_SOURCE_FILE_AT_LINE (308)), true) ;
      const GGS_isr_map::cElement * operand_12314 = NULL ;
      while (((operand_12314 = enumerator_12314.nextObject ()))) {
        macroValidPointer (operand_12314) ;
        GGS_string var_cas_named_sec = var_cas_obj_tpl.reader_stringByReplacingStringByString (inLexique, GGS_string ("$NAME$"), operand_12314->mKey.reader_string (inLexique COMMA_SOURCE_FILE_AT_LINE (309)) COMMA_SOURCE_FILE_AT_LINE (309)) ;
        GGS_string var_cas_code_sec_tpl = var_cas_named_sec.reader_stringByReplacingStringByString (inLexique, GGS_string ("$KIND$"), GGS_string ("CODE") COMMA_SOURCE_FILE_AT_LINE (311)) ;
        ::routine_doReplace (inLexique,  var_cas_code_sec_tpl,  GGS_string ("$SUBKIND$"),  GGS_string ("") COMMA_SOURCE_FILE_AT_LINE (312)) ;
        ::routine_doReplace (inLexique,  var_cas_code_sec_tpl,  GGS_string ("$SIZE$"),  GGS_string ("") COMMA_SOURCE_FILE_AT_LINE (313)) ;
        ::routine_doReplace (inLexique,  var_cas_code_sec_tpl,  GGS_string ("$TYPE$"),  GGS_string ("CODE") COMMA_SOURCE_FILE_AT_LINE (314)) ;
        ::routine_doReplace (inLexique,  var_cas_code_sec_tpl,  GGS_string ("$SECTION_KIND$"),  GGS_string ("text") COMMA_SOURCE_FILE_AT_LINE (315)) ;
        var_cas_result.dotAssign_operation (var_cas_code_sec_tpl) ;
        GGS_string var_cas_var_sec_tpl = var_cas_named_sec.reader_stringByReplacingStringByString (inLexique, GGS_string ("$KIND$"), GGS_string ("VAR") COMMA_SOURCE_FILE_AT_LINE (318)) ;
        ::routine_doReplace (inLexique,  var_cas_var_sec_tpl,  GGS_string ("$TYPE$"),  GGS_string ("DATA") COMMA_SOURCE_FILE_AT_LINE (319)) ;
        ::routine_doReplace (inLexique,  var_cas_var_sec_tpl,  GGS_string ("$SECTION_KIND$"),  GGS_string ("data") COMMA_SOURCE_FILE_AT_LINE (320)) ;
        {
          GGS_stringlist::cEnumerator enumerator_13040 (var_cas_sub_kind, true) ;
          const GGS_stringlist::cElement * operand_13040 = NULL ;
          while (((operand_13040 = enumerator_13040.nextObject ()))) {
            macroValidPointer (operand_13040) ;
            GGS_string var_cas_var_sec_sk_tpl = var_cas_var_sec_tpl.reader_stringByReplacingStringByString (inLexique, GGS_string ("$SUBKIND$"), operand_13040->mValue COMMA_SOURCE_FILE_AT_LINE (322)) ;
            {
              GGS_stringlist::cEnumerator enumerator_13180 (var_cas_data_size, true) ;
              const GGS_stringlist::cElement * operand_13180 = NULL ;
              while (((operand_13180 = enumerator_13180.nextObject ()))) {
                macroValidPointer (operand_13180) ;
                GGS_string var_cas_partial_result = var_cas_var_sec_sk_tpl.reader_stringByReplacingStringByString (inLexique, GGS_string ("$SIZE$"), operand_13180->mValue COMMA_SOURCE_FILE_AT_LINE (324)) ;
                var_cas_result.dotAssign_operation (var_cas_partial_result) ;
              }
            }
          }
        }
        GGS_string var_cas_const_sec_tpl = var_cas_named_sec.reader_stringByReplacingStringByString (inLexique, GGS_string ("$KIND$"), GGS_string ("CONST") COMMA_SOURCE_FILE_AT_LINE (329)) ;
        ::routine_doReplace (inLexique,  var_cas_const_sec_tpl,  GGS_string ("$TYPE$"),  GGS_string ("DATA") COMMA_SOURCE_FILE_AT_LINE (330)) ;
        ::routine_doReplace (inLexique,  var_cas_const_sec_tpl,  GGS_string ("$SECTION_KIND$"),  GGS_string ("rodata") COMMA_SOURCE_FILE_AT_LINE (331)) ;
        var_cas_const_sec_tpl = var_cas_const_sec_tpl.reader_stringByReplacingStringByString (inLexique, GGS_string ("$SUBKIND$"), GGS_string ("") COMMA_SOURCE_FILE_AT_LINE (332)) ;
        {
          GGS_stringlist::cEnumerator enumerator_13736 (var_cas_data_size, true) ;
          const GGS_stringlist::cElement * operand_13736 = NULL ;
          while (((operand_13736 = enumerator_13736.nextObject ()))) {
            macroValidPointer (operand_13736) ;
            GGS_string var_cas_partial_result = var_cas_const_sec_tpl.reader_stringByReplacingStringByString (inLexique, GGS_string ("$SIZE$"), operand_13736->mValue COMMA_SOURCE_FILE_AT_LINE (334)) ;
            var_cas_result.dotAssign_operation (var_cas_partial_result) ;
          }
        }
        var_cas_const_sec_tpl = var_cas_named_sec.reader_stringByReplacingStringByString (inLexique, GGS_string ("$KIND$"), GGS_string ("CALIB") COMMA_SOURCE_FILE_AT_LINE (337)) ;
        ::routine_doReplace (inLexique,  var_cas_const_sec_tpl,  GGS_string ("$TYPE$"),  GGS_string ("DATA") COMMA_SOURCE_FILE_AT_LINE (338)) ;
        var_cas_const_sec_tpl = var_cas_const_sec_tpl.reader_stringByReplacingStringByString (inLexique, GGS_string ("$SUBKIND$"), GGS_string ("") COMMA_SOURCE_FILE_AT_LINE (339)) ;
        {
          GGS_stringlist::cEnumerator enumerator_14157 (var_cas_data_size, true) ;
          const GGS_stringlist::cElement * operand_14157 = NULL ;
          while (((operand_14157 = enumerator_14157.nextObject ()))) {
            macroValidPointer (operand_14157) ;
            GGS_string var_cas_partial_result = var_cas_const_sec_tpl.reader_stringByReplacingStringByString (inLexique, GGS_string ("$SIZE$"), operand_14157->mValue COMMA_SOURCE_FILE_AT_LINE (341)) ;
            var_cas_result.dotAssign_operation (var_cas_partial_result) ;
          }
        }
        var_cas_const_sec_tpl = var_cas_named_sec.reader_stringByReplacingStringByString (inLexique, GGS_string ("$KIND$"), GGS_string ("CARTO") COMMA_SOURCE_FILE_AT_LINE (344)) ;
        ::routine_doReplace (inLexique,  var_cas_const_sec_tpl,  GGS_string ("$TYPE$"),  GGS_string ("DATA") COMMA_SOURCE_FILE_AT_LINE (345)) ;
        var_cas_const_sec_tpl = var_cas_const_sec_tpl.reader_stringByReplacingStringByString (inLexique, GGS_string ("$SUBKIND$"), GGS_string ("") COMMA_SOURCE_FILE_AT_LINE (346)) ;
        {
          GGS_stringlist::cEnumerator enumerator_14578 (var_cas_data_size, true) ;
          const GGS_stringlist::cElement * operand_14578 = NULL ;
          while (((operand_14578 = enumerator_14578.nextObject ()))) {
            macroValidPointer (operand_14578) ;
            GGS_string var_cas_partial_result = var_cas_const_sec_tpl.reader_stringByReplacingStringByString (inLexique, GGS_string ("$SIZE$"), operand_14578->mValue COMMA_SOURCE_FILE_AT_LINE (348)) ;
            var_cas_result.dotAssign_operation (var_cas_partial_result) ;
          }
        }
        GGS_string var_cas_cfg_data = var_cas_config_tpl.reader_stringByReplacingStringByString (inLexique, GGS_string ("$KIND$"), GGS_string ("DATA") COMMA_SOURCE_FILE_AT_LINE (352)) ;
        ::routine_doReplace (inLexique,  var_cas_cfg_data,  GGS_string ("$TYPE$"),  GGS_string ("DATA") COMMA_SOURCE_FILE_AT_LINE (353)) ;
        ::routine_doReplace (inLexique,  var_cas_cfg_data,  GGS_string ("$SECTION_KIND$"),  GGS_string ("data") COMMA_SOURCE_FILE_AT_LINE (354)) ;
        var_cas_cfg_data = var_cas_cfg_data.reader_stringByReplacingStringByString (inLexique, GGS_string ("$SUBKIND$"), GGS_string ("") COMMA_SOURCE_FILE_AT_LINE (355)) ;
        var_cas_cfg_data = var_cas_cfg_data.reader_stringByReplacingStringByString (inLexique, GGS_string ("$OBJ$"), GGS_string ("ISR") COMMA_SOURCE_FILE_AT_LINE (356)) ;
        var_cas_cfg_data = var_cas_cfg_data.reader_stringByReplacingStringByString (inLexique, GGS_string ("$NAME$"), operand_12314->mKey.reader_string (inLexique COMMA_SOURCE_FILE_AT_LINE (357)) COMMA_SOURCE_FILE_AT_LINE (357)) ;
        {
          GGS_stringlist::cEnumerator enumerator_15249 (var_cas_data_size, true) ;
          const GGS_stringlist::cElement * operand_15249 = NULL ;
          while (((operand_15249 = enumerator_15249.nextObject ()))) {
            macroValidPointer (operand_15249) ;
            GGS_string var_cas_partial_result = var_cas_cfg_data.reader_stringByReplacingStringByString (inLexique, GGS_string ("$SIZE$"), operand_15249->mValue COMMA_SOURCE_FILE_AT_LINE (359)) ;
            var_cas_result.dotAssign_operation (var_cas_partial_result) ;
          }
        }
      }
    }
    ::routine_doReplace (inLexique,  var_cas_mm,  GGS_string ("$APP_MEMMAP$"),  var_cas_result COMMA_SOURCE_FILE_AT_LINE (364)) ;
    GGS_string var_cas_os_secs = GGS_string ("") ;
    GGS_string var_cas_os_tpl = function_template_string_if_exist (inLexique, var_cas_cc, GGS_string ("os_section") COMMA_SOURCE_FILE_AT_LINE (368)) ;
    GGS_string var_cas_code_section = var_cas_os_tpl.reader_stringByReplacingStringByString (inLexique, GGS_string ("$KIND$"), GGS_string ("CODE") COMMA_SOURCE_FILE_AT_LINE (369)) ;
    ::routine_doReplace (inLexique,  var_cas_code_section,  GGS_string ("$TYPE$"),  GGS_string ("CODE") COMMA_SOURCE_FILE_AT_LINE (370)) ;
    ::routine_doReplace (inLexique,  var_cas_code_section,  GGS_string ("$SECTION_KIND$"),  GGS_string ("text") COMMA_SOURCE_FILE_AT_LINE (371)) ;
    ::routine_doReplace (inLexique,  var_cas_code_section,  GGS_string ("$CONT$"),  GGS_string ("SEC") COMMA_SOURCE_FILE_AT_LINE (372)) ;
    ::routine_doReplace (inLexique,  var_cas_code_section,  GGS_string ("$SUBKIND$"),  GGS_string ("") COMMA_SOURCE_FILE_AT_LINE (373)) ;
    ::routine_doReplace (inLexique,  var_cas_code_section,  GGS_string ("$SIZE$"),  GGS_string ("") COMMA_SOURCE_FILE_AT_LINE (374)) ;
    ::routine_doReplace (inLexique,  var_cas_code_section,  GGS_string ("$SECTION$"),  GGS_string (".osCode") COMMA_SOURCE_FILE_AT_LINE (375)) ;
    var_cas_os_secs.dotAssign_operation (var_cas_code_section) ;
    GGS_string var_cas_var_section = var_cas_os_tpl.reader_stringByReplacingStringByString (inLexique, GGS_string ("$KIND$"), GGS_string ("VAR") COMMA_SOURCE_FILE_AT_LINE (378)) ;
    ::routine_doReplace (inLexique,  var_cas_var_section,  GGS_string ("$TYPE$"),  GGS_string ("DATA") COMMA_SOURCE_FILE_AT_LINE (379)) ;
    ::routine_doReplace (inLexique,  var_cas_var_section,  GGS_string ("$SECTION_KIND$"),  GGS_string ("data") COMMA_SOURCE_FILE_AT_LINE (380)) ;
    ::routine_doReplace (inLexique,  var_cas_var_section,  GGS_string ("$CONT$"),  GGS_string ("SEC") COMMA_SOURCE_FILE_AT_LINE (381)) ;
    ::routine_doReplace (inLexique,  var_cas_var_section,  GGS_string ("$SECTION$"),  GGS_string (".osVar") COMMA_SOURCE_FILE_AT_LINE (382)) ;
    GGS_string var_cas_no_init = var_cas_var_section.reader_stringByReplacingStringByString (inLexique, GGS_string ("$SUBKIND$"), GGS_string ("_NOINIT") COMMA_SOURCE_FILE_AT_LINE (383)) ;
    {
      GGS_stringlist::cEnumerator enumerator_16407 (var_cas_data_size, true) ;
      const GGS_stringlist::cElement * operand_16407 = NULL ;
      while (((operand_16407 = enumerator_16407.nextObject ()))) {
        macroValidPointer (operand_16407) ;
        var_cas_os_secs.dotAssign_operation (var_cas_no_init.reader_stringByReplacingStringByString (inLexique, GGS_string ("$SIZE$"), operand_16407->mValue COMMA_SOURCE_FILE_AT_LINE (385))) ;
      }
    }
    GGS_string var_cas_power_on = var_cas_var_section.reader_stringByReplacingStringByString (inLexique, GGS_string ("$SUBKIND$"), GGS_string ("_POWER_ON_INIT") COMMA_SOURCE_FILE_AT_LINE (387)) ;
    {
      GGS_stringlist::cEnumerator enumerator_16642 (var_cas_data_size, true) ;
      const GGS_stringlist::cElement * operand_16642 = NULL ;
      while (((operand_16642 = enumerator_16642.nextObject ()))) {
        macroValidPointer (operand_16642) ;
        var_cas_os_secs.dotAssign_operation (var_cas_power_on.reader_stringByReplacingStringByString (inLexique, GGS_string ("$SIZE$"), operand_16642->mValue COMMA_SOURCE_FILE_AT_LINE (389))) ;
      }
    }
    GGS_string var_cas_fast = var_cas_var_section.reader_stringByReplacingStringByString (inLexique, GGS_string ("$SUBKIND$"), GGS_string ("_POWER_ON_INIT") COMMA_SOURCE_FILE_AT_LINE (391)) ;
    {
      GGS_stringlist::cEnumerator enumerator_16874 (var_cas_data_size, true) ;
      const GGS_stringlist::cElement * operand_16874 = NULL ;
      while (((operand_16874 = enumerator_16874.nextObject ()))) {
        macroValidPointer (operand_16874) ;
        var_cas_os_secs.dotAssign_operation (var_cas_fast.reader_stringByReplacingStringByString (inLexique, GGS_string ("$SIZE$"), operand_16874->mValue COMMA_SOURCE_FILE_AT_LINE (393))) ;
      }
    }
    GGS_string var_cas_var = var_cas_var_section.reader_stringByReplacingStringByString (inLexique, GGS_string ("$SUBKIND$"), GGS_string ("") COMMA_SOURCE_FILE_AT_LINE (395)) ;
    {
      GGS_stringlist::cEnumerator enumerator_17087 (var_cas_data_size, true) ;
      const GGS_stringlist::cElement * operand_17087 = NULL ;
      while (((operand_17087 = enumerator_17087.nextObject ()))) {
        macroValidPointer (operand_17087) ;
        var_cas_os_secs.dotAssign_operation (var_cas_var.reader_stringByReplacingStringByString (inLexique, GGS_string ("$SIZE$"), operand_17087->mValue COMMA_SOURCE_FILE_AT_LINE (397))) ;
      }
    }
    GGS_string var_cas_const_section = var_cas_os_tpl.reader_stringByReplacingStringByString (inLexique, GGS_string ("$KIND$"), GGS_string ("CONST") COMMA_SOURCE_FILE_AT_LINE (400)) ;
    ::routine_doReplace (inLexique,  var_cas_const_section,  GGS_string ("$TYPE$"),  GGS_string ("DATA") COMMA_SOURCE_FILE_AT_LINE (401)) ;
    ::routine_doReplace (inLexique,  var_cas_const_section,  GGS_string ("$SECTION_KIND$"),  GGS_string ("rodata") COMMA_SOURCE_FILE_AT_LINE (402)) ;
    ::routine_doReplace (inLexique,  var_cas_const_section,  GGS_string ("$CONT$"),  GGS_string ("SEC") COMMA_SOURCE_FILE_AT_LINE (403)) ;
    ::routine_doReplace (inLexique,  var_cas_const_section,  GGS_string ("$SECTION$"),  GGS_string (".osConst") COMMA_SOURCE_FILE_AT_LINE (404)) ;
    GGS_string var_cas_os_const = var_cas_const_section.reader_stringByReplacingStringByString (inLexique, GGS_string ("$SUBKIND$"), GGS_string ("") COMMA_SOURCE_FILE_AT_LINE (405)) ;
    {
      GGS_stringlist::cEnumerator enumerator_17609 (var_cas_data_size, true) ;
      const GGS_stringlist::cElement * operand_17609 = NULL ;
      while (((operand_17609 = enumerator_17609.nextObject ()))) {
        macroValidPointer (operand_17609) ;
        var_cas_os_secs.dotAssign_operation (var_cas_os_const.reader_stringByReplacingStringByString (inLexique, GGS_string ("$SIZE$"), operand_17609->mValue COMMA_SOURCE_FILE_AT_LINE (407))) ;
      }
    }
    ::routine_doReplace (inLexique,  var_cas_mm,  GGS_string ("$OS_MEMMAP$"),  var_cas_os_secs COMMA_SOURCE_FILE_AT_LINE (410)) ;
    GGS_string var_cas_api_tpl = function_template_string_if_exist (inLexique, var_cas_cc, GGS_string ("api_section") COMMA_SOURCE_FILE_AT_LINE (413)) ;
    ::routine_doReplace (inLexique,  var_cas_mm,  GGS_string ("$API_MEMMAP$"),  var_cas_api_tpl COMMA_SOURCE_FILE_AT_LINE (414)) ;
    GGS_string var_cas_mm_file = (function_project_name (inLexique COMMA_SOURCE_FILE_AT_LINE (416))).operator_concat (GGS_string ("/MemMap.h")) ;
    const GGS_bool cond_18154 = (GGS_uint ::constructor_errorCount (inLexique COMMA_HERE)).operator_isEqual (GGS_uint (0U)) ;
    if (cond_18154.isBuiltAndTrue ()) {
      const GGS_bool cond_18093 = gOption_galgas_5F_cli_5F_options_verbose_5F_output.reader_value () ;
      if (cond_18093.isBuiltAndTrue ()) {
        inLexique.printMessage (((GGS_string ("creating ")).operator_concat (var_cas_mm_file)).operator_concat (GGS_string ("\n")) COMMA_SOURCE_FILE_AT_LINE (419)) ;
      }
      const GGS_string temp_18135 = var_cas_mm ;
      if (temp_18135.isBuilt ()) {
        temp_18135 (HERE)->method_makeDirectoryAndWriteToFile (inLexique, var_cas_mm_file COMMA_SOURCE_FILE_AT_LINE (421)) ;
      }
    }
  }
  #ifdef DEBUG_TRACE_ENABLED
    printf ("LEAVE routine_generate_memmap\n") ;
  #endif
}

//---------------------------------------------------------------------------*
//                                                                           *
//             Implementation of routine "generate_memmap_new"               *
//                                                                           *
//---------------------------------------------------------------------------*

void routine_generate_memmap_new (C_Compiler & inLexique,
                                const GGS_root_obj   var_cas_cpu,
                                const GGS_goilTemplateVariableMap   var_cas_cfg COMMA_UNUSED_LOCATION_ARGS) {
  #ifdef DEBUG_TRACE_ENABLED
    printf ("ENTER routine_generate_memmap_new at %s:%d\n", __FILE__, __LINE__) ;
  #endif
  GGS_string var_cas_cc = function_compiler (inLexique, var_cas_cpu.reader_os (inLexique COMMA_SOURCE_FILE_AT_LINE (433)).reader_memmap (inLexique COMMA_SOURCE_FILE_AT_LINE (433)) COMMA_SOURCE_FILE_AT_LINE (433)) ;
  const GGS_bool cond_18709 = (var_cas_cc).operator_isNotEqual (GGS_string ("")) ;
  if (cond_18709.isBuiltAndTrue ()) {
    GGS_string var_cas_mm = function_goil_template (inLexique, var_cas_cc, var_cas_cfg, GGS_string ("MemMap.h") COMMA_SOURCE_FILE_AT_LINE (435)) ;
    GGS_string var_cas_mm_file = (function_project_name (inLexique COMMA_SOURCE_FILE_AT_LINE (437))).operator_concat (GGS_string ("/MemMap.h")) ;
    const GGS_bool cond_18698 = (GGS_uint ::constructor_errorCount (inLexique COMMA_HERE)).operator_isEqual (GGS_uint (0U)) ;
    if (cond_18698.isBuiltAndTrue ()) {
      const GGS_bool cond_18637 = gOption_galgas_5F_cli_5F_options_verbose_5F_output.reader_value () ;
      if (cond_18637.isBuiltAndTrue ()) {
        inLexique.printMessage (((GGS_string ("creating ")).operator_concat (var_cas_mm_file)).operator_concat (GGS_string ("\n")) COMMA_SOURCE_FILE_AT_LINE (440)) ;
      }
      const GGS_string temp_18679 = var_cas_mm ;
      if (temp_18679.isBuilt ()) {
        temp_18679 (HERE)->method_makeDirectoryAndWriteToFile (inLexique, var_cas_mm_file COMMA_SOURCE_FILE_AT_LINE (442)) ;
      }
    }
  }
  #ifdef DEBUG_TRACE_ENABLED
    printf ("LEAVE routine_generate_memmap_new\n") ;
  #endif
}

//---------------------------------------------------------------------------*
//                                                                           *
//              Implementation of routine "generate_compiler"                *
//                                                                           *
//---------------------------------------------------------------------------*

void routine_generate_compiler (C_Compiler & inLexique,
                                const GGS_root_obj   var_cas_cpu COMMA_UNUSED_LOCATION_ARGS) {
  #ifdef DEBUG_TRACE_ENABLED
    printf ("ENTER routine_generate_compiler at %s:%d\n", __FILE__, __LINE__) ;
  #endif
  GGS_string var_cas_cc = function_compiler (inLexique, var_cas_cpu.reader_os (inLexique COMMA_SOURCE_FILE_AT_LINE (452)).reader_memmap (inLexique COMMA_SOURCE_FILE_AT_LINE (452)) COMMA_SOURCE_FILE_AT_LINE (452)) ;
  const GGS_bool cond_19569 = (var_cas_cc).operator_isNotEqual (GGS_string ("")) ;
  if (cond_19569.isBuiltAndTrue ()) {
    GGS_string var_cas_comp = function_template_string_if_exist (inLexique, var_cas_cc, GGS_string ("Compiler.h") COMMA_SOURCE_FILE_AT_LINE (454)) ;
    GGS_string var_cas_comp_cfg = function_template_string_if_exist (inLexique, var_cas_cc, GGS_string ("Compiler_Cfg.h") COMMA_SOURCE_FILE_AT_LINE (455)) ;
    GGS_string var_cas_comp_file = (function_project_name (inLexique COMMA_SOURCE_FILE_AT_LINE (456))).operator_concat (GGS_string ("/Compiler.h")) ;
    GGS_string var_cas_comp_cfg_file = (function_project_name (inLexique COMMA_SOURCE_FILE_AT_LINE (457))).operator_concat (GGS_string ("/Compiler_Cfg.h")) ;
    const GGS_bool cond_19559 = (GGS_uint ::constructor_errorCount (inLexique COMMA_HERE)).operator_isEqual (GGS_uint (0U)) ;
    if (cond_19559.isBuiltAndTrue ()) {
      const GGS_bool cond_19320 = gOption_galgas_5F_cli_5F_options_verbose_5F_output.reader_value () ;
      if (cond_19320.isBuiltAndTrue ()) {
        inLexique.printMessage (((GGS_string ("creating ")).operator_concat (var_cas_comp_file)).operator_concat (GGS_string ("\n")) COMMA_SOURCE_FILE_AT_LINE (461)) ;
      }
      const GGS_string temp_19364 = var_cas_comp ;
      if (temp_19364.isBuilt ()) {
        temp_19364 (HERE)->method_makeDirectoryAndWriteToFile (inLexique, var_cas_comp_file COMMA_SOURCE_FILE_AT_LINE (463)) ;
      }
      const GGS_bool cond_19486 = gOption_galgas_5F_cli_5F_options_verbose_5F_output.reader_value () ;
      if (cond_19486.isBuiltAndTrue ()) {
        inLexique.printMessage (((GGS_string ("creating ")).operator_concat (var_cas_comp_cfg_file)).operator_concat (GGS_string ("\n")) COMMA_SOURCE_FILE_AT_LINE (465)) ;
      }
      const GGS_string temp_19534 = var_cas_comp_cfg ;
      if (temp_19534.isBuilt ()) {
        temp_19534 (HERE)->method_makeDirectoryAndWriteToFile (inLexique, var_cas_comp_cfg_file COMMA_SOURCE_FILE_AT_LINE (467)) ;
      }
    }
  }
  #ifdef DEBUG_TRACE_ENABLED
    printf ("LEAVE routine_generate_compiler\n") ;
  #endif
}

//---------------------------------------------------------------------------*

