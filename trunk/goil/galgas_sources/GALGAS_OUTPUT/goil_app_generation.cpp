//---------------------------------------------------------------------------*
//                                                                           *
//                      File 'goil_app_generation.cpp'                       *
//                        Generated by version 1.9.7                         *
//                     december 17th, 2009, at 9h55'41"                      *
//                                                                           *
//---------------------------------------------------------------------------*

//--- START OF USER ZONE 1


//--- END OF USER ZONE 1

//---------------------------------------------------------------------------*

#include "version_libpm.h"
#if LIBPM_VERSION != 629
  #error "This file has been compiled with a version of GALGAS different than the version of libpm"
#endif

//---------------------------------------------------------------------------*

#include <typeinfo>
#include "utilities/MF_MemoryControl.h"
#include "files/C_TextFileWrite.h"
#include "galgas/C_galgas_CLI_Options.h"
#include "goil_app_generation.h"

//---------------------------------------------------------------------------*

#ifndef DO_NOT_GENERATE_CHECKINGS
  #define SOURCE_FILE_AT_LINE(line) "goil_app_generation.ggs", line
  #define COMMA_SOURCE_FILE_AT_LINE(line) , SOURCE_FILE_AT_LINE(line)
#else
  #define SOURCE_FILE_AT_LINE(line) 
  #define COMMA_SOURCE_FILE_AT_LINE(line) 
#endif


//--- START OF USER ZONE 2


//--- END OF USER ZONE 2

//---------------------------------------------------------------------------*
//                                                                           *
//               Implementation of routine "generate_vector"                 *
//                                                                           *
//---------------------------------------------------------------------------*

void routine_generate_vector (C_Compiler & inLexique,
                                GGS_string  var_cas_vec,
                                GGS_string & var_cas_res,
                                GGS_uint  & var_cas_byte_count COMMA_UNUSED_LOCATION_ARGS) {
  #ifdef DEBUG_TRACE_ENABLED
    printf ("ENTER routine_generate_vector at %s:%d\n", __FILE__, __LINE__) ;
  #endif
  var_cas_byte_count = var_cas_vec.reader_length ().divide_operation (inLexique, GGS_uint (8U) COMMA_SOURCE_FILE_AT_LINE (47)) ;
  const GGS_bool cond_1242 = (var_cas_vec.reader_length ().modulo_operation (inLexique, GGS_uint (8U) COMMA_SOURCE_FILE_AT_LINE (48))).operator_isNotEqual (GGS_uint (0U)) ;
  if (cond_1242.isBuiltAndTrue ()) {
    var_cas_byte_count.increment_operation (inLexique COMMA_SOURCE_FILE_AT_LINE (48)) ;
  }
  GGS_stringlist  var_cas_data = GGS_stringlist ::constructor_emptyList () ;
  GGS_uint  var_cas_i = GGS_uint (0U) ;
  GGS_uint  var_cas_start = GGS_uint (0U) ;
  GGS_uint _variant_1799 = var_cas_byte_count ;
  GGS_bool _condition_1799 (_variant_1799.isBuilt (), true) ;
  while (_condition_1799.isBuiltAndTrue ()) {
    _condition_1799 = (var_cas_i).operator_strictInf (var_cas_byte_count) ;
    if (_condition_1799.isBuiltAndTrue ()) {
      if (_variant_1799.uintValue () == 0) {
        inLexique.onTheFlyRunTimeError ("loop variant error" COMMA_SOURCE_FILE_AT_LINE (73)) ;
        _condition_1799 = GGS_bool (false) ;
      }else{
        _variant_1799.decrement_operation (inLexique COMMA_HERE) ;
        GGS_string var_cas_byte = var_cas_vec.reader_subString (var_cas_start, GGS_uint (8U)).reader_reversedString () ;
        GGS_uint  var_cas_bit_pos = GGS_uint (0U) ;
        GGS_uint  var_cas_val = GGS_uint (0U) ;
        GGS_uint _variant_1723 = GGS_uint (8U) ;
        GGS_bool _condition_1723 (_variant_1723.isBuilt (), true) ;
        while (_condition_1723.isBuiltAndTrue ()) {
          _condition_1723 = (var_cas_bit_pos).operator_strictInf (var_cas_byte.reader_length ()) ;
          if (_condition_1723.isBuiltAndTrue ()) {
            if (_variant_1723.uintValue () == 0) {
              inLexique.onTheFlyRunTimeError ("loop variant error" COMMA_SOURCE_FILE_AT_LINE (69)) ;
              _condition_1723 = GGS_bool (false) ;
            }else{
              _variant_1723.decrement_operation (inLexique COMMA_HERE) ;
              GGS_char var_cas_bit = var_cas_byte.reader_characterAtIndex (inLexique, var_cas_bit_pos COMMA_SOURCE_FILE_AT_LINE (63)) ;
              var_cas_val = var_cas_val.left_shift_operation (inLexique, GGS_uint (1U) COMMA_SOURCE_FILE_AT_LINE (64)) ;
              const GGS_bool cond_1692 = (var_cas_bit).operator_isEqual (GGS_char (TO_UNICODE ('1'))) ;
              if (cond_1692.isBuiltAndTrue ()) {
                var_cas_val.increment_operation (inLexique COMMA_SOURCE_FILE_AT_LINE (66)) ;
              }
              var_cas_bit_pos.increment_operation (inLexique COMMA_SOURCE_FILE_AT_LINE (68)) ;
            }
          }
        }
        var_cas_data.addAssign_operation (var_cas_val.reader_string (inLexique COMMA_SOURCE_FILE_AT_LINE (70))) ;
        var_cas_i.increment_operation (inLexique COMMA_SOURCE_FILE_AT_LINE (71)) ;
        var_cas_start = var_cas_start.add_operation (inLexique, GGS_uint (8U) COMMA_SOURCE_FILE_AT_LINE (72)) ;
      }
    }
  }
  var_cas_res = GGS_string::constructor_componentsJoinedByString (inLexique, var_cas_data, GGS_string (",") COMMA_HERE) ;
  #ifdef DEBUG_TRACE_ENABLED
    printf ("LEAVE routine_generate_vector\n") ;
  #endif
}

//---------------------------------------------------------------------------*
//                                                                           *
//                Implementation of routine "generate_apps"                  *
//                                                                           *
//---------------------------------------------------------------------------*

void routine_generate_apps (C_Compiler & inLexique,
                                GGS_app_map   var_cas_apps,
                                GGS_task_map   var_cas_tasks,
                                GGS_isr_map   var_cas_isrs,
                                GGS_alarm_map   var_cas_alarms,
                                GGS_resource_map   var_cas_rezs,
                                GGS_scheduletable_map   var_cas_sts,
                                GGS_counter_map   var_cas_cnts,
                                GGS_string & /* var_cas_head */,
                                GGS_string & var_cas_obj_head,
                                GGS_string & var_cas_imp COMMA_UNUSED_LOCATION_ARGS) {
  #ifdef DEBUG_TRACE_ENABLED
    printf ("ENTER routine_generate_apps at %s:%d\n", __FILE__, __LINE__) ;
  #endif
  GGS_string var_cas_res = GGS_string ("") ;
  GGS_stringlist  var_cas_app_list = GGS_stringlist ::constructor_emptyList () ;
  GGS_string var_cas_ids = GGS_string ("") ;
  ::routine_doReplace (inLexique,  var_cas_obj_head,  GGS_string ("$APP_COUNT$"),  var_cas_apps.reader_count ().reader_string (inLexique COMMA_SOURCE_FILE_AT_LINE (95)) COMMA_SOURCE_FILE_AT_LINE (95)) ;
  const GGS_bool cond_11220 = (var_cas_apps.reader_count ()).operator_strictSup (GGS_uint (0U)) ;
  if (cond_11220.isBuiltAndTrue ()) {
    GGS_tasks_by_type  var_cas_stasks = GGS_tasks_by_type ::constructor_emptySortedList () ;
    {
      GGS_task_map::cEnumerator enumerator_2569 (var_cas_tasks, true) ;
      const GGS_task_map::cElement * operand_2569 = NULL ;
      while (((operand_2569 = enumerator_2569.nextObject ()))) {
        macroValidPointer (operand_2569) ;
        const GGS_bool cond_2655 = (operand_2569->mInfo.task.reader_events (inLexique COMMA_SOURCE_FILE_AT_LINE (103)).reader_length ()).operator_strictSup (GGS_uint (0U)) ;
        if (cond_2655.isBuiltAndTrue ()) {
          var_cas_stasks.addAssign_operation (GGS_uint (0U), operand_2569->mKey.reader_string (inLexique COMMA_SOURCE_FILE_AT_LINE (104))) ;
        }else if (cond_2655.isBuiltAndFalse ()) {
          var_cas_stasks.addAssign_operation (GGS_uint (1U), operand_2569->mKey.reader_string (inLexique COMMA_SOURCE_FILE_AT_LINE (106))) ;
        }
      }
    }
    {
        GGS_uint var_cas_n (true, 0) ;
      GGS_app_map::cEnumerator enumerator_2736 (var_cas_apps, true) ;
      const GGS_app_map::cElement * operand_2736 = NULL ;
      while (((operand_2736 = enumerator_2736.nextObject ()))) {
        macroValidPointer (operand_2736) ;
        var_cas_app_list.addAssign_operation (((GGS_string ("&")).operator_concat (operand_2736->mKey.reader_string (inLexique COMMA_SOURCE_FILE_AT_LINE (112)))).operator_concat (GGS_string ("_app_access"))) ;
        var_cas_ids.appendCString ("#define ") ;
        var_cas_ids.dotAssign_operation (operand_2736->mKey.reader_string (inLexique COMMA_SOURCE_FILE_AT_LINE (113))) ;
        var_cas_ids.appendCString ("_id ") ;
        var_cas_ids.dotAssign_operation (var_cas_n.reader_string (inLexique COMMA_SOURCE_FILE_AT_LINE (113))) ;
        var_cas_ids.appendCString ("\n") ;
        var_cas_ids.appendCString ("CONST(ApplicationType, OS_APPL_CONST) ") ;
        var_cas_ids.dotAssign_operation (operand_2736->mKey.reader_string (inLexique COMMA_SOURCE_FILE_AT_LINE (114))) ;
        var_cas_ids.appendCString (" = ") ;
        var_cas_ids.dotAssign_operation (operand_2736->mKey.reader_string (inLexique COMMA_SOURCE_FILE_AT_LINE (114))) ;
        var_cas_ids.appendCString ("_id;\n") ;
        GGS_string var_cas_vectors = GGS_string ("") ;
        GGS_string var_cas_vec = GGS_string ("") ;
        GGS_string var_cas_init ;
        GGS_uint  var_cas_count ;
        GGS_string var_cas_tpl ;
        var_cas_tpl = function_template_string (inLexique, GGS_string ("code"), GGS_string ("app") COMMA_SOURCE_FILE_AT_LINE (121)) ;
        ::routine_doReplace (inLexique,  var_cas_tpl,  GGS_string ("$APP_NAME$"),  operand_2736->mKey.reader_string (inLexique COMMA_SOURCE_FILE_AT_LINE (123)) COMMA_SOURCE_FILE_AT_LINE (123)) ;
        {
          GGS_tasks_by_type::cEnumerator enumerator_3366 (var_cas_stasks, true) ;
          const GGS_tasks_by_type::cElement * operand_3366 = NULL ;
          while (((operand_3366 = enumerator_3366.nextObject ()))) {
            macroValidPointer (operand_3366) ;
            const GGS_bool cond_3469 = operand_2736->mInfo.app.reader_tasks (inLexique COMMA_SOURCE_FILE_AT_LINE (129)).reader_hasKey (operand_3366->name) ;
            if (cond_3469.isBuiltAndTrue ()) {
              var_cas_vec.appendCString ("11") ;
            }else if (cond_3469.isBuiltAndFalse ()) {
              var_cas_vec.appendCString ("0") ;
              GGS_task_obj  var_cas_t ;
              const GGS_task_map  temp_3555 = var_cas_tasks ;
              if (temp_3555.isBuilt ()) {
                temp_3555 (HERE)->method_get (inLexique, GGS_lstring ::constructor_new (inLexique, operand_3366->name, GGS_location (inLexique) COMMA_HERE), var_cas_t COMMA_SOURCE_FILE_AT_LINE (135)) ;
              }
              GGS_bool var_cas_found ;
              GGS_lstring  automatic_var_0 ;
              ::routine_is_in_lstringlist (inLexique,  var_cas_t.reader_acc_apps (inLexique COMMA_SOURCE_FILE_AT_LINE (137)),  operand_2736->mKey,  automatic_var_0,  var_cas_found COMMA_SOURCE_FILE_AT_LINE (137)) ;
              const GGS_bool cond_3713 = var_cas_found ;
              if (cond_3713.isBuiltAndTrue ()) {
                var_cas_vec.appendCString ("1") ;
              }else if (cond_3713.isBuiltAndFalse ()) {
                var_cas_vec.appendCString ("0") ;
              }
            }
          }
        }
        {
          GGS_isr_map::cEnumerator enumerator_3812 (var_cas_isrs, true) ;
          const GGS_isr_map::cElement * operand_3812 = NULL ;
          while (((operand_3812 = enumerator_3812.nextObject ()))) {
            macroValidPointer (operand_3812) ;
            const GGS_bool cond_3896 = operand_2736->mInfo.app.reader_isrs (inLexique COMMA_SOURCE_FILE_AT_LINE (144)).reader_hasKey (operand_3812->mKey.reader_string (inLexique COMMA_SOURCE_FILE_AT_LINE (144))) ;
            if (cond_3896.isBuiltAndTrue ()) {
              var_cas_vec.appendCString ("11") ;
            }else if (cond_3896.isBuiltAndFalse ()) {
              var_cas_vec.appendCString ("0") ;
              GGS_bool var_cas_found ;
              GGS_lstring  automatic_var_1 ;
              ::routine_is_in_lstringlist (inLexique,  operand_3812->mInfo.isr.reader_acc_apps (inLexique COMMA_SOURCE_FILE_AT_LINE (149)),  operand_2736->mKey,  automatic_var_1,  var_cas_found COMMA_SOURCE_FILE_AT_LINE (149)) ;
              const GGS_bool cond_4043 = var_cas_found ;
              if (cond_4043.isBuiltAndTrue ()) {
                var_cas_vec.appendCString ("1") ;
              }else if (cond_4043.isBuiltAndFalse ()) {
                var_cas_vec.appendCString ("0") ;
              }
            }
          }
        }
        var_cas_vec.appendCString ("01") ;
        ::routine_generate_vector (inLexique,  var_cas_vec,  var_cas_init,  var_cas_count COMMA_SOURCE_FILE_AT_LINE (158)) ;
        const GGS_bool cond_4515 = (var_cas_count).operator_strictSup (GGS_uint (0U)) ;
        if (cond_4515.isBuiltAndTrue ()) {
          var_cas_vectors.appendCString ("/* vector ") ;
          var_cas_vectors.dotAssign_operation (var_cas_vec) ;
          var_cas_vectors.appendCString (" */\n") ;
          var_cas_vectors.appendCString ("u8 ") ;
          var_cas_vectors.dotAssign_operation (operand_2736->mKey.reader_string (inLexique COMMA_SOURCE_FILE_AT_LINE (161))) ;
          var_cas_vectors.appendCString ("_procs_access[") ;
          var_cas_vectors.dotAssign_operation (var_cas_count.reader_string (inLexique COMMA_SOURCE_FILE_AT_LINE (161))) ;
          var_cas_vectors.appendCString ("] = {") ;
          var_cas_vectors.dotAssign_operation (var_cas_init) ;
          var_cas_vectors.appendCString ("};\n") ;
          ::routine_doReplace (inLexique,  var_cas_tpl,  GGS_string ("$PROC_ACCESS$"),  (operand_2736->mKey.reader_string (inLexique COMMA_SOURCE_FILE_AT_LINE (162))).operator_concat (GGS_string ("_procs_access")) COMMA_SOURCE_FILE_AT_LINE (162)) ;
        }else if (cond_4515.isBuiltAndFalse ()) {
          ::routine_doReplace (inLexique,  var_cas_tpl,  GGS_string ("$PROC_ACCESS$"),  GGS_string ("NULL") COMMA_SOURCE_FILE_AT_LINE (164)) ;
        }
        var_cas_vec = GGS_string ("") ;
        {
          GGS_alarm_map::cEnumerator enumerator_4701 (var_cas_alarms, true) ;
          const GGS_alarm_map::cElement * operand_4701 = NULL ;
          while (((operand_4701 = enumerator_4701.nextObject ()))) {
            macroValidPointer (operand_4701) ;
            const GGS_bool cond_4787 = operand_2736->mInfo.app.reader_alarms (inLexique COMMA_SOURCE_FILE_AT_LINE (170)).reader_hasKey (operand_4701->mKey.reader_string (inLexique COMMA_SOURCE_FILE_AT_LINE (170))) ;
            if (cond_4787.isBuiltAndTrue ()) {
              var_cas_vec.appendCString ("11") ;
            }else if (cond_4787.isBuiltAndFalse ()) {
              var_cas_vec.appendCString ("0") ;
              GGS_bool var_cas_found ;
              GGS_lstring  automatic_var_2 ;
              ::routine_is_in_lstringlist (inLexique,  operand_4701->mInfo.alarm.reader_acc_apps (inLexique COMMA_SOURCE_FILE_AT_LINE (175)),  operand_2736->mKey,  automatic_var_2,  var_cas_found COMMA_SOURCE_FILE_AT_LINE (175)) ;
              const GGS_bool cond_4936 = var_cas_found ;
              if (cond_4936.isBuiltAndTrue ()) {
                var_cas_vec.appendCString ("1") ;
              }else if (cond_4936.isBuiltAndFalse ()) {
                var_cas_vec.appendCString ("0") ;
              }
            }
          }
        }
        ::routine_generate_vector (inLexique,  var_cas_vec,  var_cas_init,  var_cas_count COMMA_SOURCE_FILE_AT_LINE (181)) ;
        const GGS_bool cond_5304 = (var_cas_count).operator_strictSup (GGS_uint (0U)) ;
        if (cond_5304.isBuiltAndTrue ()) {
          var_cas_vectors.appendCString ("/* vector ") ;
          var_cas_vectors.dotAssign_operation (var_cas_vec) ;
          var_cas_vectors.appendCString (" */\n") ;
          var_cas_vectors.appendCString ("u8 ") ;
          var_cas_vectors.dotAssign_operation (operand_2736->mKey.reader_string (inLexique COMMA_SOURCE_FILE_AT_LINE (184))) ;
          var_cas_vectors.appendCString ("_alarms_access[") ;
          var_cas_vectors.dotAssign_operation (var_cas_count.reader_string (inLexique COMMA_SOURCE_FILE_AT_LINE (184))) ;
          var_cas_vectors.appendCString ("] = {") ;
          var_cas_vectors.dotAssign_operation (var_cas_init) ;
          var_cas_vectors.appendCString ("};\n") ;
          ::routine_doReplace (inLexique,  var_cas_tpl,  GGS_string ("$ALARM_ACCESS$"),  (operand_2736->mKey.reader_string (inLexique COMMA_SOURCE_FILE_AT_LINE (185))).operator_concat (GGS_string ("_alarms_access")) COMMA_SOURCE_FILE_AT_LINE (185)) ;
        }else if (cond_5304.isBuiltAndFalse ()) {
          ::routine_doReplace (inLexique,  var_cas_tpl,  GGS_string ("$ALARM_ACCESS$"),  GGS_string ("NULL") COMMA_SOURCE_FILE_AT_LINE (187)) ;
        }
        var_cas_vec = GGS_string ("") ;
        {
          GGS_resource_map::cEnumerator enumerator_5493 (var_cas_rezs, true) ;
          const GGS_resource_map::cElement * operand_5493 = NULL ;
          while (((operand_5493 = enumerator_5493.nextObject ()))) {
            macroValidPointer (operand_5493) ;
            const GGS_bool cond_5582 = operand_2736->mInfo.app.reader_resources (inLexique COMMA_SOURCE_FILE_AT_LINE (194)).reader_hasKey (operand_5493->mKey.reader_string (inLexique COMMA_SOURCE_FILE_AT_LINE (194))) ;
            if (cond_5582.isBuiltAndTrue ()) {
              var_cas_vec.appendCString ("11") ;
            }else if (cond_5582.isBuiltAndFalse ()) {
              var_cas_vec.appendCString ("0") ;
              GGS_bool var_cas_found ;
              GGS_lstring  automatic_var_3 ;
              ::routine_is_in_lstringlist (inLexique,  operand_5493->mInfo.resource.reader_acc_apps (inLexique COMMA_SOURCE_FILE_AT_LINE (199)),  operand_2736->mKey,  automatic_var_3,  var_cas_found COMMA_SOURCE_FILE_AT_LINE (199)) ;
              const GGS_bool cond_5734 = var_cas_found ;
              if (cond_5734.isBuiltAndTrue ()) {
                var_cas_vec.appendCString ("1") ;
              }else if (cond_5734.isBuiltAndFalse ()) {
                var_cas_vec.appendCString ("0") ;
              }
            }
          }
        }
        var_cas_vec.appendCString ("10") ;
        ::routine_generate_vector (inLexique,  var_cas_vec,  var_cas_init,  var_cas_count COMMA_SOURCE_FILE_AT_LINE (209)) ;
        const GGS_bool cond_6144 = (var_cas_count).operator_strictSup (GGS_uint (0U)) ;
        if (cond_6144.isBuiltAndTrue ()) {
          var_cas_vectors.appendCString ("/* vector ") ;
          var_cas_vectors.dotAssign_operation (var_cas_vec) ;
          var_cas_vectors.appendCString (" */\n") ;
          var_cas_vectors.appendCString ("u8 ") ;
          var_cas_vectors.dotAssign_operation (operand_2736->mKey.reader_string (inLexique COMMA_SOURCE_FILE_AT_LINE (212))) ;
          var_cas_vectors.appendCString ("_rezs_access[") ;
          var_cas_vectors.dotAssign_operation (var_cas_count.reader_string (inLexique COMMA_SOURCE_FILE_AT_LINE (212))) ;
          var_cas_vectors.appendCString ("] = {") ;
          var_cas_vectors.dotAssign_operation (var_cas_init) ;
          var_cas_vectors.appendCString ("};\n") ;
          ::routine_doReplace (inLexique,  var_cas_tpl,  GGS_string ("$REZ_ACCESS$"),  (operand_2736->mKey.reader_string (inLexique COMMA_SOURCE_FILE_AT_LINE (213))).operator_concat (GGS_string ("_rezs_access")) COMMA_SOURCE_FILE_AT_LINE (213)) ;
        }else if (cond_6144.isBuiltAndFalse ()) {
          ::routine_doReplace (inLexique,  var_cas_tpl,  GGS_string ("$REZ_ACCESS$"),  GGS_string ("NULL") COMMA_SOURCE_FILE_AT_LINE (215)) ;
        }
        var_cas_vec = GGS_string ("") ;
        {
          GGS_scheduletable_map::cEnumerator enumerator_6336 (var_cas_sts, true) ;
          const GGS_scheduletable_map::cElement * operand_6336 = NULL ;
          while (((operand_6336 = enumerator_6336.nextObject ()))) {
            macroValidPointer (operand_6336) ;
            const GGS_bool cond_6427 = operand_2736->mInfo.app.reader_schedtables (inLexique COMMA_SOURCE_FILE_AT_LINE (222)).reader_hasKey (operand_6336->mKey.reader_string (inLexique COMMA_SOURCE_FILE_AT_LINE (222))) ;
            if (cond_6427.isBuiltAndTrue ()) {
              var_cas_vec.appendCString ("11") ;
            }else if (cond_6427.isBuiltAndFalse ()) {
              var_cas_vec.appendCString ("0") ;
              GGS_bool var_cas_found ;
              GGS_lstring  automatic_var_4 ;
              ::routine_is_in_lstringlist (inLexique,  operand_6336->mInfo.st.reader_acc_apps (inLexique COMMA_SOURCE_FILE_AT_LINE (227)),  operand_2736->mKey,  automatic_var_4,  var_cas_found COMMA_SOURCE_FILE_AT_LINE (227)) ;
              const GGS_bool cond_6573 = var_cas_found ;
              if (cond_6573.isBuiltAndTrue ()) {
                var_cas_vec.appendCString ("1") ;
              }else if (cond_6573.isBuiltAndFalse ()) {
                var_cas_vec.appendCString ("0") ;
              }
            }
          }
        }
        ::routine_generate_vector (inLexique,  var_cas_vec,  var_cas_init,  var_cas_count COMMA_SOURCE_FILE_AT_LINE (232)) ;
        const GGS_bool cond_6908 = (var_cas_count).operator_strictSup (GGS_uint (0U)) ;
        if (cond_6908.isBuiltAndTrue ()) {
          var_cas_vectors.appendCString ("/* vector ") ;
          var_cas_vectors.dotAssign_operation (var_cas_vec) ;
          var_cas_vectors.appendCString (" */\n") ;
          var_cas_vectors.appendCString ("u8 ") ;
          var_cas_vectors.dotAssign_operation (operand_2736->mKey.reader_string (inLexique COMMA_SOURCE_FILE_AT_LINE (235))) ;
          var_cas_vectors.appendCString ("_sts_access[") ;
          var_cas_vectors.dotAssign_operation (var_cas_count.reader_string (inLexique COMMA_SOURCE_FILE_AT_LINE (235))) ;
          var_cas_vectors.appendCString ("] = {") ;
          var_cas_vectors.dotAssign_operation (var_cas_init) ;
          var_cas_vectors.appendCString ("};\n") ;
          ::routine_doReplace (inLexique,  var_cas_tpl,  GGS_string ("$ST_ACCESS$"),  (operand_2736->mKey.reader_string (inLexique COMMA_SOURCE_FILE_AT_LINE (236))).operator_concat (GGS_string ("_sts_access")) COMMA_SOURCE_FILE_AT_LINE (236)) ;
        }else if (cond_6908.isBuiltAndFalse ()) {
          ::routine_doReplace (inLexique,  var_cas_tpl,  GGS_string ("$ST_ACCESS$"),  GGS_string ("NULL") COMMA_SOURCE_FILE_AT_LINE (238)) ;
        }
        var_cas_vec = GGS_string ("") ;
        {
          GGS_counter_map::cEnumerator enumerator_7093 (var_cas_cnts, true) ;
          const GGS_counter_map::cElement * operand_7093 = NULL ;
          while (((operand_7093 = enumerator_7093.nextObject ()))) {
            macroValidPointer (operand_7093) ;
            const GGS_bool cond_7181 = operand_2736->mInfo.app.reader_counters (inLexique COMMA_SOURCE_FILE_AT_LINE (245)).reader_hasKey (operand_7093->mKey.reader_string (inLexique COMMA_SOURCE_FILE_AT_LINE (245))) ;
            if (cond_7181.isBuiltAndTrue ()) {
              var_cas_vec.appendCString ("11") ;
            }else if (cond_7181.isBuiltAndFalse ()) {
              var_cas_vec.appendCString ("0") ;
              GGS_bool var_cas_found ;
              GGS_lstring  automatic_var_5 ;
              ::routine_is_in_lstringlist (inLexique,  operand_7093->mInfo.counter.reader_acc_apps (inLexique COMMA_SOURCE_FILE_AT_LINE (250)),  operand_2736->mKey,  automatic_var_5,  var_cas_found COMMA_SOURCE_FILE_AT_LINE (250)) ;
              const GGS_bool cond_7332 = var_cas_found ;
              if (cond_7332.isBuiltAndTrue ()) {
                var_cas_vec.appendCString ("1") ;
              }else if (cond_7332.isBuiltAndFalse ()) {
                var_cas_vec.appendCString ("0") ;
              }
            }
          }
        }
        ::routine_generate_vector (inLexique,  var_cas_vec,  var_cas_init,  var_cas_count COMMA_SOURCE_FILE_AT_LINE (255)) ;
        const GGS_bool cond_7670 = (var_cas_count).operator_strictSup (GGS_uint (0U)) ;
        if (cond_7670.isBuiltAndTrue ()) {
          var_cas_vectors.appendCString ("/* vector ") ;
          var_cas_vectors.dotAssign_operation (var_cas_vec) ;
          var_cas_vectors.appendCString (" */\n") ;
          var_cas_vectors.appendCString ("u8 ") ;
          var_cas_vectors.dotAssign_operation (operand_2736->mKey.reader_string (inLexique COMMA_SOURCE_FILE_AT_LINE (258))) ;
          var_cas_vectors.appendCString ("_cnts_access[") ;
          var_cas_vectors.dotAssign_operation (var_cas_count.reader_string (inLexique COMMA_SOURCE_FILE_AT_LINE (258))) ;
          var_cas_vectors.appendCString ("] = {") ;
          var_cas_vectors.dotAssign_operation (var_cas_init) ;
          var_cas_vectors.appendCString ("};\n") ;
          ::routine_doReplace (inLexique,  var_cas_tpl,  GGS_string ("$CNT_ACCESS$"),  (operand_2736->mKey.reader_string (inLexique COMMA_SOURCE_FILE_AT_LINE (259))).operator_concat (GGS_string ("_cnts_access")) COMMA_SOURCE_FILE_AT_LINE (259)) ;
        }else if (cond_7670.isBuiltAndFalse ()) {
          ::routine_doReplace (inLexique,  var_cas_tpl,  GGS_string ("$CNT_ACCESS$"),  GGS_string ("NULL") COMMA_SOURCE_FILE_AT_LINE (261)) ;
        }
        ::routine_doReplace (inLexique,  var_cas_tpl,  GGS_string ("$ACCESS_VEC$"),  var_cas_vectors COMMA_SOURCE_FILE_AT_LINE (264)) ;
        GGS_string var_cas_ownership_vec = GGS_string ("") ;
        GGS_lstringlist  var_cas_procs = (operand_2736->mInfo.app.reader_tasks (inLexique COMMA_SOURCE_FILE_AT_LINE (268)).reader_keyList (inLexique COMMA_SOURCE_FILE_AT_LINE (268))).operator_concat (operand_2736->mInfo.app.reader_isrs (inLexique COMMA_SOURCE_FILE_AT_LINE (268)).reader_keyList (inLexique COMMA_SOURCE_FILE_AT_LINE (268))) ;
        GGS_string var_cas_table = GGS_string ("") ;
        {
          GGS_lstringlist::cEnumerator enumerator_7960 (var_cas_procs, true) ;
          const GGS_lstringlist::cElement * operand_7960 = enumerator_7960.nextObject () ;
          if ((operand_7960 != NULL)) {
            var_cas_table = ((((GGS_string ("tpl_proc_id ")).operator_concat (operand_2736->mKey.reader_string (inLexique COMMA_SOURCE_FILE_AT_LINE (271)))).operator_concat (GGS_string ("_proc_own ["))).operator_concat (var_cas_procs.reader_length ().reader_string (inLexique COMMA_SOURCE_FILE_AT_LINE (271)))).operator_concat (GGS_string ("] = {")) ;
            bool _foreach_loop_7960 ;
            do{
              macroValidPointer (operand_7960) ;
              var_cas_table.dotAssign_operation (operand_7960->mValue.reader_string (inLexique COMMA_SOURCE_FILE_AT_LINE (272))) ;
              var_cas_table.appendCString ("_id") ;
              operand_7960 = enumerator_7960.nextObject () ;
              _foreach_loop_7960 = ((operand_7960 != NULL)) ;
              if (_foreach_loop_7960) {
                var_cas_table.appendCString (",") ;
              }
            }while (_foreach_loop_7960) ;
            var_cas_table.appendCString ("};\n") ;
          }
        }
        var_cas_ownership_vec.dotAssign_operation (var_cas_table) ;
        ::routine_doReplace (inLexique,  var_cas_tpl,  GGS_string ("$PROC_COUNT$"),  var_cas_procs.reader_length ().reader_string (inLexique COMMA_SOURCE_FILE_AT_LINE (277)) COMMA_SOURCE_FILE_AT_LINE (277)) ;
        const GGS_bool cond_8396 = (var_cas_table).operator_isNotEqual (GGS_string ("")) ;
        if (cond_8396.isBuiltAndTrue ()) {
          ::routine_doReplace (inLexique,  var_cas_tpl,  GGS_string ("$PROC_OWNERSHIP$"),  (operand_2736->mKey.reader_string (inLexique COMMA_SOURCE_FILE_AT_LINE (279))).operator_concat (GGS_string ("_proc_own")) COMMA_SOURCE_FILE_AT_LINE (279)) ;
        }else if (cond_8396.isBuiltAndFalse ()) {
          ::routine_doReplace (inLexique,  var_cas_tpl,  GGS_string ("$PROC_OWNERSHIP$"),  GGS_string ("NULL") COMMA_SOURCE_FILE_AT_LINE (281)) ;
        }
        var_cas_table = GGS_string ("") ;
        {
          GGS_ident_map::cEnumerator enumerator_8495 (operand_2736->mInfo.app.reader_alarms (inLexique COMMA_SOURCE_FILE_AT_LINE (285)), true) ;
          const GGS_ident_map::cElement * operand_8495 = enumerator_8495.nextObject () ;
          if ((operand_8495 != NULL)) {
            var_cas_table = ((((GGS_string ("tpl_alarm_id ")).operator_concat (operand_2736->mKey.reader_string (inLexique COMMA_SOURCE_FILE_AT_LINE (286)))).operator_concat (GGS_string ("_alarm_own ["))).operator_concat (operand_2736->mInfo.app.reader_alarms (inLexique COMMA_SOURCE_FILE_AT_LINE (286)).reader_count ().reader_string (inLexique COMMA_SOURCE_FILE_AT_LINE (286)))).operator_concat (GGS_string ("] = {")) ;
            bool _foreach_loop_8495 ;
            do{
              macroValidPointer (operand_8495) ;
              var_cas_table.dotAssign_operation (operand_8495->mKey.reader_string (inLexique COMMA_SOURCE_FILE_AT_LINE (287))) ;
              var_cas_table.appendCString ("_id") ;
              operand_8495 = enumerator_8495.nextObject () ;
              _foreach_loop_8495 = ((operand_8495 != NULL)) ;
              if (_foreach_loop_8495) {
                var_cas_table.appendCString (",") ;
              }
            }while (_foreach_loop_8495) ;
            var_cas_table.appendCString ("};\n") ;
          }
        }
        var_cas_ownership_vec.dotAssign_operation (var_cas_table) ;
        ::routine_doReplace (inLexique,  var_cas_tpl,  GGS_string ("$ALARM_COUNT$"),  operand_2736->mInfo.app.reader_alarms (inLexique COMMA_SOURCE_FILE_AT_LINE (292)).reader_count ().reader_string (inLexique COMMA_SOURCE_FILE_AT_LINE (292)) COMMA_SOURCE_FILE_AT_LINE (292)) ;
        const GGS_bool cond_8942 = (var_cas_table).operator_isNotEqual (GGS_string ("")) ;
        if (cond_8942.isBuiltAndTrue ()) {
          ::routine_doReplace (inLexique,  var_cas_tpl,  GGS_string ("$ALARM_OWNERSHIP$"),  (operand_2736->mKey.reader_string (inLexique COMMA_SOURCE_FILE_AT_LINE (294))).operator_concat (GGS_string ("_alarm_own")) COMMA_SOURCE_FILE_AT_LINE (294)) ;
        }else if (cond_8942.isBuiltAndFalse ()) {
          ::routine_doReplace (inLexique,  var_cas_tpl,  GGS_string ("$ALARM_OWNERSHIP$"),  GGS_string ("NULL") COMMA_SOURCE_FILE_AT_LINE (296)) ;
        }
        var_cas_table = GGS_string ("") ;
        {
          GGS_ident_map::cEnumerator enumerator_9042 (operand_2736->mInfo.app.reader_resources (inLexique COMMA_SOURCE_FILE_AT_LINE (300)), true) ;
          const GGS_ident_map::cElement * operand_9042 = enumerator_9042.nextObject () ;
          if ((operand_9042 != NULL)) {
            var_cas_table = ((((GGS_string ("tpl_resource_id ")).operator_concat (operand_2736->mKey.reader_string (inLexique COMMA_SOURCE_FILE_AT_LINE (301)))).operator_concat (GGS_string ("_rez_own ["))).operator_concat (operand_2736->mInfo.app.reader_resources (inLexique COMMA_SOURCE_FILE_AT_LINE (301)).reader_count ().reader_string (inLexique COMMA_SOURCE_FILE_AT_LINE (301)))).operator_concat (GGS_string ("] = {")) ;
            bool _foreach_loop_9042 ;
            do{
              macroValidPointer (operand_9042) ;
              var_cas_table.dotAssign_operation (operand_9042->mKey.reader_string (inLexique COMMA_SOURCE_FILE_AT_LINE (302))) ;
              var_cas_table.appendCString ("_id") ;
              operand_9042 = enumerator_9042.nextObject () ;
              _foreach_loop_9042 = ((operand_9042 != NULL)) ;
              if (_foreach_loop_9042) {
                var_cas_table.appendCString (",") ;
              }
            }while (_foreach_loop_9042) ;
            var_cas_table.appendCString ("};\n") ;
          }
        }
        var_cas_ownership_vec.dotAssign_operation (var_cas_table) ;
        ::routine_doReplace (inLexique,  var_cas_tpl,  GGS_string ("$REZ_COUNT$"),  operand_2736->mInfo.app.reader_resources (inLexique COMMA_SOURCE_FILE_AT_LINE (307)).reader_count ().reader_string (inLexique COMMA_SOURCE_FILE_AT_LINE (307)) COMMA_SOURCE_FILE_AT_LINE (307)) ;
        const GGS_bool cond_9493 = (var_cas_table).operator_isNotEqual (GGS_string ("")) ;
        if (cond_9493.isBuiltAndTrue ()) {
          ::routine_doReplace (inLexique,  var_cas_tpl,  GGS_string ("$REZ_OWNERSHIP$"),  (operand_2736->mKey.reader_string (inLexique COMMA_SOURCE_FILE_AT_LINE (309))).operator_concat (GGS_string ("_rez_own")) COMMA_SOURCE_FILE_AT_LINE (309)) ;
        }else if (cond_9493.isBuiltAndFalse ()) {
          ::routine_doReplace (inLexique,  var_cas_tpl,  GGS_string ("$REZ_OWNERSHIP$"),  GGS_string ("NULL") COMMA_SOURCE_FILE_AT_LINE (311)) ;
        }
        var_cas_table = GGS_string ("") ;
        {
          GGS_ident_map::cEnumerator enumerator_9591 (operand_2736->mInfo.app.reader_schedtables (inLexique COMMA_SOURCE_FILE_AT_LINE (315)), true) ;
          const GGS_ident_map::cElement * operand_9591 = enumerator_9591.nextObject () ;
          if ((operand_9591 != NULL)) {
            var_cas_table = ((((GGS_string ("tpl_schedtable_id ")).operator_concat (operand_2736->mKey.reader_string (inLexique COMMA_SOURCE_FILE_AT_LINE (316)))).operator_concat (GGS_string ("_st_own ["))).operator_concat (operand_2736->mInfo.app.reader_schedtables (inLexique COMMA_SOURCE_FILE_AT_LINE (316)).reader_count ().reader_string (inLexique COMMA_SOURCE_FILE_AT_LINE (316)))).operator_concat (GGS_string ("] = {")) ;
            bool _foreach_loop_9591 ;
            do{
              macroValidPointer (operand_9591) ;
              var_cas_table.dotAssign_operation (operand_9591->mKey.reader_string (inLexique COMMA_SOURCE_FILE_AT_LINE (317))) ;
              var_cas_table.appendCString ("_id") ;
              operand_9591 = enumerator_9591.nextObject () ;
              _foreach_loop_9591 = ((operand_9591 != NULL)) ;
              if (_foreach_loop_9591) {
                var_cas_table.appendCString (",") ;
              }
            }while (_foreach_loop_9591) ;
            var_cas_table.appendCString ("};\n") ;
          }
        }
        var_cas_ownership_vec.dotAssign_operation (var_cas_table) ;
        ::routine_doReplace (inLexique,  var_cas_tpl,  GGS_string ("$ST_COUNT$"),  operand_2736->mInfo.app.reader_schedtables (inLexique COMMA_SOURCE_FILE_AT_LINE (322)).reader_count ().reader_string (inLexique COMMA_SOURCE_FILE_AT_LINE (322)) COMMA_SOURCE_FILE_AT_LINE (322)) ;
        const GGS_bool cond_10046 = (var_cas_table).operator_isNotEqual (GGS_string ("")) ;
        if (cond_10046.isBuiltAndTrue ()) {
          ::routine_doReplace (inLexique,  var_cas_tpl,  GGS_string ("$ST_OWNERSHIP$"),  (operand_2736->mKey.reader_string (inLexique COMMA_SOURCE_FILE_AT_LINE (324))).operator_concat (GGS_string ("_st_own")) COMMA_SOURCE_FILE_AT_LINE (324)) ;
        }else if (cond_10046.isBuiltAndFalse ()) {
          ::routine_doReplace (inLexique,  var_cas_tpl,  GGS_string ("$ST_OWNERSHIP$"),  GGS_string ("NULL") COMMA_SOURCE_FILE_AT_LINE (326)) ;
        }
        var_cas_table = GGS_string ("") ;
        {
          GGS_ident_map::cEnumerator enumerator_10143 (operand_2736->mInfo.app.reader_counters (inLexique COMMA_SOURCE_FILE_AT_LINE (330)), true) ;
          const GGS_ident_map::cElement * operand_10143 = enumerator_10143.nextObject () ;
          if ((operand_10143 != NULL)) {
            var_cas_table = ((((GGS_string ("tpl_counter_id ")).operator_concat (operand_2736->mKey.reader_string (inLexique COMMA_SOURCE_FILE_AT_LINE (331)))).operator_concat (GGS_string ("_cnt_own ["))).operator_concat (operand_2736->mInfo.app.reader_counters (inLexique COMMA_SOURCE_FILE_AT_LINE (331)).reader_count ().reader_string (inLexique COMMA_SOURCE_FILE_AT_LINE (331)))).operator_concat (GGS_string ("] = {")) ;
            bool _foreach_loop_10143 ;
            do{
              macroValidPointer (operand_10143) ;
              var_cas_table.dotAssign_operation (operand_10143->mKey.reader_string (inLexique COMMA_SOURCE_FILE_AT_LINE (332))) ;
              var_cas_table.appendCString ("_id") ;
              operand_10143 = enumerator_10143.nextObject () ;
              _foreach_loop_10143 = ((operand_10143 != NULL)) ;
              if (_foreach_loop_10143) {
                var_cas_table.appendCString (",") ;
              }
            }while (_foreach_loop_10143) ;
            var_cas_table.appendCString ("};\n") ;
          }
        }
        var_cas_ownership_vec.dotAssign_operation (var_cas_table) ;
        ::routine_doReplace (inLexique,  var_cas_tpl,  GGS_string ("$CNT_COUNT$"),  operand_2736->mInfo.app.reader_counters (inLexique COMMA_SOURCE_FILE_AT_LINE (337)).reader_count ().reader_string (inLexique COMMA_SOURCE_FILE_AT_LINE (337)) COMMA_SOURCE_FILE_AT_LINE (337)) ;
        const GGS_bool cond_10590 = (var_cas_table).operator_isNotEqual (GGS_string ("")) ;
        if (cond_10590.isBuiltAndTrue ()) {
          ::routine_doReplace (inLexique,  var_cas_tpl,  GGS_string ("$CNT_OWNERSHIP$"),  (operand_2736->mKey.reader_string (inLexique COMMA_SOURCE_FILE_AT_LINE (339))).operator_concat (GGS_string ("_cnt_own")) COMMA_SOURCE_FILE_AT_LINE (339)) ;
        }else if (cond_10590.isBuiltAndFalse ()) {
          ::routine_doReplace (inLexique,  var_cas_tpl,  GGS_string ("$CNT_OWNERSHIP$"),  GGS_string ("NULL") COMMA_SOURCE_FILE_AT_LINE (341)) ;
        }
        { const GGS_basic_type _var_10904 = operand_2736->mInfo.app.reader_restart (inLexique COMMA_SOURCE_FILE_AT_LINE (347)) ; // CAST instruction
          if (_var_10904.getPtr () != NULL) {
            macroValidPointer (_var_10904.getPtr ()) ;
            if (typeid (cPtr_string_class) == typeid (* (_var_10904.getPtr ()))) {
              const GGS_string_class var_cas_rst (_var_10904.getPtr ()) ;
              ::routine_doReplace (inLexique,  var_cas_tpl,  GGS_string ("$RESTART$"),  (var_cas_rst.reader_value (inLexique COMMA_SOURCE_FILE_AT_LINE (349))).operator_concat (GGS_string ("_id")) COMMA_SOURCE_FILE_AT_LINE (349)) ;
            }else{
              ::routine_doReplace (inLexique,  var_cas_tpl,  GGS_string ("$RESTART$"),  GGS_string ("INVALID_TASK_ID") COMMA_SOURCE_FILE_AT_LINE (351)) ;
            }
          }
        }
        ::routine_doReplace (inLexique,  var_cas_tpl,  GGS_string ("$OWNERSHIP_VEC$"),  var_cas_ownership_vec COMMA_SOURCE_FILE_AT_LINE (354)) ;
        var_cas_res.dotAssign_operation (var_cas_tpl) ;
        var_cas_n.mValue ++ ;
      }
    }
    var_cas_res.appendCString ("CONSTP2CONST(tpl_app_access, AUTOMATIC, OS_APPL_CONST) tpl_app_table[APP_COUNT] = {\n") ;
    var_cas_res.appendCString ("  ") ;
    var_cas_res.dotAssign_operation (GGS_string::constructor_componentsJoinedByString (inLexique, var_cas_app_list, GGS_string (",\n"
      "  ") COMMA_HERE)) ;
    var_cas_res.appendCString ("\n"
      "};\n") ;
  }
  ::routine_doReplace (inLexique,  var_cas_imp,  GGS_string ("$OSAPPLICATIONS$"),  var_cas_res COMMA_SOURCE_FILE_AT_LINE (366)) ;
  ::routine_doReplace (inLexique,  var_cas_imp,  GGS_string ("$OSAPPIDS$"),  var_cas_ids COMMA_SOURCE_FILE_AT_LINE (367)) ;
  #ifdef DEBUG_TRACE_ENABLED
    printf ("LEAVE routine_generate_apps\n") ;
  #endif
}

//---------------------------------------------------------------------------*
//                                                                           *
//          Implementation of routine "generate_trusted_functions"           *
//                                                                           *
//---------------------------------------------------------------------------*

void routine_generate_trusted_functions (C_Compiler & inLexique,
                                GGS_app_map   var_cas_apps,
                                GGS_string & /* var_cas_head */,
                                GGS_string & var_cas_obj_head,
                                GGS_string & var_cas_imp COMMA_UNUSED_LOCATION_ARGS) {
  #ifdef DEBUG_TRACE_ENABLED
    printf ("ENTER routine_generate_trusted_functions at %s:%d\n", __FILE__, __LINE__) ;
  #endif
  GGS_stringset  var_cas_tfs = GGS_stringset ::constructor_emptySet () ;
  {
    GGS_app_map::cEnumerator enumerator_11629 (var_cas_apps, true) ;
    const GGS_app_map::cElement * operand_11629 = NULL ;
    while (((operand_11629 = enumerator_11629.nextObject ()))) {
      macroValidPointer (operand_11629) ;
      { const GGS_app_trusted_obj _var_11791 = operand_11629->mInfo.app.reader_trusted (inLexique COMMA_SOURCE_FILE_AT_LINE (384)) ; // CAST instruction
        if (_var_11791.getPtr () != NULL) {
          macroValidPointer (_var_11791.getPtr ()) ;
          if (typeid (cPtr_app_trusted_true) == typeid (* (_var_11791.getPtr ()))) {
            const GGS_app_trusted_true var_cas_t (_var_11791.getPtr ()) ;
            {
              GGS_stringset::cEnumerator enumerator_11708 (var_cas_t.reader_trusted_fcts (inLexique COMMA_SOURCE_FILE_AT_LINE (386)), true) ;
              while (enumerator_11708.hasCurrentObject ()) {
                var_cas_tfs.addAssign_operation (enumerator_11708._key (HERE)) ;
                enumerator_11708.next () ;
              }
            }
          }else{
          }
        }
      }
    }
  }
  GGS_string var_cas_fcts = GGS_string ("") ;
  GGS_string var_cas_fct_ids = GGS_string ("") ;
  GGS_string var_cas_fct_table = GGS_string ("") ;
  GGS_uint  var_cas_tf_id = GGS_uint (0U) ;
  {
    GGS_stringset::cEnumerator enumerator_11928 (var_cas_tfs, true) ;
    if (enumerator_11928 .hasCurrentObject ()) {
      var_cas_fct_table = GGS_string ("CONST(tpl_trusted_fct, OS_APPL_CODE)\n") ;
      var_cas_fct_table.appendCString ("  tpl_trusted_fct_table[TRUSTED_FCT_COUNT] = {\n") ;
      bool _foreach_loop_11928 ;
      do{
        var_cas_fcts.appendCString ("FUNC(void, OS_APPL_CODE) TRUSTED_") ;
        var_cas_fcts.dotAssign_operation (enumerator_11928._key (HERE)) ;
        var_cas_fcts.appendCString ("(\n") ;
        var_cas_fcts.appendCString ("  CONST(TrustedFunctionIndexType, AUTOMATIC) idx,\n") ;
        var_cas_fcts.appendCString ("  CONST(TrustedFunctionParameterRefType, AUTOMATIC) params);\n") ;
        var_cas_fct_ids.appendCString ("#define ") ;
        var_cas_fct_ids.dotAssign_operation (enumerator_11928._key (HERE)) ;
        var_cas_fct_ids.appendCString ("_id    ") ;
        var_cas_fct_ids.dotAssign_operation (var_cas_tf_id.reader_string (inLexique COMMA_SOURCE_FILE_AT_LINE (405))) ;
        var_cas_fct_ids.appendCString ("\n") ;
        var_cas_fct_ids.appendCString ("CONST(TrustedFunctionIndexType, AUTOMATIC) ") ;
        var_cas_fct_ids.dotAssign_operation (enumerator_11928._key (HERE)) ;
        var_cas_fct_ids.appendCString (" = ") ;
        var_cas_fct_ids.dotAssign_operation (enumerator_11928._key (HERE)) ;
        var_cas_fct_ids.appendCString ("_id;\n") ;
        var_cas_fct_table.appendCString ("  TRUSTED_") ;
        var_cas_fct_table.dotAssign_operation (enumerator_11928._key (HERE)) ;
        var_cas_tf_id.increment_operation (inLexique COMMA_SOURCE_FILE_AT_LINE (408)) ;
        enumerator_11928.next () ;
        _foreach_loop_11928 = (enumerator_11928 .hasCurrentObject ()) ;
        if (_foreach_loop_11928) {
          var_cas_fct_table.appendCString (",\n") ;
        }
      }while (_foreach_loop_11928) ;
      var_cas_fct_table.appendCString ("\n"
        "};\n") ;
    }
  }
  ::routine_doReplace (inLexique,  var_cas_imp,  GGS_string ("$TRUSTED_IDS$"),  var_cas_fct_ids COMMA_SOURCE_FILE_AT_LINE (415)) ;
  ::routine_doReplace (inLexique,  var_cas_imp,  GGS_string ("$TRUSTED_FCTS$"),  var_cas_fcts COMMA_SOURCE_FILE_AT_LINE (416)) ;
  ::routine_doReplace (inLexique,  var_cas_imp,  GGS_string ("$TRUSTED_TABLE$"),  var_cas_fct_table COMMA_SOURCE_FILE_AT_LINE (417)) ;
  ::routine_doReplace (inLexique,  var_cas_obj_head,  GGS_string ("$TRUSTED_FCT_COUNT$"),  var_cas_tf_id.reader_string (inLexique COMMA_SOURCE_FILE_AT_LINE (418)) COMMA_SOURCE_FILE_AT_LINE (418)) ;
  #ifdef DEBUG_TRACE_ENABLED
    printf ("LEAVE routine_generate_trusted_functions\n") ;
  #endif
}

//---------------------------------------------------------------------------*

