//---------------------------------------------------------------------------*
//                                                                           *
//                          File 'isrs_verif.cpp'                            *
//                    Generated by version version 2.1.0                     *
//                     november 18th, 2010, at 7h24'7"                       *
//                                                                           *
//---------------------------------------------------------------------------*

//--- START OF USER ZONE 1


//--- END OF USER ZONE 1

#include "version_libpm.h"
#if CURRENT_LIBPM_VERSION != 909
  #error "This file has been compiled with a version of GALGAS that uses libpm version 909, different than the current version (CURRENT_LIBPM_VERSION) of libpm"
#endif

//---------------------------------------------------------------------------*

#include "isrs_verif.h"
#include "galgas2/C_Compiler.h"
#include "galgas2/C_galgas_CLI_Options.h"

//---------------------------------------------------------------------------*

#include "goil_options.h"

//---------------------------------------------------------------------------*

#ifndef DO_NOT_GENERATE_CHECKINGS
  #define SOURCE_FILE_AT_LINE(line) "isrs_verif.gSemantics", line
  #define COMMA_SOURCE_FILE_AT_LINE(line) , SOURCE_FILE_AT_LINE(line)
#else
  #define SOURCE_FILE_AT_LINE(line) 
  #define COMMA_SOURCE_FILE_AT_LINE(line) 
#endif

//---------------------------------------------------------------------------*
//                                                                           *
//                        Routine 'isrs_well_formed'                         *
//                                                                           *
//---------------------------------------------------------------------------*

void routine_isrs_5F_well_5F_formed (const GALGAS_isr_5F_map constinArgument_isrs,
                                     C_Compiler * inCompiler
                                     COMMA_UNUSED_LOCATION_ARGS) {
  //-------- @foreachInstructionForGeneration
  cEnumerator_isr_5F_map enumerator_752 (constinArgument_isrs, true) ;
  //--- simple foreach instruction
  while (enumerator_752.hasCurrentObject ()) {
    //-------- @structuredCastInstructionForGeneration
    if (enumerator_752.current_isr (HERE).reader_category (SOURCE_FILE_AT_LINE (46)).isValid ()) {
      if (enumerator_752.current_isr (HERE).reader_category (SOURCE_FILE_AT_LINE (46)).dynamicTypeDescriptor () == & kTypeDescriptor_GALGAS_void) {
        //-------- @errorInstructionForGeneration
        GALGAS_location location_0 (enumerator_752.current_lkey (HERE).reader_location (HERE)) ; // Implicit use of 'location' reader
        inCompiler->emitSemanticError (location_0, GALGAS_string ("CATEGORY attribute undefined for ISR ").operator_concat (enumerator_752.current_lkey (HERE).reader_string (SOURCE_FILE_AT_LINE (48)) COMMA_SOURCE_FILE_AT_LINE (48)) COMMA_SOURCE_FILE_AT_LINE (48)) ;
      }
    }
    //-------- @structuredCastInstructionForGeneration
    if (enumerator_752.current_isr (HERE).reader_priority (SOURCE_FILE_AT_LINE (52)).isValid ()) {
      if (enumerator_752.current_isr (HERE).reader_priority (SOURCE_FILE_AT_LINE (52)).dynamicTypeDescriptor () == & kTypeDescriptor_GALGAS_void) {
        //-------- @errorInstructionForGeneration
        GALGAS_location location_1 (enumerator_752.current_lkey (HERE).reader_location (HERE)) ; // Implicit use of 'location' reader
        inCompiler->emitSemanticError (location_1, GALGAS_string ("PRIORITY attribute undefined for ISR ").operator_concat (enumerator_752.current_lkey (HERE).reader_string (SOURCE_FILE_AT_LINE (54)) COMMA_SOURCE_FILE_AT_LINE (54)) COMMA_SOURCE_FILE_AT_LINE (54)) ;
      }
    }
    enumerator_752.gotoNextObject () ;
  }
}


//--- START OF USER ZONE 2


//--- END OF USER ZONE 2


