//---------------------------------------------------------------------------*
//                                                                           *
//                        File 'xml_containers.cpp'                          *
//                 Generated by version GALGAS_BETA_VERSION                  *
//                      june 12th, 2009, at 14h44'51"                        *
//                                                                           *
//---------------------------------------------------------------------------*

//--- START OF USER ZONE 1


//--- END OF USER ZONE 1

//---------------------------------------------------------------------------*

#include "version_libpm.h"
#if LIBPM_VERSION != 502
  #error "This file has been compiled with a version of GALGAS different than the version of libpm"
#endif

//---------------------------------------------------------------------------*

#include <typeinfo>
#include "utilities/MF_MemoryControl.h"
#include "files/C_TextFileWrite.h"
#include "xml_containers.h"

//---------------------------------------------------------------------------*

#ifndef DO_NOT_GENERATE_CHECKINGS
  #define SOURCE_FILE_AT_LINE(line) "xml_containers.ggs", line
  #define COMMA_SOURCE_FILE_AT_LINE(line) , SOURCE_FILE_AT_LINE(line)
#else
  #define SOURCE_FILE_AT_LINE(line) 
  #define COMMA_SOURCE_FILE_AT_LINE(line) 
#endif


//--- START OF USER ZONE 2


//--- END OF USER ZONE 2

//---------------------------------------------------------------------------*
//                                                                           *
//               Implementation of routine "parse_container"                 *
//                                                                           *
//---------------------------------------------------------------------------*

void routine_parse_container (C_Compiler & inLexique,
                                const GGS_xmlNodeList   var_cas_cont_elems,
                                GGS_root_obj  & var_cas_cpu COMMA_UNUSED_LOCATION_ARGS) {
  #ifdef DEBUG_TRACE_ENABLED
    printf ("ENTER routine_parse_container at %s:%d\n", __FILE__, __LINE__) ;
  #endif
  GGS_lstring  var_cas_emptyString ;
  var_cas_emptyString = GGS_lstring ::constructor_new (inLexique, GGS_string (""), GGS_location (inLexique) COMMA_HERE) ;
  GGS_lstring  var_cas_elem ;
  var_cas_elem = var_cas_emptyString ;
  GGS_lstring  var_cas_name ;
  var_cas_name = var_cas_emptyString ;
  {
    GGS_xmlNodeList::cEnumerator enumerator_864 (var_cas_cont_elems, true) ;
    const GGS_xmlNodeList::cElement * operand_864 = NULL ;
    while (((operand_864 = enumerator_864.nextObject ()))) {
      macroValidPointer (operand_864) ;
      GGS_lstring  var_cas_lelem ;
      var_cas_lelem = function_long_name (inLexique, operand_864->node COMMA_SOURCE_FILE_AT_LINE (40)) ;
      GGS_lstring  var_cas_lname ;
      var_cas_lname = function_short_name (inLexique, operand_864->node COMMA_SOURCE_FILE_AT_LINE (41)) ;
      if (((var_cas_lelem.reader_string (inLexique COMMA_SOURCE_FILE_AT_LINE (42))).operator_isNotEqual (GGS_string (""))).isBuiltAndTrue ()) {
        var_cas_elem = var_cas_lelem ;
      }
      if (((var_cas_lname.reader_string (inLexique COMMA_SOURCE_FILE_AT_LINE (45))).operator_isNotEqual (GGS_string (""))).isBuiltAndTrue ()) {
        var_cas_name = var_cas_lname ;
      }
    }
  }
  if (((var_cas_elem.reader_string (inLexique COMMA_SOURCE_FILE_AT_LINE (50))).operator_isEqual (GGS_string ("OsOS"))).isBuiltAndTrue ()) {
    ::routine_parse_osos (inLexique,  var_cas_cont_elems,  var_cas_cpu COMMA_SOURCE_FILE_AT_LINE (51)) ;
  }else if (((var_cas_elem.reader_string (inLexique COMMA_SOURCE_FILE_AT_LINE (52))).operator_isEqual (GGS_string ("OsResource"))).isBuiltAndTrue ()) {
    ::routine_parse_resource (inLexique,  var_cas_name,  var_cas_cont_elems,  var_cas_cpu COMMA_SOURCE_FILE_AT_LINE (53)) ;
  }else if (((var_cas_elem.reader_string (inLexique COMMA_SOURCE_FILE_AT_LINE (54))).operator_isEqual (GGS_string ("OsScheduleTable"))).isBuiltAndTrue ()) {
    ::routine_parse_schedtable (inLexique,  var_cas_name,  var_cas_cont_elems,  var_cas_cpu COMMA_SOURCE_FILE_AT_LINE (55)) ;
  }else if (((var_cas_elem.reader_string (inLexique COMMA_SOURCE_FILE_AT_LINE (56))).operator_isEqual (GGS_string ("OsTask"))).isBuiltAndTrue ()) {
    ::routine_parse_task (inLexique,  var_cas_name,  var_cas_cont_elems,  var_cas_cpu COMMA_SOURCE_FILE_AT_LINE (57)) ;
  }
  #ifdef DEBUG_TRACE_ENABLED
    printf ("LEAVE routine_parse_container\n") ;
  #endif
}

//---------------------------------------------------------------------------*

