//---------------------------------------------------------------------------*
//                                                                           *
//                         File 'goil_routines.cpp'                          *
//                        Generated by version 2.5.4                         *
//                     january 16th, 2014, at 12h12'52"                      *
//                                                                           *
//---------------------------------------------------------------------------*

//--- START OF USER ZONE 1


//--- END OF USER ZONE 1

#include "goil_routines.h"
#include "galgas2/C_Compiler.h"
#include "galgas2/C_galgas_io.h"
#include "galgas2/C_galgas_CLI_Options.h"
#include "utilities/C_PrologueEpilogue.h"

//---------------------------------------------------------------------------*

#include "goil_options.h"

//---------------------------------------------------------------------------*

#ifndef DO_NOT_GENERATE_CHECKINGS
  #define SOURCE_FILE_AT_LINE(line) "goil_routines.gSemantics", line
  #define COMMA_SOURCE_FILE_AT_LINE(line) , SOURCE_FILE_AT_LINE(line)
#else
  #define SOURCE_FILE_AT_LINE(line) 
  #define COMMA_SOURCE_FILE_AT_LINE(line) 
#endif

//---------------------------------------------------------------------------*
//                                                                           *
//                          Function 'projectName'                           *
//                                                                           *
//---------------------------------------------------------------------------*

GALGAS_string function_projectName (C_Compiler * inCompiler
                                    COMMA_UNUSED_LOCATION_ARGS) {
  GALGAS_string result_directory ; // Returned variable
  result_directory = GALGAS_string::constructor_stringWithSourceFilePath (inCompiler COMMA_SOURCE_FILE_AT_LINE (8)).reader_stringByDeletingPathExtension (SOURCE_FILE_AT_LINE (8)) ;
  const enumGalgasBool test_0 = GALGAS_bool (kIsNotEqual, GALGAS_string (gOption_goil_5F_options_project_5F_dir.reader_value ()).objectCompare (GALGAS_string::makeEmptyString ())).boolEnum () ;
  if (kBoolTrue == test_0) {
    result_directory = GALGAS_string (gOption_goil_5F_options_project_5F_dir.reader_value ()) ;
  }
//---
  return result_directory ;
}


//---------------------------------------------------------------------------*
//  Function introspection                                                   *
//---------------------------------------------------------------------------*

static const C_galgas_type_descriptor * functionArgs_projectName [1] = {
  NULL
} ;

//---------------------------------------------------------------------------*

static GALGAS_object functionWithGenericHeader_projectName (C_Compiler * inCompiler,
                                                            const cObjectArray & /* inEffectiveParameterArray */,
                                                            const GALGAS_location & /* inErrorLocation */
                                                            COMMA_LOCATION_ARGS) {
  return function_projectName (inCompiler COMMA_THERE).reader_object (THERE) ;
}

//---------------------------------------------------------------------------*

C_galgas_function_descriptor functionDescriptor_projectName ("projectName",
                                                             functionWithGenericHeader_projectName,
                                                             & kTypeDescriptor_GALGAS_string,
                                                             0,
                                                             functionArgs_projectName) ;

//---------------------------------------------------------------------------*
//                                                                           *
//                            Function 'oil_dir'                             *
//                                                                           *
//---------------------------------------------------------------------------*

GALGAS_string function_oil_5F_dir (C_Compiler * inCompiler
                                   COMMA_UNUSED_LOCATION_ARGS) {
  GALGAS_string result_dir ; // Returned variable
  result_dir = GALGAS_string::constructor_stringWithSourceFilePath (inCompiler COMMA_SOURCE_FILE_AT_LINE (15)).reader_stringByDeletingLastPathComponent (SOURCE_FILE_AT_LINE (15)) ;
//---
  return result_dir ;
}


//---------------------------------------------------------------------------*
//  Function introspection                                                   *
//---------------------------------------------------------------------------*

static const C_galgas_type_descriptor * functionArgs_oil_5F_dir [1] = {
  NULL
} ;

//---------------------------------------------------------------------------*

static GALGAS_object functionWithGenericHeader_oil_5F_dir (C_Compiler * inCompiler,
                                                           const cObjectArray & /* inEffectiveParameterArray */,
                                                           const GALGAS_location & /* inErrorLocation */
                                                           COMMA_LOCATION_ARGS) {
  return function_oil_5F_dir (inCompiler COMMA_THERE).reader_object (THERE) ;
}

//---------------------------------------------------------------------------*

C_galgas_function_descriptor functionDescriptor_oil_5F_dir ("oil_dir",
                                                            functionWithGenericHeader_oil_5F_dir,
                                                            & kTypeDescriptor_GALGAS_string,
                                                            0,
                                                            functionArgs_oil_5F_dir) ;

//---------------------------------------------------------------------------*
//                                                                           *
//                              Function 'arch'                              *
//                                                                           *
//---------------------------------------------------------------------------*

GALGAS_string function_arch (C_Compiler * inCompiler
                             COMMA_UNUSED_LOCATION_ARGS) {
  GALGAS_string result_arch_5F_name ; // Returned variable
  GALGAS_stringlist var_components = GALGAS_string (gOption_goil_5F_options_target_5F_platform.reader_value ()).reader_componentsSeparatedByString (GALGAS_string ("/") COMMA_SOURCE_FILE_AT_LINE (23)) ;
  var_components.method_first (result_arch_5F_name, inCompiler COMMA_SOURCE_FILE_AT_LINE (24)) ;
//---
  return result_arch_5F_name ;
}


//---------------------------------------------------------------------------*
//  Function introspection                                                   *
//---------------------------------------------------------------------------*

static const C_galgas_type_descriptor * functionArgs_arch [1] = {
  NULL
} ;

//---------------------------------------------------------------------------*

static GALGAS_object functionWithGenericHeader_arch (C_Compiler * inCompiler,
                                                     const cObjectArray & /* inEffectiveParameterArray */,
                                                     const GALGAS_location & /* inErrorLocation */
                                                     COMMA_LOCATION_ARGS) {
  return function_arch (inCompiler COMMA_THERE).reader_object (THERE) ;
}

//---------------------------------------------------------------------------*

C_galgas_function_descriptor functionDescriptor_arch ("arch",
                                                      functionWithGenericHeader_arch,
                                                      & kTypeDescriptor_GALGAS_string,
                                                      0,
                                                      functionArgs_arch) ;

//---------------------------------------------------------------------------*
//                                                                           *
//                              Function 'chip'                              *
//                                                                           *
//---------------------------------------------------------------------------*

GALGAS_string function_chip (C_Compiler * inCompiler
                             COMMA_UNUSED_LOCATION_ARGS) {
  GALGAS_string result_chip_5F_name ; // Returned variable
  GALGAS_stringlist var_components = GALGAS_string (gOption_goil_5F_options_target_5F_platform.reader_value ()).reader_componentsSeparatedByString (GALGAS_string ("/") COMMA_SOURCE_FILE_AT_LINE (32)) ;
  const enumGalgasBool test_0 = GALGAS_bool (kIsStrictSup, var_components.reader_length (SOURCE_FILE_AT_LINE (33)).objectCompare (GALGAS_uint ((PMUInt32) 1U))).boolEnum () ;
  if (kBoolTrue == test_0) {
    result_chip_5F_name = var_components.reader_mValueAtIndex (GALGAS_uint ((PMUInt32) 1U), inCompiler COMMA_SOURCE_FILE_AT_LINE (34)) ;
  }else if (kBoolFalse == test_0) {
    result_chip_5F_name = GALGAS_string::makeEmptyString () ;
  }
//---
  return result_chip_5F_name ;
}


//---------------------------------------------------------------------------*
//  Function introspection                                                   *
//---------------------------------------------------------------------------*

static const C_galgas_type_descriptor * functionArgs_chip [1] = {
  NULL
} ;

//---------------------------------------------------------------------------*

static GALGAS_object functionWithGenericHeader_chip (C_Compiler * inCompiler,
                                                     const cObjectArray & /* inEffectiveParameterArray */,
                                                     const GALGAS_location & /* inErrorLocation */
                                                     COMMA_LOCATION_ARGS) {
  return function_chip (inCompiler COMMA_THERE).reader_object (THERE) ;
}

//---------------------------------------------------------------------------*

C_galgas_function_descriptor functionDescriptor_chip ("chip",
                                                      functionWithGenericHeader_chip,
                                                      & kTypeDescriptor_GALGAS_string,
                                                      0,
                                                      functionArgs_chip) ;

//---------------------------------------------------------------------------*
//                                                                           *
//                             Function 'board'                              *
//                                                                           *
//---------------------------------------------------------------------------*

GALGAS_string function_board (C_Compiler * inCompiler
                              COMMA_UNUSED_LOCATION_ARGS) {
  GALGAS_string result_board_5F_name ; // Returned variable
  GALGAS_stringlist var_components = GALGAS_string (gOption_goil_5F_options_target_5F_platform.reader_value ()).reader_componentsSeparatedByString (GALGAS_string ("/") COMMA_SOURCE_FILE_AT_LINE (44)) ;
  const enumGalgasBool test_0 = GALGAS_bool (kIsStrictSup, var_components.reader_length (SOURCE_FILE_AT_LINE (45)).objectCompare (GALGAS_uint ((PMUInt32) 2U))).boolEnum () ;
  if (kBoolTrue == test_0) {
    result_board_5F_name = var_components.reader_mValueAtIndex (GALGAS_uint ((PMUInt32) 2U), inCompiler COMMA_SOURCE_FILE_AT_LINE (46)) ;
  }else if (kBoolFalse == test_0) {
    result_board_5F_name = GALGAS_string::makeEmptyString () ;
  }
//---
  return result_board_5F_name ;
}


//---------------------------------------------------------------------------*
//  Function introspection                                                   *
//---------------------------------------------------------------------------*

static const C_galgas_type_descriptor * functionArgs_board [1] = {
  NULL
} ;

//---------------------------------------------------------------------------*

static GALGAS_object functionWithGenericHeader_board (C_Compiler * inCompiler,
                                                      const cObjectArray & /* inEffectiveParameterArray */,
                                                      const GALGAS_location & /* inErrorLocation */
                                                      COMMA_LOCATION_ARGS) {
  return function_board (inCompiler COMMA_THERE).reader_object (THERE) ;
}

//---------------------------------------------------------------------------*

C_galgas_function_descriptor functionDescriptor_board ("board",
                                                       functionWithGenericHeader_board,
                                                       & kTypeDescriptor_GALGAS_string,
                                                       0,
                                                       functionArgs_board) ;

//---------------------------------------------------------------------------*
//                                                                           *
//                       Function 'add_path_component'                       *
//                                                                           *
//---------------------------------------------------------------------------*

GALGAS_string function_add_5F_path_5F_component (GALGAS_string inArgument_path,
                                                 GALGAS_string inArgument_component,
                                                 C_Compiler * inCompiler
                                                 COMMA_UNUSED_LOCATION_ARGS) {
  GALGAS_string result_new_5F_path ; // Returned variable
  const enumGalgasBool test_0 = GALGAS_bool (kIsNotEqual, inArgument_path.reader_characterAtIndex (inArgument_path.reader_length (SOURCE_FILE_AT_LINE (60)).substract_operation (GALGAS_uint ((PMUInt32) 1U), inCompiler COMMA_SOURCE_FILE_AT_LINE (60)), inCompiler COMMA_SOURCE_FILE_AT_LINE (60)).objectCompare (GALGAS_char (TO_UNICODE (47)))).boolEnum () ;
  if (kBoolTrue == test_0) {
    result_new_5F_path = inArgument_path.operator_concat (GALGAS_string ("/") COMMA_SOURCE_FILE_AT_LINE (61)).operator_concat (inArgument_component COMMA_SOURCE_FILE_AT_LINE (61)) ;
  }else if (kBoolFalse == test_0) {
    result_new_5F_path = inArgument_path.operator_concat (inArgument_component COMMA_SOURCE_FILE_AT_LINE (63)) ;
  }
//---
  return result_new_5F_path ;
}


//---------------------------------------------------------------------------*
//  Function introspection                                                   *
//---------------------------------------------------------------------------*

static const C_galgas_type_descriptor * functionArgs_add_5F_path_5F_component [3] = {
  & kTypeDescriptor_GALGAS_string,
  & kTypeDescriptor_GALGAS_string,
  NULL
} ;

//---------------------------------------------------------------------------*

static GALGAS_object functionWithGenericHeader_add_5F_path_5F_component (C_Compiler * inCompiler,
                                                                         const cObjectArray & inEffectiveParameterArray,
                                                                         const GALGAS_location & /* §§ inErrorLocation */
                                                                         COMMA_LOCATION_ARGS) {
  const GALGAS_string operand0 = GALGAS_string::extractObject (inEffectiveParameterArray.objectAtIndex (0 COMMA_HERE),
                                                               inCompiler
                                                               COMMA_THERE) ;
  const GALGAS_string operand1 = GALGAS_string::extractObject (inEffectiveParameterArray.objectAtIndex (1 COMMA_HERE),
                                                               inCompiler
                                                               COMMA_THERE) ;
  return function_add_5F_path_5F_component (operand0,
                                            operand1,
                                            inCompiler
                                            COMMA_THERE).reader_object (THERE) ;
}

//---------------------------------------------------------------------------*

C_galgas_function_descriptor functionDescriptor_add_5F_path_5F_component ("add_path_component",
                                                                          functionWithGenericHeader_add_5F_path_5F_component,
                                                                          & kTypeDescriptor_GALGAS_string,
                                                                          2,
                                                                          functionArgs_add_5F_path_5F_component) ;

//---------------------------------------------------------------------------*
//                                                                           *
//                     Function 'rootTemplatesDirectory'                     *
//                                                                           *
//---------------------------------------------------------------------------*

GALGAS_string function_rootTemplatesDirectory (C_Compiler * inCompiler
                                               COMMA_UNUSED_LOCATION_ARGS) {
  GALGAS_string result_templateDirectory ; // Returned variable
  const enumGalgasBool test_0 = GALGAS_bool (kIsNotEqual, GALGAS_string (gOption_goil_5F_options_template_5F_dir.reader_value ()).objectCompare (GALGAS_string::makeEmptyString ())).boolEnum () ;
  if (kBoolTrue == test_0) {
    result_templateDirectory = GALGAS_string (gOption_goil_5F_options_template_5F_dir.reader_value ()) ;
  }else if (kBoolFalse == test_0) {
    result_templateDirectory = GALGAS_string::constructor_stringWithEnvironmentVariableOrEmpty (GALGAS_string ("GOIL_TEMPLATES") COMMA_SOURCE_FILE_AT_LINE (73)) ;
  }
  result_templateDirectory = result_templateDirectory.reader_unixPathWithNativePath (SOURCE_FILE_AT_LINE (75)) ;
  result_templateDirectory = result_templateDirectory.reader_stringByStandardizingPath (SOURCE_FILE_AT_LINE (76)) ;
  const enumGalgasBool test_1 = GALGAS_bool (kIsNotEqual, result_templateDirectory.reader_characterAtIndex (GALGAS_uint ((PMUInt32) 0U), inCompiler COMMA_SOURCE_FILE_AT_LINE (77)).objectCompare (GALGAS_char (TO_UNICODE (47)))).boolEnum () ;
  if (kBoolTrue == test_1) {
    GALGAS_string var_currentDirectory = GALGAS_string::constructor_stringWithCurrentDirectory (SOURCE_FILE_AT_LINE (78)) ;
    result_templateDirectory = var_currentDirectory.operator_concat (GALGAS_string ("/") COMMA_SOURCE_FILE_AT_LINE (79)).operator_concat (result_templateDirectory COMMA_SOURCE_FILE_AT_LINE (79)) ;
    result_templateDirectory = result_templateDirectory.reader_stringByStandardizingPath (SOURCE_FILE_AT_LINE (80)) ;
  }
//---
  return result_templateDirectory ;
}


//---------------------------------------------------------------------------*
//  Function introspection                                                   *
//---------------------------------------------------------------------------*

static const C_galgas_type_descriptor * functionArgs_rootTemplatesDirectory [1] = {
  NULL
} ;

//---------------------------------------------------------------------------*

static GALGAS_object functionWithGenericHeader_rootTemplatesDirectory (C_Compiler * inCompiler,
                                                                       const cObjectArray & /* inEffectiveParameterArray */,
                                                                       const GALGAS_location & /* inErrorLocation */
                                                                       COMMA_LOCATION_ARGS) {
  return function_rootTemplatesDirectory (inCompiler COMMA_THERE).reader_object (THERE) ;
}

//---------------------------------------------------------------------------*

C_galgas_function_descriptor functionDescriptor_rootTemplatesDirectory ("rootTemplatesDirectory",
                                                                        functionWithGenericHeader_rootTemplatesDirectory,
                                                                        & kTypeDescriptor_GALGAS_string,
                                                                        0,
                                                                        functionArgs_rootTemplatesDirectory) ;

//---------------------------------------------------------------------------*
//                                                                           *
//                      Function 'templates_directory'                       *
//                                                                           *
//---------------------------------------------------------------------------*

GALGAS_string function_templates_5F_directory (GALGAS_string inArgument_prefix,
                                               C_Compiler * inCompiler
                                               COMMA_UNUSED_LOCATION_ARGS) {
  GALGAS_string result_temp_5F_dir ; // Returned variable
  result_temp_5F_dir = function_rootTemplatesDirectory (inCompiler COMMA_SOURCE_FILE_AT_LINE (85)) ;
  const enumGalgasBool test_0 = GALGAS_bool (kIsNotEqual, result_temp_5F_dir.objectCompare (GALGAS_string::makeEmptyString ())).boolEnum () ;
  if (kBoolTrue == test_0) {
    result_temp_5F_dir = function_add_5F_path_5F_component (result_temp_5F_dir, inArgument_prefix, inCompiler COMMA_SOURCE_FILE_AT_LINE (87)) ;
    const enumGalgasBool test_1 = GALGAS_bool (kIsNotEqual, result_temp_5F_dir.reader_characterAtIndex (GALGAS_uint ((PMUInt32) 0U), inCompiler COMMA_SOURCE_FILE_AT_LINE (89)).objectCompare (GALGAS_char (TO_UNICODE (47)))).boolEnum () ;
    if (kBoolTrue == test_1) {
      GALGAS_string var_curdir = GALGAS_string::constructor_stringWithCurrentDirectory (SOURCE_FILE_AT_LINE (90)) ;
      const enumGalgasBool test_2 = GALGAS_bool (kIsEqual, result_temp_5F_dir.reader_characterAtIndex (GALGAS_uint ((PMUInt32) 0U), inCompiler COMMA_SOURCE_FILE_AT_LINE (91)).objectCompare (GALGAS_char (TO_UNICODE (46)))).operator_and (GALGAS_bool (kIsEqual, result_temp_5F_dir.reader_characterAtIndex (GALGAS_uint ((PMUInt32) 1U), inCompiler COMMA_SOURCE_FILE_AT_LINE (91)).objectCompare (GALGAS_char (TO_UNICODE (47)))) COMMA_SOURCE_FILE_AT_LINE (91)).boolEnum () ;
      if (kBoolTrue == test_2) {
        result_temp_5F_dir = result_temp_5F_dir.reader_stringByRemovingCharacterAtIndex (GALGAS_uint ((PMUInt32) 0U), inCompiler COMMA_SOURCE_FILE_AT_LINE (92)).reader_stringByRemovingCharacterAtIndex (GALGAS_uint ((PMUInt32) 0U), inCompiler COMMA_SOURCE_FILE_AT_LINE (92)) ;
      }
      result_temp_5F_dir = var_curdir.operator_concat (GALGAS_string ("/") COMMA_SOURCE_FILE_AT_LINE (94)).operator_concat (result_temp_5F_dir COMMA_SOURCE_FILE_AT_LINE (94)) ;
    }
    const enumGalgasBool test_3 = GALGAS_bool (kIsNotEqual, result_temp_5F_dir.reader_characterAtIndex (result_temp_5F_dir.reader_length (SOURCE_FILE_AT_LINE (96)).substract_operation (GALGAS_uint ((PMUInt32) 1U), inCompiler COMMA_SOURCE_FILE_AT_LINE (96)), inCompiler COMMA_SOURCE_FILE_AT_LINE (96)).objectCompare (GALGAS_char (TO_UNICODE (47)))).boolEnum () ;
    if (kBoolTrue == test_3) {
      result_temp_5F_dir.dotAssign_operation (GALGAS_string ("/") COMMA_SOURCE_FILE_AT_LINE (97)) ;
    }
  }
//---
  return result_temp_5F_dir ;
}


//---------------------------------------------------------------------------*
//  Function introspection                                                   *
//---------------------------------------------------------------------------*

static const C_galgas_type_descriptor * functionArgs_templates_5F_directory [2] = {
  & kTypeDescriptor_GALGAS_string,
  NULL
} ;

//---------------------------------------------------------------------------*

static GALGAS_object functionWithGenericHeader_templates_5F_directory (C_Compiler * inCompiler,
                                                                       const cObjectArray & inEffectiveParameterArray,
                                                                       const GALGAS_location & /* §§ inErrorLocation */
                                                                       COMMA_LOCATION_ARGS) {
  const GALGAS_string operand0 = GALGAS_string::extractObject (inEffectiveParameterArray.objectAtIndex (0 COMMA_HERE),
                                                               inCompiler
                                                               COMMA_THERE) ;
  return function_templates_5F_directory (operand0,
                                          inCompiler
                                          COMMA_THERE).reader_object (THERE) ;
}

//---------------------------------------------------------------------------*

C_galgas_function_descriptor functionDescriptor_templates_5F_directory ("templates_directory",
                                                                        functionWithGenericHeader_templates_5F_directory,
                                                                        & kTypeDescriptor_GALGAS_string,
                                                                        1,
                                                                        functionArgs_templates_5F_directory) ;

//---------------------------------------------------------------------------*
//                                                                           *
//                    Function 'template_string_if_exist'                    *
//                                                                           *
//---------------------------------------------------------------------------*

GALGAS_string function_template_5F_string_5F_if_5F_exist (GALGAS_string inArgument_prefix,
                                                          GALGAS_string inArgument_obj,
                                                          C_Compiler * inCompiler
                                                          COMMA_UNUSED_LOCATION_ARGS) {
  GALGAS_string result_tpl ; // Returned variable
  GALGAS_string var_targ_5F_tpl = GALGAS_string::makeEmptyString () ;
  GALGAS_string var_temp_5F_dir ;
  var_temp_5F_dir = function_templates_5F_directory (inArgument_prefix, inCompiler COMMA_SOURCE_FILE_AT_LINE (115)) ;
  GALGAS_string var_temp_5F_name = inArgument_obj.operator_concat (GALGAS_string (".tpl") COMMA_SOURCE_FILE_AT_LINE (118)) ;
  var_targ_5F_tpl = var_temp_5F_dir.operator_concat (function_arch (inCompiler COMMA_SOURCE_FILE_AT_LINE (120)) COMMA_SOURCE_FILE_AT_LINE (120)).operator_concat (GALGAS_string ("/") COMMA_SOURCE_FILE_AT_LINE (120)).operator_concat (function_chip (inCompiler COMMA_SOURCE_FILE_AT_LINE (120)) COMMA_SOURCE_FILE_AT_LINE (120)).operator_concat (GALGAS_string ("/") COMMA_SOURCE_FILE_AT_LINE (120)).operator_concat (function_board (inCompiler COMMA_SOURCE_FILE_AT_LINE (120)) COMMA_SOURCE_FILE_AT_LINE (120)).operator_concat (GALGAS_string ("/") COMMA_SOURCE_FILE_AT_LINE (120)).operator_concat (var_temp_5F_name COMMA_SOURCE_FILE_AT_LINE (120)) ;
  const enumGalgasBool test_0 = var_targ_5F_tpl.reader_fileExists (SOURCE_FILE_AT_LINE (121)).boolEnum () ;
  if (kBoolTrue == test_0) {
    result_tpl = GALGAS_string::constructor_stringWithContentsOfFile (var_targ_5F_tpl, inCompiler COMMA_SOURCE_FILE_AT_LINE (122)) ;
  }else if (kBoolFalse == test_0) {
    var_targ_5F_tpl = var_temp_5F_dir.operator_concat (function_arch (inCompiler COMMA_SOURCE_FILE_AT_LINE (124)) COMMA_SOURCE_FILE_AT_LINE (124)).operator_concat (GALGAS_string ("/") COMMA_SOURCE_FILE_AT_LINE (124)).operator_concat (function_chip (inCompiler COMMA_SOURCE_FILE_AT_LINE (124)) COMMA_SOURCE_FILE_AT_LINE (124)).operator_concat (GALGAS_string ("/") COMMA_SOURCE_FILE_AT_LINE (124)).operator_concat (var_temp_5F_name COMMA_SOURCE_FILE_AT_LINE (124)) ;
    const enumGalgasBool test_1 = var_targ_5F_tpl.reader_fileExists (SOURCE_FILE_AT_LINE (125)).boolEnum () ;
    if (kBoolTrue == test_1) {
      result_tpl = GALGAS_string::constructor_stringWithContentsOfFile (var_targ_5F_tpl, inCompiler COMMA_SOURCE_FILE_AT_LINE (126)) ;
    }else if (kBoolFalse == test_1) {
      var_targ_5F_tpl = var_temp_5F_dir.operator_concat (function_arch (inCompiler COMMA_SOURCE_FILE_AT_LINE (128)) COMMA_SOURCE_FILE_AT_LINE (128)).operator_concat (GALGAS_string ("/") COMMA_SOURCE_FILE_AT_LINE (128)).operator_concat (var_temp_5F_name COMMA_SOURCE_FILE_AT_LINE (128)) ;
      const enumGalgasBool test_2 = var_targ_5F_tpl.reader_fileExists (SOURCE_FILE_AT_LINE (129)).boolEnum () ;
      if (kBoolTrue == test_2) {
        result_tpl = GALGAS_string::constructor_stringWithContentsOfFile (var_targ_5F_tpl, inCompiler COMMA_SOURCE_FILE_AT_LINE (130)) ;
      }else if (kBoolFalse == test_2) {
        var_targ_5F_tpl = var_temp_5F_dir.operator_concat (GALGAS_string ("all_targets/") COMMA_SOURCE_FILE_AT_LINE (133)).operator_concat (var_temp_5F_name COMMA_SOURCE_FILE_AT_LINE (133)) ;
        const enumGalgasBool test_3 = var_targ_5F_tpl.reader_fileExists (SOURCE_FILE_AT_LINE (134)).boolEnum () ;
        if (kBoolTrue == test_3) {
          result_tpl = GALGAS_string::constructor_stringWithContentsOfFile (var_targ_5F_tpl, inCompiler COMMA_SOURCE_FILE_AT_LINE (135)) ;
        }else if (kBoolFalse == test_3) {
          var_targ_5F_tpl = var_temp_5F_dir.operator_concat (var_temp_5F_name COMMA_SOURCE_FILE_AT_LINE (137)) ;
          const enumGalgasBool test_4 = var_targ_5F_tpl.reader_fileExists (SOURCE_FILE_AT_LINE (138)).boolEnum () ;
          if (kBoolTrue == test_4) {
            result_tpl = GALGAS_string::constructor_stringWithContentsOfFile (var_targ_5F_tpl, inCompiler COMMA_SOURCE_FILE_AT_LINE (139)) ;
          }else if (kBoolFalse == test_4) {
            result_tpl = GALGAS_string::makeEmptyString () ;
          }
        }
      }
    }
  }
//---
  return result_tpl ;
}


//---------------------------------------------------------------------------*
//  Function introspection                                                   *
//---------------------------------------------------------------------------*

static const C_galgas_type_descriptor * functionArgs_template_5F_string_5F_if_5F_exist [3] = {
  & kTypeDescriptor_GALGAS_string,
  & kTypeDescriptor_GALGAS_string,
  NULL
} ;

//---------------------------------------------------------------------------*

static GALGAS_object functionWithGenericHeader_template_5F_string_5F_if_5F_exist (C_Compiler * inCompiler,
                                                                                  const cObjectArray & inEffectiveParameterArray,
                                                                                  const GALGAS_location & /* §§ inErrorLocation */
                                                                                  COMMA_LOCATION_ARGS) {
  const GALGAS_string operand0 = GALGAS_string::extractObject (inEffectiveParameterArray.objectAtIndex (0 COMMA_HERE),
                                                               inCompiler
                                                               COMMA_THERE) ;
  const GALGAS_string operand1 = GALGAS_string::extractObject (inEffectiveParameterArray.objectAtIndex (1 COMMA_HERE),
                                                               inCompiler
                                                               COMMA_THERE) ;
  return function_template_5F_string_5F_if_5F_exist (operand0,
                                                     operand1,
                                                     inCompiler
                                                     COMMA_THERE).reader_object (THERE) ;
}

//---------------------------------------------------------------------------*

C_galgas_function_descriptor functionDescriptor_template_5F_string_5F_if_5F_exist ("template_string_if_exist",
                                                                                   functionWithGenericHeader_template_5F_string_5F_if_5F_exist,
                                                                                   & kTypeDescriptor_GALGAS_string,
                                                                                   2,
                                                                                   functionArgs_template_5F_string_5F_if_5F_exist) ;

//---------------------------------------------------------------------------*
//                                                                           *
//                        Function 'template_string'                         *
//                                                                           *
//---------------------------------------------------------------------------*

GALGAS_string function_template_5F_string (GALGAS_string inArgument_prefix,
                                           GALGAS_string inArgument_obj,
                                           C_Compiler * inCompiler
                                           COMMA_UNUSED_LOCATION_ARGS) {
  GALGAS_string result_tpl ; // Returned variable
  result_tpl = function_template_5F_string_5F_if_5F_exist (inArgument_prefix, inArgument_obj, inCompiler COMMA_SOURCE_FILE_AT_LINE (153)) ;
  const enumGalgasBool test_0 = GALGAS_bool (kIsEqual, result_tpl.objectCompare (GALGAS_string::makeEmptyString ())).boolEnum () ;
  if (kBoolTrue == test_0) {
    GALGAS_string var_target_5F_platform = function_arch (inCompiler COMMA_SOURCE_FILE_AT_LINE (155)) ;
    GALGAS_string var_temp_5F_dir ;
    var_temp_5F_dir = function_templates_5F_directory (inArgument_prefix, inCompiler COMMA_SOURCE_FILE_AT_LINE (157)) ;
    inCompiler->emitSemanticError (inCompiler->here (), GALGAS_string ("No template found for ").operator_concat (inArgument_obj COMMA_SOURCE_FILE_AT_LINE (158)).operator_concat (GALGAS_string (" (searched in ") COMMA_SOURCE_FILE_AT_LINE (158)).operator_concat (var_temp_5F_dir COMMA_SOURCE_FILE_AT_LINE (158)).operator_concat (var_target_5F_platform COMMA_SOURCE_FILE_AT_LINE (158)).operator_concat (GALGAS_string (" and in ") COMMA_SOURCE_FILE_AT_LINE (158)).operator_concat (var_temp_5F_dir COMMA_SOURCE_FILE_AT_LINE (159)).operator_concat (GALGAS_string ("all_targets)") COMMA_SOURCE_FILE_AT_LINE (159)) COMMA_SOURCE_FILE_AT_LINE (158)) ;
  }
//---
  return result_tpl ;
}


//---------------------------------------------------------------------------*
//  Function introspection                                                   *
//---------------------------------------------------------------------------*

static const C_galgas_type_descriptor * functionArgs_template_5F_string [3] = {
  & kTypeDescriptor_GALGAS_string,
  & kTypeDescriptor_GALGAS_string,
  NULL
} ;

//---------------------------------------------------------------------------*

static GALGAS_object functionWithGenericHeader_template_5F_string (C_Compiler * inCompiler,
                                                                   const cObjectArray & inEffectiveParameterArray,
                                                                   const GALGAS_location & /* §§ inErrorLocation */
                                                                   COMMA_LOCATION_ARGS) {
  const GALGAS_string operand0 = GALGAS_string::extractObject (inEffectiveParameterArray.objectAtIndex (0 COMMA_HERE),
                                                               inCompiler
                                                               COMMA_THERE) ;
  const GALGAS_string operand1 = GALGAS_string::extractObject (inEffectiveParameterArray.objectAtIndex (1 COMMA_HERE),
                                                               inCompiler
                                                               COMMA_THERE) ;
  return function_template_5F_string (operand0,
                                      operand1,
                                      inCompiler
                                      COMMA_THERE).reader_object (THERE) ;
}

//---------------------------------------------------------------------------*

C_galgas_function_descriptor functionDescriptor_template_5F_string ("template_string",
                                                                    functionWithGenericHeader_template_5F_string,
                                                                    & kTypeDescriptor_GALGAS_string,
                                                                    2,
                                                                    functionArgs_template_5F_string) ;

//---------------------------------------------------------------------------*
//                                                                           *
//                        Function 'templateFilePath'                        *
//                                                                           *
//---------------------------------------------------------------------------*

GALGAS_string function_templateFilePath (const GALGAS_string & constinArgument_prefix,
                                         const GALGAS_string & constinArgument_file,
                                         C_Compiler * inCompiler
                                         COMMA_UNUSED_LOCATION_ARGS) {
  GALGAS_string result_path ; // Returned variable
  GALGAS_stringlist var_components = GALGAS_string (gOption_goil_5F_options_target_5F_platform.reader_value ()).reader_componentsSeparatedByString (GALGAS_string ("/") COMMA_SOURCE_FILE_AT_LINE (168)) ;
  GALGAS_string var_templateDir = function_templates_5F_directory (constinArgument_prefix, inCompiler COMMA_SOURCE_FILE_AT_LINE (169)) ;
  GALGAS_bool var_notFound = GALGAS_bool (true) ;
  GALGAS_bool var_notOver = GALGAS_bool (true) ;
  result_path = GALGAS_string::makeEmptyString () ;
  if (var_components.reader_length (SOURCE_FILE_AT_LINE (174)).add_operation (GALGAS_uint ((PMUInt32) 1U), inCompiler COMMA_SOURCE_FILE_AT_LINE (174)).isValid ()) {
    PMUInt32 variant_5619 = var_components.reader_length (SOURCE_FILE_AT_LINE (174)).add_operation (GALGAS_uint ((PMUInt32) 1U), inCompiler COMMA_SOURCE_FILE_AT_LINE (174)).uintValue () ;
    bool loop_5619 = true ;
    while (loop_5619) {
      loop_5619 = var_notFound.operator_and (var_notOver COMMA_SOURCE_FILE_AT_LINE (175)).isValid () ;
      if (loop_5619) {
        loop_5619 = var_notFound.operator_and (var_notOver COMMA_SOURCE_FILE_AT_LINE (175)).boolValue () ;
      }
      if (loop_5619 && (0 == variant_5619)) {
        loop_5619 = false ;
        inCompiler->loopRunTimeVariantError (SOURCE_FILE_AT_LINE (174)) ;
      }
      if (loop_5619) {
        variant_5619 -- ;
        GALGAS_string var_targetPath = var_templateDir.operator_concat (GALGAS_string::constructor_componentsJoinedByString (var_components, GALGAS_string ("/") COMMA_SOURCE_FILE_AT_LINE (176)) COMMA_SOURCE_FILE_AT_LINE (176)).operator_concat (GALGAS_string ("/") COMMA_SOURCE_FILE_AT_LINE (176)).operator_concat (constinArgument_file COMMA_SOURCE_FILE_AT_LINE (176)) ;
        const enumGalgasBool test_0 = var_targetPath.reader_fileExists (SOURCE_FILE_AT_LINE (178)).boolEnum () ;
        if (kBoolTrue == test_0) {
          var_notFound = GALGAS_bool (false) ;
          result_path = var_targetPath ;
        }
        const enumGalgasBool test_1 = GALGAS_bool (kIsStrictSup, var_components.reader_length (SOURCE_FILE_AT_LINE (182)).objectCompare (GALGAS_uint ((PMUInt32) 0U))).boolEnum () ;
        if (kBoolTrue == test_1) {
          {
          GALGAS_string joker_5979_0 ; // Joker input parameter
          var_components.modifier_popLast (joker_5979_0, inCompiler COMMA_SOURCE_FILE_AT_LINE (183)) ;
          }
        }else if (kBoolFalse == test_1) {
          var_notOver = GALGAS_bool (false) ;
        }
      }
    }
  }
//---
  return result_path ;
}


//---------------------------------------------------------------------------*
//  Function introspection                                                   *
//---------------------------------------------------------------------------*

static const C_galgas_type_descriptor * functionArgs_templateFilePath [3] = {
  & kTypeDescriptor_GALGAS_string,
  & kTypeDescriptor_GALGAS_string,
  NULL
} ;

//---------------------------------------------------------------------------*

static GALGAS_object functionWithGenericHeader_templateFilePath (C_Compiler * inCompiler,
                                                                 const cObjectArray & inEffectiveParameterArray,
                                                                 const GALGAS_location & /* §§ inErrorLocation */
                                                                 COMMA_LOCATION_ARGS) {
  const GALGAS_string operand0 = GALGAS_string::extractObject (inEffectiveParameterArray.objectAtIndex (0 COMMA_HERE),
                                                               inCompiler
                                                               COMMA_THERE) ;
  const GALGAS_string operand1 = GALGAS_string::extractObject (inEffectiveParameterArray.objectAtIndex (1 COMMA_HERE),
                                                               inCompiler
                                                               COMMA_THERE) ;
  return function_templateFilePath (operand0,
                                    operand1,
                                    inCompiler
                                    COMMA_THERE).reader_object (THERE) ;
}

//---------------------------------------------------------------------------*

C_galgas_function_descriptor functionDescriptor_templateFilePath ("templateFilePath",
                                                                  functionWithGenericHeader_templateFilePath,
                                                                  & kTypeDescriptor_GALGAS_string,
                                                                  2,
                                                                  functionArgs_templateFilePath) ;

//---------------------------------------------------------------------------*
//                                                                           *
//                      Function 'allTemplateFilePaths'                      *
//                                                                           *
//---------------------------------------------------------------------------*

GALGAS_stringlist function_allTemplateFilePaths (const GALGAS_string & constinArgument_prefix,
                                                 const GALGAS_string & constinArgument_file,
                                                 C_Compiler * inCompiler
                                                 COMMA_UNUSED_LOCATION_ARGS) {
  GALGAS_stringlist result_paths ; // Returned variable
  GALGAS_stringlist var_components = GALGAS_string (gOption_goil_5F_options_target_5F_platform.reader_value ()).reader_componentsSeparatedByString (GALGAS_string ("/") COMMA_SOURCE_FILE_AT_LINE (195)) ;
  GALGAS_string var_templateDir = function_templates_5F_directory (constinArgument_prefix, inCompiler COMMA_SOURCE_FILE_AT_LINE (196)) ;
  GALGAS_bool var_notOver = GALGAS_bool (true) ;
  result_paths = GALGAS_stringlist::constructor_emptyList (SOURCE_FILE_AT_LINE (198)) ;
  if (var_components.reader_length (SOURCE_FILE_AT_LINE (200)).add_operation (GALGAS_uint ((PMUInt32) 1U), inCompiler COMMA_SOURCE_FILE_AT_LINE (200)).isValid ()) {
    PMUInt32 variant_6378 = var_components.reader_length (SOURCE_FILE_AT_LINE (200)).add_operation (GALGAS_uint ((PMUInt32) 1U), inCompiler COMMA_SOURCE_FILE_AT_LINE (200)).uintValue () ;
    bool loop_6378 = true ;
    while (loop_6378) {
      loop_6378 = var_notOver.isValid () ;
      if (loop_6378) {
        loop_6378 = var_notOver.boolValue () ;
      }
      if (loop_6378 && (0 == variant_6378)) {
        loop_6378 = false ;
        inCompiler->loopRunTimeVariantError (SOURCE_FILE_AT_LINE (200)) ;
      }
      if (loop_6378) {
        variant_6378 -- ;
        GALGAS_string var_intermediatePath = GALGAS_string::constructor_componentsJoinedByString (var_components, GALGAS_string ("/") COMMA_SOURCE_FILE_AT_LINE (202)) ;
        const enumGalgasBool test_0 = GALGAS_bool (kIsNotEqual, var_intermediatePath.objectCompare (GALGAS_string::makeEmptyString ())).boolEnum () ;
        if (kBoolTrue == test_0) {
          var_intermediatePath.dotAssign_operation (GALGAS_string ("/") COMMA_SOURCE_FILE_AT_LINE (203)) ;
        }
        GALGAS_string var_targetPath = var_templateDir.operator_concat (var_intermediatePath COMMA_SOURCE_FILE_AT_LINE (204)).operator_concat (constinArgument_file COMMA_SOURCE_FILE_AT_LINE (204)) ;
        const enumGalgasBool test_1 = var_targetPath.reader_fileExists (SOURCE_FILE_AT_LINE (206)).boolEnum () ;
        if (kBoolTrue == test_1) {
          result_paths.addAssign_operation (var_targetPath COMMA_SOURCE_FILE_AT_LINE (207)) ;
        }
        const enumGalgasBool test_2 = GALGAS_bool (kIsStrictSup, var_components.reader_length (SOURCE_FILE_AT_LINE (209)).objectCompare (GALGAS_uint ((PMUInt32) 0U))).boolEnum () ;
        if (kBoolTrue == test_2) {
          {
          GALGAS_string joker_6818_0 ; // Joker input parameter
          var_components.modifier_popLast (joker_6818_0, inCompiler COMMA_SOURCE_FILE_AT_LINE (210)) ;
          }
        }else if (kBoolFalse == test_2) {
          var_notOver = GALGAS_bool (false) ;
        }
      }
    }
  }
//---
  return result_paths ;
}


//---------------------------------------------------------------------------*
//  Function introspection                                                   *
//---------------------------------------------------------------------------*

static const C_galgas_type_descriptor * functionArgs_allTemplateFilePaths [3] = {
  & kTypeDescriptor_GALGAS_string,
  & kTypeDescriptor_GALGAS_string,
  NULL
} ;

//---------------------------------------------------------------------------*

static GALGAS_object functionWithGenericHeader_allTemplateFilePaths (C_Compiler * inCompiler,
                                                                     const cObjectArray & inEffectiveParameterArray,
                                                                     const GALGAS_location & /* §§ inErrorLocation */
                                                                     COMMA_LOCATION_ARGS) {
  const GALGAS_string operand0 = GALGAS_string::extractObject (inEffectiveParameterArray.objectAtIndex (0 COMMA_HERE),
                                                               inCompiler
                                                               COMMA_THERE) ;
  const GALGAS_string operand1 = GALGAS_string::extractObject (inEffectiveParameterArray.objectAtIndex (1 COMMA_HERE),
                                                               inCompiler
                                                               COMMA_THERE) ;
  return function_allTemplateFilePaths (operand0,
                                        operand1,
                                        inCompiler
                                        COMMA_THERE).reader_object (THERE) ;
}

//---------------------------------------------------------------------------*

C_galgas_function_descriptor functionDescriptor_allTemplateFilePaths ("allTemplateFilePaths",
                                                                      functionWithGenericHeader_allTemplateFilePaths,
                                                                      & kTypeDescriptor_GALGAS_stringlist,
                                                                      2,
                                                                      functionArgs_allTemplateFilePaths) ;

//---------------------------------------------------------------------------*
//                                                                           *
//                          Function 'config_file'                           *
//                                                                           *
//---------------------------------------------------------------------------*

GALGAS_lstring function_config_5F_file (C_Compiler * inCompiler
                                        COMMA_UNUSED_LOCATION_ARGS) {
  GALGAS_lstring result_cfg_5F_file ; // Returned variable
  GALGAS_string var_cfg = function_templateFilePath (GALGAS_string ("config"), GALGAS_string ("target.cfg"), inCompiler COMMA_SOURCE_FILE_AT_LINE (219)) ;
  result_cfg_5F_file = GALGAS_lstring::constructor_new (var_cfg, inCompiler->here () COMMA_SOURCE_FILE_AT_LINE (221)) ;
//---
  return result_cfg_5F_file ;
}


//---------------------------------------------------------------------------*
//  Function introspection                                                   *
//---------------------------------------------------------------------------*

static const C_galgas_type_descriptor * functionArgs_config_5F_file [1] = {
  NULL
} ;

//---------------------------------------------------------------------------*

static GALGAS_object functionWithGenericHeader_config_5F_file (C_Compiler * inCompiler,
                                                               const cObjectArray & /* inEffectiveParameterArray */,
                                                               const GALGAS_location & /* inErrorLocation */
                                                               COMMA_LOCATION_ARGS) {
  return function_config_5F_file (inCompiler COMMA_THERE).reader_object (THERE) ;
}

//---------------------------------------------------------------------------*

C_galgas_function_descriptor functionDescriptor_config_5F_file ("config_file",
                                                                functionWithGenericHeader_config_5F_file,
                                                                & kTypeDescriptor_GALGAS_lstring,
                                                                0,
                                                                functionArgs_config_5F_file) ;

//---------------------------------------------------------------------------*
//                                                                           *
//                       Function 'extra_config_file'                        *
//                                                                           *
//---------------------------------------------------------------------------*

GALGAS_lstring function_extra_5F_config_5F_file (C_Compiler * inCompiler
                                                 COMMA_UNUSED_LOCATION_ARGS) {
  GALGAS_lstring result_cfg_5F_file ; // Returned variable
  GALGAS_string var_cfg = function_oil_5F_dir (inCompiler COMMA_SOURCE_FILE_AT_LINE (226)).operator_concat (GALGAS_string ("/target.cfg") COMMA_SOURCE_FILE_AT_LINE (226)) ;
  const enumGalgasBool test_0 = var_cfg.reader_fileExists (SOURCE_FILE_AT_LINE (227)).operator_not (SOURCE_FILE_AT_LINE (227)).boolEnum () ;
  if (kBoolTrue == test_0) {
    var_cfg = GALGAS_string::makeEmptyString () ;
  }
  result_cfg_5F_file = GALGAS_lstring::constructor_new (var_cfg, inCompiler->here () COMMA_SOURCE_FILE_AT_LINE (230)) ;
//---
  return result_cfg_5F_file ;
}


//---------------------------------------------------------------------------*
//  Function introspection                                                   *
//---------------------------------------------------------------------------*

static const C_galgas_type_descriptor * functionArgs_extra_5F_config_5F_file [1] = {
  NULL
} ;

//---------------------------------------------------------------------------*

static GALGAS_object functionWithGenericHeader_extra_5F_config_5F_file (C_Compiler * inCompiler,
                                                                        const cObjectArray & /* inEffectiveParameterArray */,
                                                                        const GALGAS_location & /* inErrorLocation */
                                                                        COMMA_LOCATION_ARGS) {
  return function_extra_5F_config_5F_file (inCompiler COMMA_THERE).reader_object (THERE) ;
}

//---------------------------------------------------------------------------*

C_galgas_function_descriptor functionDescriptor_extra_5F_config_5F_file ("extra_config_file",
                                                                         functionWithGenericHeader_extra_5F_config_5F_file,
                                                                         & kTypeDescriptor_GALGAS_lstring,
                                                                         0,
                                                                         functionArgs_extra_5F_config_5F_file) ;

//---------------------------------------------------------------------------*
//                                                                           *
//                             Routine 'prefix'                              *
//                                                                           *
//---------------------------------------------------------------------------*

void routine_prefix (GALGAS_prefix_5F_map inArgument_p,
                     GALGAS_string inArgument_key,
                     GALGAS_string & outArgument_val,
                     C_Compiler * inCompiler
                     COMMA_UNUSED_LOCATION_ARGS) {
  outArgument_val.drop () ; // Release 'out' argument
  GALGAS_lstring var_lkey = GALGAS_lstring::constructor_new (inArgument_key, inCompiler->here () COMMA_SOURCE_FILE_AT_LINE (234)) ;
  GALGAS_string joker_7430_0 ; // Joker input parameter
  inArgument_p.method_prefix (var_lkey, outArgument_val, joker_7430_0, inCompiler COMMA_SOURCE_FILE_AT_LINE (235)) ;
}


//---------------------------------------------------------------------------*
//                                                                           *
//                         Routine 'performReplace'                          *
//                                                                           *
//---------------------------------------------------------------------------*

void routine_performReplace (GALGAS_prefix_5F_map inArgument_p,
                             GALGAS_string inArgument_key,
                             GALGAS_string inArgument_name,
                             GALGAS_string & ioArgument_res,
                             C_Compiler * inCompiler
                             COMMA_UNUSED_LOCATION_ARGS) {
  GALGAS_lstring var_lkey = GALGAS_lstring::constructor_new (inArgument_key, inCompiler->here () COMMA_SOURCE_FILE_AT_LINE (239)) ;
  GALGAS_string var_prefix ;
  GALGAS_string var_tag_5F_to_5F_rep ;
  inArgument_p.method_prefix (var_lkey, var_prefix, var_tag_5F_to_5F_rep, inCompiler COMMA_SOURCE_FILE_AT_LINE (242)) ;
  ioArgument_res = ioArgument_res.reader_stringByReplacingStringByString (var_tag_5F_to_5F_rep, var_prefix.operator_concat (inArgument_name COMMA_SOURCE_FILE_AT_LINE (243)), inCompiler COMMA_SOURCE_FILE_AT_LINE (243)) ;
}


//---------------------------------------------------------------------------*
//                                                                           *
//                            Routine 'doReplace'                            *
//                                                                           *
//---------------------------------------------------------------------------*

void routine_doReplace (GALGAS_string & ioArgument_s,
                        GALGAS_string inArgument_o,
                        GALGAS_string inArgument_n,
                        C_Compiler * inCompiler
                        COMMA_UNUSED_LOCATION_ARGS) {
  ioArgument_s = ioArgument_s.reader_stringByReplacingStringByString (inArgument_o, inArgument_n, inCompiler COMMA_SOURCE_FILE_AT_LINE (247)) ;
}


//---------------------------------------------------------------------------*
//                                                                           *
//                       Routine 'do_replace_default'                        *
//                                                                           *
//---------------------------------------------------------------------------*

void routine_do_5F_replace_5F_default (GALGAS_string & ioArgument_s,
                                       GALGAS_string inArgument_o,
                                       GALGAS_string inArgument_n,
                                       GALGAS_string inArgument_d,
                                       C_Compiler * inCompiler
                                       COMMA_UNUSED_LOCATION_ARGS) {
  const enumGalgasBool test_0 = GALGAS_bool (kIsNotEqual, inArgument_n.objectCompare (GALGAS_string::makeEmptyString ())).boolEnum () ;
  if (kBoolTrue == test_0) {
    ioArgument_s = ioArgument_s.reader_stringByReplacingStringByString (inArgument_o, inArgument_n, inCompiler COMMA_SOURCE_FILE_AT_LINE (252)) ;
  }else if (kBoolFalse == test_0) {
    ioArgument_s = ioArgument_s.reader_stringByReplacingStringByString (inArgument_o, inArgument_d, inCompiler COMMA_SOURCE_FILE_AT_LINE (254)) ;
  }
}


//---------------------------------------------------------------------------*
//                                                                           *
//                        Routine 'replace_no_prefix'                        *
//                                                                           *
//---------------------------------------------------------------------------*

void routine_replace_5F_no_5F_prefix (GALGAS_prefix_5F_map inArgument_p,
                                      GALGAS_string inArgument_key,
                                      GALGAS_string inArgument_name,
                                      GALGAS_string & ioArgument_res,
                                      C_Compiler * inCompiler
                                      COMMA_UNUSED_LOCATION_ARGS) {
  GALGAS_lstring var_lkey = GALGAS_lstring::constructor_new (inArgument_key, inCompiler->here () COMMA_SOURCE_FILE_AT_LINE (259)) ;
  GALGAS_string var_tag_5F_to_5F_rep ;
  GALGAS_string joker_8308_0 ; // Joker input parameter
  inArgument_p.method_prefix (var_lkey, joker_8308_0, var_tag_5F_to_5F_rep, inCompiler COMMA_SOURCE_FILE_AT_LINE (262)) ;
  ioArgument_res = ioArgument_res.reader_stringByReplacingStringByString (var_tag_5F_to_5F_rep, inArgument_name, inCompiler COMMA_SOURCE_FILE_AT_LINE (263)) ;
}


//---------------------------------------------------------------------------*
//                                                                           *
//                           Routine 'table_core'                            *
//                                                                           *
//---------------------------------------------------------------------------*

void routine_table_5F_core (GALGAS_string inArgument_typename,
                            GALGAS_string inArgument_varname,
                            GALGAS_string inArgument_obj_5F_prefix,
                            GALGAS_stringset inArgument_names,
                            GALGAS_string & ioArgument_header,
                            GALGAS_string & ioArgument_implementation,
                            C_Compiler * inCompiler
                            COMMA_UNUSED_LOCATION_ARGS) {
  GALGAS_uint var_n = GALGAS_uint ((PMUInt32) 0U) ;
  cEnumerator_stringset enumerator_8782 (inArgument_names, kEnumeration_up) ;
  while (enumerator_8782.hasCurrentObject ()) {
    ioArgument_header = ioArgument_header.operator_concat (GALGAS_string ("#define ") COMMA_SOURCE_FILE_AT_LINE (283)).operator_concat (inArgument_varname COMMA_SOURCE_FILE_AT_LINE (283)).operator_concat (GALGAS_string ("_id_of_") COMMA_SOURCE_FILE_AT_LINE (283)).operator_concat (enumerator_8782.current_key (HERE) COMMA_SOURCE_FILE_AT_LINE (283)).operator_concat (GALGAS_string ("  ") COMMA_SOURCE_FILE_AT_LINE (283)).operator_concat (var_n.reader_string (SOURCE_FILE_AT_LINE (283)) COMMA_SOURCE_FILE_AT_LINE (283)).operator_concat (GALGAS_string ("\n") COMMA_SOURCE_FILE_AT_LINE (283)) ;
    ioArgument_header = ioArgument_header.operator_concat (GALGAS_string ("#define ") COMMA_SOURCE_FILE_AT_LINE (291)).operator_concat (enumerator_8782.current_key (HERE) COMMA_SOURCE_FILE_AT_LINE (291)).operator_concat (GALGAS_string ("  ") COMMA_SOURCE_FILE_AT_LINE (291)).operator_concat (inArgument_varname COMMA_SOURCE_FILE_AT_LINE (291)).operator_concat (GALGAS_string ("_id_of_") COMMA_SOURCE_FILE_AT_LINE (291)).operator_concat (enumerator_8782.current_key (HERE) COMMA_SOURCE_FILE_AT_LINE (291)).operator_concat (GALGAS_string ("\n") COMMA_SOURCE_FILE_AT_LINE (291)) ;
    ioArgument_implementation = ioArgument_implementation.operator_concat (GALGAS_string ("    (tpl_") COMMA_SOURCE_FILE_AT_LINE (292)).operator_concat (inArgument_typename COMMA_SOURCE_FILE_AT_LINE (292)).operator_concat (GALGAS_string (" *)&") COMMA_SOURCE_FILE_AT_LINE (292)).operator_concat (inArgument_obj_5F_prefix COMMA_SOURCE_FILE_AT_LINE (292)).operator_concat (enumerator_8782.current_key (HERE) COMMA_SOURCE_FILE_AT_LINE (292)) ;
    var_n.increment_operation (inCompiler COMMA_SOURCE_FILE_AT_LINE (293)) ;
    const enumGalgasBool test_0 = GALGAS_bool (kIsNotEqual, var_n.objectCompare (inArgument_names.reader_count (SOURCE_FILE_AT_LINE (294)))).boolEnum () ;
    if (kBoolTrue == test_0) {
      ioArgument_implementation = ioArgument_implementation.operator_concat (GALGAS_string (",\n") COMMA_SOURCE_FILE_AT_LINE (295)) ;
    }else if (kBoolFalse == test_0) {
      ioArgument_implementation = ioArgument_implementation.operator_concat (GALGAS_string ("\n") COMMA_SOURCE_FILE_AT_LINE (296)) ;
    }
    enumerator_8782.gotoNextObject () ;
  }
}


//---------------------------------------------------------------------------*
//                                                                           *
//                        Routine 'add_to_stringset'                         *
//                                                                           *
//---------------------------------------------------------------------------*

void routine_add_5F_to_5F_stringset (GALGAS_stringset & ioArgument_ss,
                                     GALGAS_string inArgument_new,
                                     C_Compiler * inCompiler
                                     COMMA_UNUSED_LOCATION_ARGS) {
  const enumGalgasBool test_0 = ioArgument_ss.reader_hasKey (inArgument_new COMMA_SOURCE_FILE_AT_LINE (402)).boolEnum () ;
  if (kBoolTrue == test_0) {
    inCompiler->emitSemanticError (inCompiler->here (), GALGAS_string ("'").operator_concat (inArgument_new COMMA_SOURCE_FILE_AT_LINE (403)).operator_concat (GALGAS_string ("' is already declared before") COMMA_SOURCE_FILE_AT_LINE (403)) COMMA_SOURCE_FILE_AT_LINE (403)) ;
  }else if (kBoolFalse == test_0) {
    ioArgument_ss.addAssign_operation (inArgument_new COMMA_SOURCE_FILE_AT_LINE (405)) ;
  }
}


//---------------------------------------------------------------------------*
//                                                                           *
//                          Routine 'file_in_path'                           *
//                                                                           *
//---------------------------------------------------------------------------*

void routine_file_5F_in_5F_path (GALGAS_lstring & ioArgument_file_5F_name,
                                 C_Compiler * inCompiler
                                 COMMA_UNUSED_LOCATION_ARGS) {
  GALGAS_string var_include_5F_path = GALGAS_string::constructor_stringWithEnvironmentVariable (GALGAS_string ("GOIL_INCLUDE_PATH"), inCompiler COMMA_SOURCE_FILE_AT_LINE (412)) ;
  GALGAS_stringlist var_path_5F_list = var_include_5F_path.reader_componentsSeparatedByString (GALGAS_string (":") COMMA_SOURCE_FILE_AT_LINE (413)) ;
  GALGAS_bool var_not_5F_found = GALGAS_bool (true) ;
  cEnumerator_stringlist enumerator_12875 (var_path_5F_list, kEnumeration_up) ;
  while (enumerator_12875.hasCurrentObject ()) {
    GALGAS_string var_full_5F_file_5F_path = enumerator_12875.current_mValue (HERE) ;
    const enumGalgasBool test_0 = GALGAS_bool (kIsNotEqual, var_full_5F_file_5F_path.objectCompare (GALGAS_string::makeEmptyString ())).boolEnum () ;
    if (kBoolTrue == test_0) {
      const enumGalgasBool test_1 = GALGAS_bool (kIsNotEqual, var_full_5F_file_5F_path.reader_characterAtIndex (var_full_5F_file_5F_path.reader_length (SOURCE_FILE_AT_LINE (418)).substract_operation (GALGAS_uint ((PMUInt32) 1U), inCompiler COMMA_SOURCE_FILE_AT_LINE (418)), inCompiler COMMA_SOURCE_FILE_AT_LINE (418)).objectCompare (GALGAS_char (TO_UNICODE (47)))).boolEnum () ;
      if (kBoolTrue == test_1) {
        var_full_5F_file_5F_path.dotAssign_operation (GALGAS_string ("/") COMMA_SOURCE_FILE_AT_LINE (419)) ;
      }
    }
    var_full_5F_file_5F_path.dotAssign_operation (ioArgument_file_5F_name.reader_string (SOURCE_FILE_AT_LINE (422)) COMMA_SOURCE_FILE_AT_LINE (422)) ;
    const enumGalgasBool test_2 = var_full_5F_file_5F_path.reader_fileExists (SOURCE_FILE_AT_LINE (423)).operator_and (var_not_5F_found COMMA_SOURCE_FILE_AT_LINE (423)).boolEnum () ;
    if (kBoolTrue == test_2) {
      ioArgument_file_5F_name = GALGAS_lstring::constructor_new (var_full_5F_file_5F_path, inCompiler->here () COMMA_SOURCE_FILE_AT_LINE (424)) ;
      var_not_5F_found = GALGAS_bool (false) ;
    }
    enumerator_12875.gotoNextObject () ;
  }
}


//---------------------------------------------------------------------------*
//                                                                           *
//                        Routine 'is_in_lstringlist'                        *
//                                                                           *
//---------------------------------------------------------------------------*

void routine_is_5F_in_5F_lstringlist (GALGAS_lstringlist inArgument_l,
                                      GALGAS_lstring inArgument_e,
                                      GALGAS_lstring & outArgument_f,
                                      GALGAS_bool & outArgument_p,
                                      C_Compiler * inCompiler
                                      COMMA_UNUSED_LOCATION_ARGS) {
  outArgument_f.drop () ; // Release 'out' argument
  outArgument_p.drop () ; // Release 'out' argument
  outArgument_p = GALGAS_bool (false) ;
  outArgument_f = GALGAS_lstring::constructor_new (GALGAS_string::makeEmptyString (), inCompiler->here () COMMA_SOURCE_FILE_AT_LINE (437)) ;
  cEnumerator_lstringlist enumerator_13554 (inArgument_l, kEnumeration_up) ;
  while (enumerator_13554.hasCurrentObject ()) {
    const enumGalgasBool test_0 = GALGAS_bool (kIsEqual, enumerator_13554.current_mValue (HERE).reader_string (SOURCE_FILE_AT_LINE (439)).objectCompare (inArgument_e.reader_string (SOURCE_FILE_AT_LINE (439)))).boolEnum () ;
    if (kBoolTrue == test_0) {
      outArgument_p = GALGAS_bool (true) ;
      outArgument_f = enumerator_13554.current_mValue (HERE) ;
    }
    enumerator_13554.gotoNextObject () ;
  }
}


//---------------------------------------------------------------------------*
//                                                                           *
//                        Function 'isInLstringlist'                         *
//                                                                           *
//---------------------------------------------------------------------------*

GALGAS_bool function_isInLstringlist (GALGAS_lstringlist inArgument_l,
                                      GALGAS_lstring inArgument_e,
                                      C_Compiler * /* inCompiler */
                                      COMMA_UNUSED_LOCATION_ARGS) {
  GALGAS_bool result_p ; // Returned variable
  result_p = GALGAS_bool (false) ;
  cEnumerator_lstringlist enumerator_13792 (inArgument_l, kEnumeration_up) ;
  while (enumerator_13792.hasCurrentObject ()) {
    const enumGalgasBool test_0 = GALGAS_bool (kIsEqual, enumerator_13792.current_mValue (HERE).reader_string (SOURCE_FILE_AT_LINE (453)).objectCompare (inArgument_e.reader_string (SOURCE_FILE_AT_LINE (453)))).boolEnum () ;
    if (kBoolTrue == test_0) {
      result_p = GALGAS_bool (true) ;
    }
    enumerator_13792.gotoNextObject () ;
  }
//---
  return result_p ;
}


//---------------------------------------------------------------------------*
//  Function introspection                                                   *
//---------------------------------------------------------------------------*

static const C_galgas_type_descriptor * functionArgs_isInLstringlist [3] = {
  & kTypeDescriptor_GALGAS_lstringlist,
  & kTypeDescriptor_GALGAS_lstring,
  NULL
} ;

//---------------------------------------------------------------------------*

static GALGAS_object functionWithGenericHeader_isInLstringlist (C_Compiler * inCompiler,
                                                                const cObjectArray & inEffectiveParameterArray,
                                                                const GALGAS_location & /* §§ inErrorLocation */
                                                                COMMA_LOCATION_ARGS) {
  const GALGAS_lstringlist operand0 = GALGAS_lstringlist::extractObject (inEffectiveParameterArray.objectAtIndex (0 COMMA_HERE),
                                                                         inCompiler
                                                                         COMMA_THERE) ;
  const GALGAS_lstring operand1 = GALGAS_lstring::extractObject (inEffectiveParameterArray.objectAtIndex (1 COMMA_HERE),
                                                                 inCompiler
                                                                 COMMA_THERE) ;
  return function_isInLstringlist (operand0,
                                   operand1,
                                   inCompiler
                                   COMMA_THERE).reader_object (THERE) ;
}

//---------------------------------------------------------------------------*

C_galgas_function_descriptor functionDescriptor_isInLstringlist ("isInLstringlist",
                                                                 functionWithGenericHeader_isInLstringlist,
                                                                 & kTypeDescriptor_GALGAS_bool,
                                                                 2,
                                                                 functionArgs_isInLstringlist) ;

//---------------------------------------------------------------------------*
//                                                                           *
//                       Routine 'add_lstring_unique'                        *
//                                                                           *
//---------------------------------------------------------------------------*

void routine_add_5F_lstring_5F_unique (GALGAS_lstringlist & ioArgument_l,
                                       GALGAS_lstring inArgument_e,
                                       GALGAS_string inArgument_att,
                                       C_Compiler * inCompiler
                                       COMMA_UNUSED_LOCATION_ARGS) {
  GALGAS_bool var_found ;
  GALGAS_lstring var_res ;
  {
  routine_is_5F_in_5F_lstringlist (ioArgument_l, inArgument_e, var_res, var_found, inCompiler COMMA_SOURCE_FILE_AT_LINE (466)) ;
  }
  const enumGalgasBool test_0 = var_found.boolEnum () ;
  if (kBoolTrue == test_0) {
    GALGAS_location location_1 (inArgument_e.reader_location (HERE)) ; // Implicit use of 'location' reader
    inCompiler->emitSemanticError (location_1, inArgument_att.operator_concat (GALGAS_string (" ") COMMA_SOURCE_FILE_AT_LINE (468)).operator_concat (inArgument_e.reader_string (SOURCE_FILE_AT_LINE (468)) COMMA_SOURCE_FILE_AT_LINE (468)).operator_concat (GALGAS_string (" has already be listed") COMMA_SOURCE_FILE_AT_LINE (468)) COMMA_SOURCE_FILE_AT_LINE (468)) ;
    GALGAS_location location_2 (var_res.reader_location (HERE)) ; // Implicit use of 'location' reader
    inCompiler->emitSemanticError (location_2, GALGAS_string ("was listed here") COMMA_SOURCE_FILE_AT_LINE (469)) ;
  }else if (kBoolFalse == test_0) {
    ioArgument_l.addAssign_operation (inArgument_e COMMA_SOURCE_FILE_AT_LINE (471)) ;
  }
}


//---------------------------------------------------------------------------*
//                                                                           *
//                      Routine 'set_lstring_if_empty'                       *
//                                                                           *
//---------------------------------------------------------------------------*

void routine_set_5F_lstring_5F_if_5F_empty (GALGAS_lstring & ioArgument_s,
                                            GALGAS_lstring inArgument_ns,
                                            GALGAS_string inArgument_att,
                                            C_Compiler * inCompiler
                                            COMMA_UNUSED_LOCATION_ARGS) {
  const enumGalgasBool test_0 = GALGAS_bool (kIsEqual, ioArgument_s.reader_string (SOURCE_FILE_AT_LINE (480)).objectCompare (GALGAS_string::makeEmptyString ())).boolEnum () ;
  if (kBoolTrue == test_0) {
    ioArgument_s = inArgument_ns ;
  }else if (kBoolFalse == test_0) {
    GALGAS_location location_1 (inArgument_ns.reader_location (HERE)) ; // Implicit use of 'location' reader
    inCompiler->emitSemanticError (location_1, inArgument_att.operator_concat (GALGAS_string (" Redefinition") COMMA_SOURCE_FILE_AT_LINE (483)) COMMA_SOURCE_FILE_AT_LINE (483)) ;
    GALGAS_location location_2 (ioArgument_s.reader_location (HERE)) ; // Implicit use of 'location' reader
    inCompiler->emitSemanticError (location_2, GALGAS_string ("was defined here") COMMA_SOURCE_FILE_AT_LINE (484)) ;
  }
}


//---------------------------------------------------------------------------*
//                                                                           *
//                 Routine 'add_makefile_flag_if_not_empty'                  *
//                                                                           *
//---------------------------------------------------------------------------*

void routine_add_5F_makefile_5F_flag_5F_if_5F_not_5F_empty (GALGAS_string & ioArgument_receiver,
                                                            GALGAS_string inArgument_flag_5F_name,
                                                            GALGAS_string inArgument_flag_5F_value,
                                                            C_Compiler * /* inCompiler */
                                                            COMMA_UNUSED_LOCATION_ARGS) {
  const enumGalgasBool test_0 = GALGAS_bool (kIsNotEqual, inArgument_flag_5F_value.objectCompare (GALGAS_string::makeEmptyString ())).boolEnum () ;
  if (kBoolTrue == test_0) {
    ioArgument_receiver.dotAssign_operation (inArgument_flag_5F_name.operator_concat (GALGAS_string ("=") COMMA_SOURCE_FILE_AT_LINE (494)).operator_concat (inArgument_flag_5F_value COMMA_SOURCE_FILE_AT_LINE (494)).operator_concat (GALGAS_string ("\n") COMMA_SOURCE_FILE_AT_LINE (494)) COMMA_SOURCE_FILE_AT_LINE (494)) ;
  }
}


//---------------------------------------------------------------------------*
//                                                                           *
//                          Function 'lstringWith'                           *
//                                                                           *
//---------------------------------------------------------------------------*

GALGAS_lstring function_lstringWith (GALGAS_string inArgument_s,
                                     C_Compiler * inCompiler
                                     COMMA_UNUSED_LOCATION_ARGS) {
  GALGAS_lstring result_r ; // Returned variable
  result_r = GALGAS_lstring::constructor_new (inArgument_s, inCompiler->here () COMMA_SOURCE_FILE_AT_LINE (499)) ;
//---
  return result_r ;
}


//---------------------------------------------------------------------------*
//  Function introspection                                                   *
//---------------------------------------------------------------------------*

static const C_galgas_type_descriptor * functionArgs_lstringWith [2] = {
  & kTypeDescriptor_GALGAS_string,
  NULL
} ;

//---------------------------------------------------------------------------*

static GALGAS_object functionWithGenericHeader_lstringWith (C_Compiler * inCompiler,
                                                            const cObjectArray & inEffectiveParameterArray,
                                                            const GALGAS_location & /* §§ inErrorLocation */
                                                            COMMA_LOCATION_ARGS) {
  const GALGAS_string operand0 = GALGAS_string::extractObject (inEffectiveParameterArray.objectAtIndex (0 COMMA_HERE),
                                                               inCompiler
                                                               COMMA_THERE) ;
  return function_lstringWith (operand0,
                               inCompiler
                               COMMA_THERE).reader_object (THERE) ;
}

//---------------------------------------------------------------------------*

C_galgas_function_descriptor functionDescriptor_lstringWith ("lstringWith",
                                                             functionWithGenericHeader_lstringWith,
                                                             & kTypeDescriptor_GALGAS_lstring,
                                                             1,
                                                             functionArgs_lstringWith) ;

//---------------------------------------------------------------------------*
//                                                                           *
//                          Function 'stripString'                           *
//                                                                           *
//---------------------------------------------------------------------------*

GALGAS_string function_stripString (GALGAS_string inArgument_s,
                                    C_Compiler * inCompiler
                                    COMMA_UNUSED_LOCATION_ARGS) {
  GALGAS_string result_r ; // Returned variable
  const enumGalgasBool test_0 = GALGAS_bool (kIsStrictSup, inArgument_s.reader_length (SOURCE_FILE_AT_LINE (503)).objectCompare (GALGAS_uint ((PMUInt32) 0U))).boolEnum () ;
  if (kBoolTrue == test_0) {
    GALGAS_uint var_first = GALGAS_uint ((PMUInt32) 0U) ;
    GALGAS_uint var_last = inArgument_s.reader_length (SOURCE_FILE_AT_LINE (505)) ;
    GALGAS_bool var_finished = GALGAS_bool (false) ;
    if (inArgument_s.reader_length (SOURCE_FILE_AT_LINE (508)).isValid ()) {
      PMUInt32 variant_14958 = inArgument_s.reader_length (SOURCE_FILE_AT_LINE (508)).uintValue () ;
      bool loop_14958 = true ;
      while (loop_14958) {
        loop_14958 = var_finished.operator_not (SOURCE_FILE_AT_LINE (509)).isValid () ;
        if (loop_14958) {
          loop_14958 = var_finished.operator_not (SOURCE_FILE_AT_LINE (509)).boolValue () ;
        }
        if (loop_14958 && (0 == variant_14958)) {
          loop_14958 = false ;
          inCompiler->loopRunTimeVariantError (SOURCE_FILE_AT_LINE (508)) ;
        }
        if (loop_14958) {
          variant_14958 -- ;
          const enumGalgasBool test_1 = GALGAS_bool (kIsEqual, inArgument_s.reader_characterAtIndex (var_first, inCompiler COMMA_SOURCE_FILE_AT_LINE (510)).objectCompare (GALGAS_char (TO_UNICODE (32)))).boolEnum () ;
          if (kBoolTrue == test_1) {
            var_first.increment_operation (inCompiler COMMA_SOURCE_FILE_AT_LINE (511)) ;
            const enumGalgasBool test_2 = GALGAS_bool (kIsEqual, var_first.objectCompare (inArgument_s.reader_length (SOURCE_FILE_AT_LINE (512)))).boolEnum () ;
            if (kBoolTrue == test_2) {
              var_finished = GALGAS_bool (true) ;
            }
          }else if (kBoolFalse == test_1) {
            var_finished = GALGAS_bool (true) ;
          }
        }
      }
    }
    var_finished = GALGAS_bool (false) ;
    if (inArgument_s.reader_length (SOURCE_FILE_AT_LINE (517)).isValid ()) {
      PMUInt32 variant_15263 = inArgument_s.reader_length (SOURCE_FILE_AT_LINE (517)).uintValue () ;
      bool loop_15263 = true ;
      while (loop_15263) {
        loop_15263 = var_finished.operator_not (SOURCE_FILE_AT_LINE (518)).isValid () ;
        if (loop_15263) {
          loop_15263 = var_finished.operator_not (SOURCE_FILE_AT_LINE (518)).boolValue () ;
        }
        if (loop_15263 && (0 == variant_15263)) {
          loop_15263 = false ;
          inCompiler->loopRunTimeVariantError (SOURCE_FILE_AT_LINE (517)) ;
        }
        if (loop_15263) {
          variant_15263 -- ;
          const enumGalgasBool test_3 = GALGAS_bool (kIsEqual, inArgument_s.reader_characterAtIndex (var_last.substract_operation (GALGAS_uint ((PMUInt32) 1U), inCompiler COMMA_SOURCE_FILE_AT_LINE (519)), inCompiler COMMA_SOURCE_FILE_AT_LINE (519)).objectCompare (GALGAS_char (TO_UNICODE (32)))).boolEnum () ;
          if (kBoolTrue == test_3) {
            var_last.decrement_operation (inCompiler COMMA_SOURCE_FILE_AT_LINE (520)) ;
            const enumGalgasBool test_4 = GALGAS_bool (kIsEqual, var_last.objectCompare (GALGAS_uint ((PMUInt32) 0U))).boolEnum () ;
            if (kBoolTrue == test_4) {
              var_finished = GALGAS_bool (true) ;
            }
          }else if (kBoolFalse == test_3) {
            var_finished = GALGAS_bool (true) ;
          }
        }
      }
    }
    const enumGalgasBool test_5 = GALGAS_bool (kIsStrictInf, var_first.objectCompare (var_last)).boolEnum () ;
    if (kBoolTrue == test_5) {
      result_r = inArgument_s.reader_subString (var_first, var_last.substract_operation (var_first, inCompiler COMMA_SOURCE_FILE_AT_LINE (526)) COMMA_SOURCE_FILE_AT_LINE (526)) ;
    }else if (kBoolFalse == test_5) {
      result_r = GALGAS_string::makeEmptyString () ;
    }
  }else if (kBoolFalse == test_0) {
    result_r = GALGAS_string::makeEmptyString () ;
  }
//---
  return result_r ;
}


//---------------------------------------------------------------------------*
//  Function introspection                                                   *
//---------------------------------------------------------------------------*

static const C_galgas_type_descriptor * functionArgs_stripString [2] = {
  & kTypeDescriptor_GALGAS_string,
  NULL
} ;

//---------------------------------------------------------------------------*

static GALGAS_object functionWithGenericHeader_stripString (C_Compiler * inCompiler,
                                                            const cObjectArray & inEffectiveParameterArray,
                                                            const GALGAS_location & /* §§ inErrorLocation */
                                                            COMMA_LOCATION_ARGS) {
  const GALGAS_string operand0 = GALGAS_string::extractObject (inEffectiveParameterArray.objectAtIndex (0 COMMA_HERE),
                                                               inCompiler
                                                               COMMA_THERE) ;
  return function_stripString (operand0,
                               inCompiler
                               COMMA_THERE).reader_object (THERE) ;
}

//---------------------------------------------------------------------------*

C_galgas_function_descriptor functionDescriptor_stripString ("stripString",
                                                             functionWithGenericHeader_stripString,
                                                             & kTypeDescriptor_GALGAS_string,
                                                             1,
                                                             functionArgs_stripString) ;

//---------------------------------------------------------------------------*
//                                                                           *
//                        Routine 'errorNoFileFound'                         *
//                                                                           *
//---------------------------------------------------------------------------*

void routine_errorNoFileFound (const GALGAS_stringlist constinArgument_searchedPaths,
                               const GALGAS_string constinArgument_kind,
                               const GALGAS_lstring constinArgument_file,
                               C_Compiler * inCompiler
                               COMMA_UNUSED_LOCATION_ARGS) {
  GALGAS_string var_m = GALGAS_string ("cannot find a valid path for the '").operator_concat (constinArgument_file.reader_string (SOURCE_FILE_AT_LINE (540)) COMMA_SOURCE_FILE_AT_LINE (540)).operator_concat (GALGAS_string ("' ") COMMA_SOURCE_FILE_AT_LINE (540)).operator_concat (constinArgument_kind COMMA_SOURCE_FILE_AT_LINE (540)).operator_concat (GALGAS_string (" file. I have tried:") COMMA_SOURCE_FILE_AT_LINE (540)) ;
  cEnumerator_stringlist enumerator_15878 (constinArgument_searchedPaths, kEnumeration_up) ;
  while (enumerator_15878.hasCurrentObject ()) {
    var_m.dotAssign_operation (GALGAS_string ("\n"
      "  - '").operator_concat (enumerator_15878.current_mValue (HERE) COMMA_SOURCE_FILE_AT_LINE (542)).operator_concat (GALGAS_string ("'") COMMA_SOURCE_FILE_AT_LINE (542)) COMMA_SOURCE_FILE_AT_LINE (542)) ;
    enumerator_15878.gotoNextObject () ;
  }
  GALGAS_location location_0 (constinArgument_file.reader_location (HERE)) ; // Implicit use of 'location' reader
  inCompiler->emitSemanticError (location_0, var_m COMMA_SOURCE_FILE_AT_LINE (544)) ;
}


//---------------------------------------------------------------------------*
//                                                                           *
//                          Function 'stringLBool'                           *
//                                                                           *
//---------------------------------------------------------------------------*

GALGAS_string function_stringLBool (const GALGAS_lbool & constinArgument_boolValue,
                                    C_Compiler * /* inCompiler */
                                    COMMA_UNUSED_LOCATION_ARGS) {
  GALGAS_string result_result ; // Returned variable
  const enumGalgasBool test_0 = constinArgument_boolValue.reader_bool (SOURCE_FILE_AT_LINE (551)).boolEnum () ;
  if (kBoolTrue == test_0) {
    result_result = GALGAS_string ("TRUE") ;
  }else if (kBoolFalse == test_0) {
    result_result = GALGAS_string ("FALSE") ;
  }
//---
  return result_result ;
}


//---------------------------------------------------------------------------*
//  Function introspection                                                   *
//---------------------------------------------------------------------------*

static const C_galgas_type_descriptor * functionArgs_stringLBool [2] = {
  & kTypeDescriptor_GALGAS_lbool,
  NULL
} ;

//---------------------------------------------------------------------------*

static GALGAS_object functionWithGenericHeader_stringLBool (C_Compiler * inCompiler,
                                                            const cObjectArray & inEffectiveParameterArray,
                                                            const GALGAS_location & /* §§ inErrorLocation */
                                                            COMMA_LOCATION_ARGS) {
  const GALGAS_lbool operand0 = GALGAS_lbool::extractObject (inEffectiveParameterArray.objectAtIndex (0 COMMA_HERE),
                                                             inCompiler
                                                             COMMA_THERE) ;
  return function_stringLBool (operand0,
                               inCompiler
                               COMMA_THERE).reader_object (THERE) ;
}

//---------------------------------------------------------------------------*

C_galgas_function_descriptor functionDescriptor_stringLBool ("stringLBool",
                                                             functionWithGenericHeader_stringLBool,
                                                             & kTypeDescriptor_GALGAS_string,
                                                             1,
                                                             functionArgs_stringLBool) ;

//--- START OF USER ZONE 2


//--- END OF USER ZONE 2


